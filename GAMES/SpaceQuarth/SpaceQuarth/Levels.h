/*
 * The MIT License
 *
 * Copyright 2017 Schuemi.
 *
 * Permission is hereby granted, free of charge, to any person obtaining a copy
 * of this software and associated documentation files (the "Software"), to deal
 * in the Software without restriction, including without limitation the rights
 * to use, copy, modify, merge, publish, distribute, sublicense, and/or sell
 * copies of the Software, and to permit persons to whom the Software is
 * furnished to do so, subject to the following conditions:
 *
 * The above copyright notice and this permission notice shall be included in
 * all copies or substantial portions of the Software.
 *
 * THE SOFTWARE IS PROVIDED "AS IS", WITHOUT WARRANTY OF ANY KIND, EXPRESS OR
 * IMPLIED, INCLUDING BUT NOT LIMITED TO THE WARRANTIES OF MERCHANTABILITY,
 * FITNESS FOR A PARTICULAR PURPOSE AND NONINFRINGEMENT. IN NO EVENT SHALL THE
 * AUTHORS OR COPYRIGHT HOLDERS BE LIABLE FOR ANY CLAIM, DAMAGES OR OTHER
 * LIABILITY, WHETHER IN AN ACTION OF CONTRACT, TORT OR OTHERWISE, ARISING FROM,
 * OUT OF OR IN CONNECTION WITH THE SOFTWARE OR THE USE OR OTHER DEALINGS IN
 * THE SOFTWARE.
 */


/* 
 * File:   Levels.h
 * Author: Schuemi
 *
 * Created on 14. Dezember 2017, 09:43
 */

#ifndef LEVELS_H
#define LEVELS_H
#include <stdint.h>

struct levelCharacteristics {
        uint8_t scrollSpeed; // scrollspeed 45 - 1
        uint8_t objectMaxHeight; // maximum height of the objectGroup
        uint8_t objectMaxWidth; // maximum with 3 - 16
        uint8_t objectMaxCount; // maximum objects in one objectGroup
        uint8_t minObjectSpaceBetween; // min space between two objectGroups (not exactly)
        uint8_t objectCountPerStage; // objectgroup counts to go one stage up
        uint8_t tightLevel; // how tight are the objects places together to one objectGroup 0 - 3
};
 
static void getLcharacteristics(uint8_t level, uint8_t levelStage, uint8_t gameMode, levelCharacteristics* levelc) {
   
    
    
    // okay
    if (level == 1){
        levelc->scrollSpeed = 40;
        levelc->objectMaxHeight = 20;
        levelc->objectMaxCount = 10;
        levelc->objectMaxWidth = 6;
        levelc->minObjectSpaceBetween = 5;
        levelc->tightLevel = 4;
        levelc->objectCountPerStage = 1;
        if (levelStage > 4){ levelc->objectMaxCount = 15; levelc->scrollSpeed = 35;}
        if (levelStage > 8){ levelc->objectMaxWidth = 10; levelc->tightLevel = 3; }
        
    }
    // okay
     if (level == 2){
        levelc->scrollSpeed = 35;
        levelc->objectMaxHeight = 8;
        levelc->objectMaxCount = 15;
        levelc->objectMaxWidth = 10;
        levelc->minObjectSpaceBetween = 5;
        levelc->tightLevel = 4;
        levelc->objectCountPerStage = 1;
        if (levelStage > 4) levelc->scrollSpeed = 35;
        if (levelStage > 8) levelc->objectMaxWidth = 12;
        
    }
    
    //// okay: speed level  
    if (level == 3){
         levelc->scrollSpeed = 11;
        levelc->objectMaxHeight = 8;
        levelc->objectMaxCount = 3;
        levelc->objectMaxWidth = 8;
        levelc->minObjectSpaceBetween = 6;
        levelc->tightLevel = 1;
        levelc->objectCountPerStage = 2;
        
        
    }
    
    //// okay big and tight , big but slow
    if (level == 4){
        levelc->scrollSpeed = 50;
        levelc->objectMaxHeight = 30;
        levelc->objectMaxCount = 30;
        levelc->objectMaxWidth = 12;
        levelc->minObjectSpaceBetween = 6;
        levelc->tightLevel = 10;
        levelc->objectCountPerStage = 1;
        
    }
    
  
    
    // Okay: speed Level 2
    if (level == 5){
        levelc->scrollSpeed = 9;
        levelc->objectMaxHeight = 8;
        levelc->objectMaxCount = 3;
        levelc->objectMaxWidth = 8;
        levelc->minObjectSpaceBetween = 6;
        levelc->tightLevel = 3;
        levelc->objectCountPerStage = 4;
        
        
    }
     if (level == 6){
        levelc->scrollSpeed = 45- (levelStage * 3);
        levelc->objectMaxHeight = 30;
        levelc->objectMaxCount = 30;
        levelc->objectMaxWidth = 14;
        levelc->minObjectSpaceBetween = 12;
        levelc->tightLevel = 6;
        levelc->objectCountPerStage = 1;
        if (levelStage  % 2 == 1)
        {
            levelc->scrollSpeed = 6;
            levelc->objectMaxCount = 2;
            levelc->minObjectSpaceBetween = 19;
        }
       
        
    }
     if (level == 7){
         levelc->scrollSpeed = 35 - levelStage;
        levelc->objectMaxHeight = 30;
        levelc->objectMaxCount = 30;
        levelc->objectMaxWidth = 13;
        levelc->minObjectSpaceBetween = 10 - levelStage;
        levelc->tightLevel = levelStage + 1;
        levelc->objectCountPerStage = 1;
        
    }
    if (level >= 8){
         levelc->scrollSpeed = 42 - (levelStage * 3);
        levelc->objectMaxHeight = 30;
        levelc->objectMaxCount = 30;
        levelc->objectMaxWidth = 16 - levelStage;
        levelc->minObjectSpaceBetween = 20 - levelStage;
        levelc->tightLevel = 10;
        levelc->objectCountPerStage = 1;
        
        
        
    }
    
    if (gameMode == GAME_MODE_NORMAL)  levelc->scrollSpeed --;
    if (gameMode == GAME_MODE_HARD)  levelc->scrollSpeed -=2;
    
}   
struct levelObject {
    uint8_t x;
    uint8_t y;
    uint8_t objectType;
    uint8_t spezial;
    
};

//36x39
const PROGMEM uint8_t  l1rPic[] = {
0x00,0x00,0x80,0xc0,0xe0,0xf0,0xf8,0xfc,0xfc,0xfc,0xfc,0xfc,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0x00
};

//36x40
//#const PROGMEM uint8_t  l2rPic[] = {
//#0x00,0x00,0x00,0x80,0xa0,0xe0,0xf0,0xf0,0xf8,0xf2,0x3e,0x7f,0x1c,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0x00
//#};

//36x42
const PROGMEM uint8_t  l3rPic[] = {
0x00,0x00,0x00,0xf0,0x30,0x20,0x20,0x20,0xe0,0xe0,0xe0,0xe0,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0x00
};

//36x43
const PROGMEM uint8_t  l4rPic[] = {
0x00,0x00,0x00,0x00,0x00,0x00,0x00,0x00,0x00,0x00,0x00,0x80,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0x00
};

//26,45
const PROGMEM uint8_t  l5rPic[] = {
0x00,0x00,0x00,0x00,0x00,0x00,0x00,0xe0,0xf0,0xfc,0xe2,0x01,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0x00
};
//36,42
const PROGMEM uint8_t  l6rPic[] = {
0x00,0x00,0x00,0x00,0x00,0x00,0x00,0x00,0x00,0xe0,0xb0,0x48,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0x00
};
//36,44
const PROGMEM uint8_t  l7rPic[] = {
0x00,0x00,0x00,0x00,0x00,0x80,0xc0,0x60,0x30,0x10,0x08,0x08,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0x00
};
//36,40
const PROGMEM uint8_t  l8rPic[] = {
0x00,0x00,0x00,0x00,0x00,0x00,0x00,0x00,0x00,0x00,0xf8,0xfc,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0x00
};

const PROGMEM uint8_t  l9rPic[] = {
0xf0,0xfc,0x0e,0x0e,0x06,0x04,0x00,0x10,0x30,0x60,0x80,0xc0,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0x00
};


const PROGMEM uint8_t  bricks[] =  {
    0b11100000,
    0b10000000,
    0b10000000,
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    0b00000000,
   
    
    
};


#endif /* LEVELS_H */
