/*
 * The MIT License
 *
 * Copyright 2017 Schuemi.
 *
 * Permission is hereby granted, free of charge, to any person obtaining a copy
 * of this software and associated documentation files (the "Software"), to deal
 * in the Software without restriction, including without limitation the rights
 * to use, copy, modify, merge, publish, distribute, sublicense, and/or sell
 * copies of the Software, and to permit persons to whom the Software is
 * furnished to do so, subject to the following conditions:
 *
 * The above copyright notice and this permission notice shall be included in
 * all copies or substantial portions of the Software.
 *
 * THE SOFTWARE IS PROVIDED "AS IS", WITHOUT WARRANTY OF ANY KIND, EXPRESS OR
 * IMPLIED, INCLUDING BUT NOT LIMITED TO THE WARRANTIES OF MERCHANTABILITY,
 * FITNESS FOR A PARTICULAR PURPOSE AND NONINFRINGEMENT. IN NO EVENT SHALL THE
 * AUTHORS OR COPYRIGHT HOLDERS BE LIABLE FOR ANY CLAIM, DAMAGES OR OTHER
 * LIABILITY, WHETHER IN AN ACTION OF CONTRACT, TORT OR OTHERWISE, ARISING FROM,
 * OUT OF OR IN CONNECTION WITH THE SOFTWARE OR THE USE OR OTHER DEALINGS IN
 * THE SOFTWARE.
 */


/* 
 * File:   DashBoard.cpp
 * Author: Schuemi
 * 
 * Created on 12. Dezember 2017, 11:28
 */

#include "DashBoard.h"
#include "StarField.h"
//#include "math.h"
//#include <avr/pgmspace.h>
//#include <Arduboy2Audio.h>
#include "Arduboy2.h"

extern Arduboy2 arduboy;
extern StarField m_starField;

#define MENU_X 27
#define MENU_Y 38
#define MENU_X_TXT MENU_X + 5


enum MENU_ITEMS {
    MENU_ITEM_SOUND = 0,
    MENU_ITEM_SAVE,
    MENU_ITEM_MODE,
    MENU_ITEM_LEVEL
    
};

const uint8_t  DashBoard::title[] = {
0x00,0xf8,0xf8,0xf8,0xf8,0xf8,0xf8,0xf8,0xf0,0xc0,0x00,0xc0,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0x00
};






DashBoard::DashBoard() {
   m_startLevel = 1;
   reset_();
}

void DashBoard::reset_() {
    arduboy.setRGBled(0,0,0);
    m_fontPosition = 128;
    m_bounce = 1;
    m_startGame = false;
    m_startHighScore = false;
    m_currSelected = 0;
    m_itemsCount = 3;
    if (EEPROM.read(EEPROM_GAME_CLEARED_BYTE + EEPROM_STORAGE_SPACE_START) == 0x32) m_itemsCount = 4;
    
    m_gameMode = 0xff;
}

//DashBoard::~DashBoard() {
//}


void DashBoard::draw() {
    uint8_t itemsy = MENU_Y;
    uint8_t isSave;
    
    if (m_itemsCount > 3) itemsy = itemsy - (m_currSelected * 3);
    
    arduboy.pollButtons();
    
    arduboy.clear();
    
    if (m_fontPosition > 35) 
        m_fontPosition-= 4;
    else if (m_bounce > -0.7) {
        m_bounce-= 0.03;
        m_fontPosition-= sin(m_bounce)*4;
    } 
    
   
    
    
    
    
    arduboy.drawPixel(MENU_X + 1, itemsy + 3 + (m_currSelected * 8));
    arduboy.drawPixel(MENU_X, itemsy + 2 + (m_currSelected * 8));
    arduboy.drawPixel(MENU_X, itemsy + 3 + (m_currSelected * 8));
    arduboy.drawPixel(MENU_X, itemsy + 4 + (m_currSelected * 8));
    arduboy.setCursor(MENU_X_TXT, itemsy);
    if (arduboy.audio.enabled())
        arduboy.print(F("SOUND: ON"));
    else
        arduboy.print(F("SOUND: OFF"));
    
    itemsy += 8;arduboy.setCursor(MENU_X_TXT, itemsy);
    isSave = EEPROM.read(EEPROM_AUTOSAVE_BYTE + EEPROM_STORAGE_SPACE_START);
    if (isSave) 
       arduboy.print(F("SAVE : ON"));
    else
       arduboy.print(F("SAVE : OFF"));
    
    
    itemsy += 8;arduboy.setCursor(MENU_X_TXT, itemsy);
    
    if (m_gameMode  > GAME_MODE_HARD){
        m_gameMode = EEPROM.read(EEPROM_GAME_MODE_BYTE + EEPROM_STORAGE_SPACE_START);
        if (m_gameMode  > GAME_MODE_HARD) m_gameMode = GAME_MODE_EASY;
    }
    
    
    arduboy.print(F("MODE :"));
    
    switch(m_gameMode) {
        case GAME_MODE_EASY: arduboy.print(F("EASY")); break;
        case GAME_MODE_NORMAL: arduboy.print(F("NORMAL")); break;
        case GAME_MODE_HARD: arduboy.print(F("HARD")); break;
        
    }
   
    
    if (m_itemsCount == 4) {
        itemsy += 8;arduboy.setCursor(MENU_X_TXT, itemsy);
        arduboy.print(F("LEVEL: ")); arduboy.print(m_startLevel);
    }
    

    
    m_starField.move();
    m_starField.draw(false);
        
    if (arduboy.justPressed(A_BUTTON)){
       m_startHighScore = true;
    }
    if (arduboy.justPressed(B_BUTTON)){
       m_startGame = true;
       arduboy.initRandomSeed();
    }
    if (arduboy.justPressed(DOWN_BUTTON)){
        m_currSelected++;
        if (m_currSelected == m_itemsCount) m_currSelected = 0;
    }
    
    
    
    if (arduboy.justPressed(UP_BUTTON)){
        if (m_currSelected == 0) m_currSelected = m_itemsCount - 1; else m_currSelected--;

    }
    if (arduboy.justPressed(LEFT_BUTTON) || arduboy.justPressed(RIGHT_BUTTON)){
        if (m_currSelected == MENU_ITEM_SOUND){
            arduboy.audio.toggle();
            arduboy.audio.saveOnOff();
        }
        if (m_currSelected == MENU_ITEM_SAVE){
           if (isSave) EEPROM.write(EEPROM_AUTOSAVE_BYTE + EEPROM_STORAGE_SPACE_START, 0); else  EEPROM.write(EEPROM_AUTOSAVE_BYTE + EEPROM_STORAGE_SPACE_START, 1);
           EEPROM.commit();
        }
    }
    if (arduboy.justPressed(LEFT_BUTTON)){
        
        if (m_currSelected == MENU_ITEM_LEVEL){
            m_startLevel--;
            if (m_startLevel == 0) m_startLevel = 8;

        }
        if (m_currSelected == MENU_ITEM_MODE){
            if (m_gameMode == GAME_MODE_EASY) m_gameMode = GAME_MODE_HARD; else m_gameMode--;
        }
        
    }
    if (arduboy.justPressed(RIGHT_BUTTON)){
       
        if (m_currSelected == MENU_ITEM_LEVEL){
            m_startLevel++;
            if (m_startLevel == 9) m_startLevel = 1;
        }
        if (m_currSelected == MENU_ITEM_MODE){
            if (m_gameMode == GAME_MODE_HARD) m_gameMode = GAME_MODE_EASY; else m_gameMode++;
            
        }
    }
    
    arduboy.setCursor(105, 56);
    String toPrint = "V" + (String)VERSION_MAJOR + "." + (String)VERSION_MINOR;
    arduboy.print(toPrint);
    
    arduboy.drawBitmap(m_fontPosition, 5, title, 120, 31);
    arduboy.display();
    
}
