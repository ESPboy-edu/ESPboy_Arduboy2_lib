#ifndef TITLE_H
#define TITLE_H

// Title screen: the game's own playfield scrolls by behind the logo, and a small menu sits at the bottom.
// The logo is stored compressed (see logoImg / logoCol) and merged straight into the display buffer, so the
// playfield shows through the transparent parts around it.

#include "globals.h"
#include "playfield.h"

#define LOGO_W        90
#define LOGO_X        19          // centred
#define LOGO_PAGE     1           // top of the logo = row 8 (the logo is written to the buffer in whole pages)

// logo 90 x 32: white pixels only, 4 pages of 90 columns (the black outline and the transparent corners are both 0)
const unsigned char PROGMEM logoImg[] =
{
  0x00, 0x00, 0x00, 0x00, 0x00, 0x00, 0x00, 0x00, 0x7e, 0xfe, 0xfe, 0xfe, 0x78, 0xfe, 0x7e, 0x00,
  0xfe, 0xfe, 0xfe, 0xfe, 0x08, 0xfe, 0xfe, 0x00, 0x1e, 0xbe, 0xfe, 0xfe, 0x78, 0x3e, 0x1e, 0x00,
  0x00, 0xfe, 0xfe, 0xfe, 0xfe, 0xf2, 0xfe, 0x7c, 0x00, 0xf2, 0xf2, 0xfe, 0xfe, 0xfe, 0xf2, 0xf2,
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  0x41, 0x7f, 0x7f, 0x7f, 0x79, 0x7f, 0x3e, 0x00,
};

// per column: (transparent rows at the top << 3) | transparent rows at the bottom; everything between is opaque, white where logoImg has a pixel, black elsewhere
const unsigned char PROGMEM logoCol[] =
{
  0xc1, 0xb8, 0xb8, 0xb8, 0x50, 0x48, 0x40, 0x00, 0x00, 0x00, 0x00, 0x00, 0x00, 0x00, 0x00, 0x00,
  0x00, 0x00, 0x00, 0x00, 0x00, 0x00, 0x00, 0x00, 0x00, 0x00, 0x00, 0x00, 0x00, 0x00, 0x00, 0x00,
  0x00, 0x00, 0x00, 0x00, 0x01, 0x04, 0x04, 0x00, 0x00, 0x00, 0x00, 0x00, 0x00, 0x00, 0x00, 0x00,
  0x00, 0x00, 0x00, 0x00, 0x00, 0x00, 0x00, 0x00, 0x08, 0x00, 0x00, 0x01, 0x00, 0x00, 0x00, 0x00,
  0x00, 0x00, 0x00, 0x00, 0x00, 0x00, 0x00, 0x00, 0x00, 0x00, 0x00, 0x00, 0x00, 0x00, 0x00, 0x00,
  0x00, 0x08, 0x40, 0x40, 0x40, 0x40, 0xb8, 0xb8, 0xb8, 0xc1,
};

// the logo, written into the display buffer: only the opaque rows of every column are touched
void drawLogo()
{
  uint8_t *buf = arduboy.getBuffer();
  for (byte x = 0; x < LOGO_W; x++)
  {
    byte tb = pgm_read_byte(&logoCol[x]);
    int8_t top = tb >> 3, end = 32 - (tb & 7);             // opaque rows: top .. end-1
    for (byte p = 0; p < 4; p++)
    {
      int8_t lo = top - 8 * p, hi = end - 8 * p;           // the opaque rows inside this page
      if (hi <= 0 || lo >= 8) continue;
      if (lo < 0) lo = 0;
      if (hi > 8) hi = 8;
      byte m = (byte)(0xFF << lo) & (byte)(0xFF >> (8 - hi));
      byte *d = &buf[(LOGO_PAGE + p) * 128 + LOGO_X + x];
      *d = (*d & ~m) | (pgm_read_byte(&logoImg[p * LOGO_W + x]) & m);
    }
  }
}

// the three menu words INFO PLAY CONF as 30 x 8 buttons (image only, drawn over a black band; menuSelection 0..2)
#define MENU_X0  17                                     // the three buttons are centred (30 wide, 2 apart)
#define MENU_Y   52
const unsigned char PROGMEM menuWords[] =
{
  30, 8,
  0x00, 0x72, 0x72, 0x7e, 0x7e, 0x7e, 0x72, 0x72, 0x0c, 0x7e, 0x7e, 0x7e, 0x04, 0x08, 0x7e,
  0x00, 0x7e, 0x7e, 0x7e, 0x16, 0x06, 0x06, 0x38, 0x7e, 0x7e, 0x72, 0x72, 0x7e, 0x3c, 0x00,
  0x00, 0x7e, 0x7e, 0x7e, 0x7e, 0x12, 0x1e, 0x0c, 0x70, 0x7e, 0x7e, 0x7e, 0x60, 0x60, 0x60,
  0x10, 0x7a, 0x7a, 0x6a, 0x6a, 0x7e, 0x3c, 0x42, 0x5e, 0x7e, 0x7e, 0x30, 0x3e, 0x1e, 0x00,
  0x00, 0x3c, 0x7e, 0x7e, 0x7e, 0x76, 0x76, 0x30, 0x0c, 0x7e, 0x7e, 0x72, 0x72, 0x7e, 0x3c,
  0x42, 0x7e, 0x7e, 0x7e, 0x04, 0x08, 0x7e, 0x00, 0x7e, 0x7e, 0x7e, 0x16, 0x06, 0x06, 0x00,
};

void drawWord(int16_t x, int16_t y, byte item)
{
  sprites.drawOverwrite(x, y, menuWords, item);
}

// an egg bounces above the selected word
byte    menuAnim = 0;
const unsigned char PROGMEM eggBounce[16] = { 0, 0, 0, 0, 0, 0, 0, 0, 1, 2, 2, 2, 1, 0, 0, 0 };

// the black band at the menu row, and the egg that bounces above the current choice (x = left edge of the egg)
void drawBand() { arduboy.fillRect(0, MENU_Y, 128, 8, BLACK); }

void drawEgg(int16_t x)
{
  sprites.drawPlusMask(x, MENU_Y - 12 - pgm_read_byte(&eggBounce[(menuAnim >> 1) & 15]), eggSprite, 0);
  menuAnim++;
}

void drawMenu()
{
  drawBand();
  for (byte i = 0; i < 3; i++) drawWord(MENU_X0 + i * 32, MENU_Y, i);
  drawEgg(MENU_X0 + menuSelection * 32 + 10);
}

// the world that scrolls by behind the title (no chicken)
bool    titleReady = false;
byte    titleSub = 0;

void titleWorld()
{
  scrollY = -32000;                                     // no dead zone behind the title screen
  if (!titleReady || (camY >> 3) > 3000)                // (re)build the world; also before the rows get too big for int16
  {
    worldInit();
    player.set();
    player.characteristics = 0;                         // no chicken
    camX = player.x; camY = player.y;
    titleSub = 0;
    titleReady = true;
  }
  titleSub += 6;                                        // 6/16 px per frame
  camY += titleSub >> 4;
  titleSub &= 15;
  int16_t cr = camY >> 3;
  extendWorld(cr);
  updateLanes(cr);
  drawGround();
  drawObjects();
}

void drawTitle()
{
  if (menuSelection > 2) menuSelection = 1;             // PLAY is pre-selected
  titleWorld();
  drawLogo();
  drawMenu();
}

// the info screen: the logo stays, the band shows CREATED BY JO3RI (image only, drawn over the black band)
const unsigned char PROGMEM infoBy[] =
{
  15, 8,
  0x00, 0x7e, 0x7e, 0x7e, 0x7e, 0x4a, 0x7e, 0x34, 0x4a, 0x7e, 0x7e, 0x78, 0x3e, 0x1e, 0x00,
};
const unsigned char PROGMEM infoCreated[] =
{
  45, 8,
  0x00, 0x3c, 0x7e, 0x7e, 0x7a, 0x7a, 0x7a, 0x38, 0x42, 0x7e, 0x7e, 0x0a, 0x7a, 0x74, 0x0a,
  0x7e, 0x7e, 0x6a, 0x6e, 0x2c, 0x52, 0x7a, 0x6a, 0x6e, 0x7e, 0x3c, 0x02, 0x7e, 0x7e, 0x7e,
  0x06, 0x36, 0x78, 0x7e, 0x7e, 0x6a, 0x6e, 0x2c, 0x52, 0x7e, 0x7e, 0x72, 0x7e, 0x3c, 0x00,
};
const unsigned char PROGMEM infoJo3ri[] =
{
  33, 8,
  0x00, 0x38, 0x7a, 0x72, 0x7e, 0x7e, 0x7e, 0x3c, 0x42, 0x7e, 0x72, 0x72, 0x7e, 0x3c, 0x42,
  0x6a, 0x7e, 0x7e, 0x7e, 0x3c, 0x42, 0x7e, 0x7e, 0x0a, 0x7a, 0x74, 0x0a, 0x7e, 0x7e, 0x7e,
  0x7a, 0x7a, 0x00,
};

void drawInfo()
{
  titleWorld();
  drawLogo();
  drawBand();
  sprites.drawOverwrite(13, MENU_Y, infoCreated, 0);
  sprites.drawOverwrite(62, MENU_Y, infoBy, 0);
  sprites.drawOverwrite(81, MENU_Y, infoJo3ri, 0);
}

// the sound screen: the logo stays, the band shows SOUND ON OFF, the egg bounces above the current setting
// (placeholder words, to be replaced by the real ones)
const unsigned char PROGMEM confSound[] =
{
  33, 8,
  0x00, 0x24, 0x6e, 0x6e, 0x7e, 0x7a, 0x7a, 0x32, 0x4c, 0x7e, 0x72, 0x72,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 0x00,
};
const unsigned char PROGMEM confOn[] =
{
  15, 8,
  0x00, 0x3c, 0x7e, 0x7e, 0x72, 0x72, 0x7e, 0x3c, 0x42, 0x7e, 0x7e, 0x04, 0x08, 0x7e, 0x00,
};
const unsigned char PROGMEM confOff[] =
{
  20, 8,
  0x00, 0x3c, 0x7e, 0x7e, 0x72, 0x72, 0x7e, 0x3c, 0x42, 0x7e, 0x7e, 0x16, 0x66, 0x78, 0x7e, 0x7e, 0x16, 0x06, 0x06, 0x00,
};

void drawConf()
{
  titleWorld();
  drawLogo();
  drawBand();
  sprites.drawOverwrite(22, MENU_Y, confSound, 0);
  sprites.drawOverwrite(63, MENU_Y, confOn, 0);
  sprites.drawOverwrite(86, MENU_Y, confOff, 0);
  drawEgg(arduboy.audio.enabled() ? 65 : 90);
}

#endif
