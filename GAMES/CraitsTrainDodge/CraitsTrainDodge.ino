//Train Dodge
//	Version 1.1, Sep 9, 2016
//	By Jonathan Holmes (crait)
//
//	Website: http://www.crait.net/
//	Twitter: @crait
//
//Who's brave enough to play chicken with a train?
//Stand on the track as multiple trains come at you
//full-speed... The closer they get to you before
//jumping off the tracks, the more points you'll rack
//up. (You'll also lose points for jumping off of the
//track too early.) Dodge as many as you can, but
//beware! If you don't jump off in time, you'll be hit!
//
//
//
//1.1 - Sep 9, 2016
//	Switched to standard get()/put() for storing data into EEPROM
//	Removed title and instruction screen from repeating
//	Elaborated on the instuctions/controls
//	Added the option to erase game data
//1.0 - Aug 25, 2016
//	Initial release


#include "Arduboy2.h"
//#include <EEPROM.h>
Arduboy2 arduboy;

#define BLACK 0
#define WHITE 1
#define SPRITESIZE 48
#define SAVELOCATION (EEPROM_STORAGE_SPACE_START + 400)

const static unsigned char title1[] PROGMEM = {
	0x00, 0x00, 0x00, 0x00, 0x00, 0x00, 0x00, 0x00, 
	0x00, 0x00, 0x00, 0x00, 0x00, 0x00, 0x00, 0x00, 
	0x00, 0x00, 0x00, 0x00, 0x00, 0x00, 0x80, 0x80, 
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	0x0b, 0x08, 0x08, 0x04, 0x02, 0x01, 0x02, 0x03
};
const static unsigned char title2[] PROGMEM = {
	0xc0, 0xa0, 0x40, 0xa0, 0x40, 0xa0, 0xe0, 0x40, 
	0x80, 0x00, 0x18, 0x38, 0x38, 0x38, 0x38, 0x78, 
	0xf8, 0xf8, 0xf8, 0x70, 0x70, 0x60, 0x00, 0x00, 
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	0x03, 0x01, 0x01, 0x01, 0x01, 0x01, 0x00, 0x00
};
const static unsigned char title3[] PROGMEM = {
	0x00, 0x00, 0x00, 0x00, 0x00, 0x00, 0x00, 0x00, 
	0x00, 0x00, 0x00, 0x00, 0x00, 0x00, 0x00, 0x00, 
	0x00, 0x00, 0x00, 0x00, 0x00, 0x00, 0x00, 0x00, 
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	0x00, 0x00, 0x00, 0x00, 0x00, 0x00, 0x00, 0x00
};
const static unsigned char grass[] PROGMEM = {
	0xdf, 0xef, 0xc7, 0xb3, 0x5f, 0x7f, 0x5f, 0x9f, 
	0xa7, 0xd7, 0xef, 0xf7, 0xef, 0xef, 0xef, 0xe7, 
	0xd3, 0xdf, 0xdf, 0xdf, 0xef, 0xd3, 0xdf, 0xaf, 
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	0x0f, 0x0f, 0x0f, 0x0f, 0x0f, 0x0f, 0x0f, 0x0f
};
const static unsigned char abutton[] PROGMEM = {
	0x00, 0xf8, 0x84, 0x72, 0x2a, 0x72, 0x84, 0xf8, 
	0x00, 0x00, 0x04, 0xf8, 0x70, 0x20, 0x00, 0x00, 
	0x00, 0x01, 0x02, 0x05, 0x05, 0x05, 0x02, 0x01, 
	0x00, 0x00, 0x01, 0x00, 0x00, 0x00, 0x00, 0x00
};

const static unsigned char guy1white[] PROGMEM = {
	0x00, 0x00, 0x70, 0xf8, 0x38, 0x78, 0x38, 0x7c, 
	0xfe, 0x1c, 0x00, 0x00, 0x00, 0x00, 0x00, 0x00, 
	0x00, 0x00, 0x00, 0x00, 0x00, 0x00, 0x00, 0x00, 
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	0x00, 0x00, 0x00, 0x00, 0x00, 0x00, 0x00, 0x00,
};
const static unsigned char guy2white[] PROGMEM = {
	0x00, 0x00, 0x00, 0x00, 0x00, 0x00, 0x00, 0x70, 
	0xf8, 0x38, 0x78, 0x38, 0x7c, 0xfe, 0x1c, 0x00, 
	0x00, 0x00, 0x00, 0x00, 0x00, 0x00, 0x00, 0x00, 
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	0x00, 0x00, 0x00, 0x00, 0x00, 0x00, 0x00, 0x00
};

const static unsigned char guy1black[] PROGMEM = {
	0x00, 0x70, 0x88, 0x04, 0xc4, 0x84, 0xc4, 0x82, 
	0x01, 0xe2, 0x1c, 0x00, 0x00, 0x00, 0x00, 0x00, 
	0x00, 0x00, 0x00, 0x00, 0x00, 0x00, 0x00, 0x00, 
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	0x00, 0x00, 0x00, 0x00, 0x00, 0x00, 0x00, 0x00
};
const static unsigned char guy2black[] PROGMEM = {
	0x00, 0x00, 0x00, 0x80, 0x80, 0x00, 0x70, 0x88, 
	0x04, 0xc4, 0x84, 0xc4, 0x82, 0x01, 0xe2, 0x1c, 
	0x00, 0x00, 0x00, 0x00, 0x00, 0x00, 0x00, 0x00, 
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	0x00, 0x00, 0x00, 0x00, 0x00, 0x00, 0x00, 0x00
};

const static unsigned char train1white[] PROGMEM = {
	0x00, 0x00, 0x00, 0x00, 0x00, 0x00, 0x00, 0x00, 
	0x00, 0x00, 0x00, 0x00, 0x00, 0x00, 0x00, 0x00, 
	0x00, 0x00, 0x00, 0x00, 0x00, 0x00, 0x00, 0x00, 
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	0x7e, 0x3f, 0x0f, 0x8f, 0x7f, 0x37, 0x77, 0x77
};
const static unsigned char train2white[] PROGMEM = {
	0x00, 0x00, 0x00, 0x00, 0x00, 0x00, 0x00, 0x00, 
	0x00, 0x00, 0x00, 0x00, 0x00, 0x00, 0x00, 0x00, 
	0x00, 0x00, 0x00, 0x00, 0x00, 0x00, 0x00, 0x00, 
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	0x7f, 0x7f, 0x7f, 0x8f, 0x0f, 0x3f, 0x7f, 0x7f, 
};
const static unsigned char train3white[] PROGMEM = {
	
	0x00, 0x00, 0x00, 0x00, 0x00, 0x00, 0x00, 0x00, 
	0x00, 0x80, 0x88, 0xd0, 0xe0, 0x80, 0x80, 0x80, 
	0x80, 0x80, 0x80, 0x80, 0x80, 0x80, 0x40, 0x40, 
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	0x7f, 0x3f, 0x1f, 0x00, 0x00, 0x00, 0x00, 0x00, 
};
const static unsigned char train4white[] PROGMEM = {
	0x00, 0x00, 0x00, 0x00, 0x00, 0x00, 0x00, 0x00, 
	0x00, 0x00, 0x00, 0x00, 0x00, 0x00, 0x00, 0x00, 
	0x00, 0x00, 0x00, 0x00, 0x00, 0x00, 0x00, 0x00, 
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	0x77, 0x77, 0x37, 0x7f, 0x8f, 0x0f, 0x3f, 0x7f
};
const static unsigned char train5white[] PROGMEM = {
	0x00, 0x00, 0x00, 0x00, 0x00, 0x00, 0x00, 0x00, 
	0x00, 0x00, 0x00, 0x00, 0x00, 0x00, 0x00, 0x00, 
	0x00, 0x00, 0x00, 0x00, 0x00, 0x00, 0x00, 0x00, 
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	0x7f, 0x7f, 0x3f, 0x7f, 0x8f, 0x0f, 0x3f, 0x7f
};
const static unsigned char train6white[] PROGMEM = {
	0x00, 0x00, 0x00, 0x00, 0x00, 0x00, 0x00, 0x00, 
	0x00, 0x00, 0x80, 0x88, 0xd0, 0xe0, 0x80, 0x80, 
	0x80, 0x80, 0x80, 0x80, 0x80, 0x80, 0x80, 0x40, 
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	0x6f, 0x7f, 0x3f, 0x1f, 0x00, 0x00, 0x00, 0x00
};

const static unsigned char train1black[] PROGMEM = {
	0x00, 0x00, 0x00, 0x00, 0x00, 0x00, 0x00, 0x00, 
	0x00, 0x00, 0x00, 0x00, 0x00, 0x00, 0x00, 0x00, 
	0x00, 0x00, 0x00, 0x00, 0x00, 0x00, 0x00, 0x00, 
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	0x81, 0xc0, 0xf0, 0x70, 0x00, 0x08, 0x08, 0x08
};
const static unsigned char train2black[] PROGMEM = {
	0x00, 0x00, 0x00, 0x00, 0x00, 0x00, 0x00, 0x00, 
	0x00, 0x00, 0x00, 0x00, 0x00, 0x00, 0x00, 0x00, 
	0x00, 0x00, 0x00, 0x00, 0x00, 0x00, 0x00, 0x00, 
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	0x00, 0x00, 0x00, 0x70, 0xf0, 0xc0, 0x80, 0x80
};
const static unsigned char train3black[] PROGMEM = {
	0x00, 0x00, 0x00, 0x00, 0x00, 0x00, 0x00, 0x00, 
	0x00, 0x00, 0x00, 0x00, 0x00, 0x00, 0x00, 0x00, 
	0x00, 0x00, 0x00, 0x00, 0x00, 0x00, 0x00, 0x00, 
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	0x00, 0x00, 0x00, 0x00, 0x00, 0x00, 0x00, 0x00
};
const static unsigned char train4black[] PROGMEM = {
	0x00, 0x00, 0x00, 0x00, 0x00, 0x00, 0x00, 0x00, 
	0x00, 0x00, 0x00, 0x00, 0x00, 0x00, 0x00, 0x00, 
	0x00, 0x00, 0x00, 0x00, 0x00, 0x00, 0x00, 0x00, 
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	0x08, 0x08, 0x08, 0x00, 0x70, 0xf0, 0xc0, 0x80
};
const static unsigned char train5black[] PROGMEM = {
	0x00, 0x00, 0x00, 0x00, 0x00, 0x00, 0x00, 0x00, 
	0x00, 0x00, 0x00, 0x00, 0x00, 0x00, 0x00, 0x00, 
	0x00, 0x00, 0x00, 0x00, 0x00, 0x00, 0x00, 0x00, 
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	0x00, 0x00, 0x00, 0x00, 0x70, 0xf0, 0xc0, 0x80
};
const static unsigned char train6black[] PROGMEM = {
	0x00, 0x00, 0x00, 0x00, 0x00, 0x00, 0x00, 0x00, 
	0x00, 0x00, 0x00, 0x00, 0x00, 0x00, 0x00, 0x00, 
	0x00, 0x00, 0x00, 0x00, 0x00, 0x00, 0x00, 0x00, 
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	0x10, 0x00, 0x00, 0x00, 0x00, 0x00, 0x00, 0x00
};

boolean buttonfree = true;
char text[24];

int animation = 0;
int endtransition = 128;
int state = 0;
boolean isdone = false;

int level = 0;
int score = 0;
int levelscore = 0;
int stashedscore = 0;
int trainspeed = 20;
int traindistance = 0;
int highscore = 0;
boolean alive = true;
boolean ontrack = true;
int currenty = 0;
int currentx = 0;

void setup() {
	arduboy.begin();
	arduboy.setFrameRate(30);
	arduboy.display();
	srand(7/8);
	EEPROM.get(SAVELOCATION, highscore);
}

void resetgame() {
	animation = 0;
	endtransition = 128;
	level = 1;
	score = 0;
	levelscore = 0;
	stashedscore = 0;
	traindistance = 0;
	trainspeed = 20;
	alive = true;
	ontrack = true;
	traindistance = 300 + rand() % 500;
}

void loop() {
  if (!(arduboy.nextFrame())) return;
	arduboy.clear();

	switch (state) {
		case 0:	//Title
			arduboy.drawBitmap(0, 0, title1, SPRITESIZE, SPRITESIZE, WHITE);
			arduboy.drawBitmap(48, 0, title2, SPRITESIZE, SPRITESIZE, WHITE);
			arduboy.drawBitmap(96, 0, title3, SPRITESIZE, SPRITESIZE, WHITE);
			arduboy.setCursor(30, 47);
			arduboy.print("1.1 - @crait");
			arduboy.setCursor(20, 55);
			arduboy.print("Jonathan Holmes");
			if((arduboy.pressed(A_BUTTON) || arduboy.pressed(B_BUTTON)) && buttonfree) {
				state = 1;
				buttonfree = false;
			}
			break;
		case 1:	//Instructions
			arduboy.drawBitmap(110, 51, abutton, 16, 16, WHITE);
			arduboy.setCursor(0, 0);
			arduboy.print(F("     Instructions\n\nAvoid the train! The\ncloser it gets to you,\nthe more points you\nwill rack up!"));
			if(arduboy.pressed(A_BUTTON) && buttonfree) {
				state = 15;
				buttonfree = false;
				resetgame();
			}
			break;
		case 15:	//Controls
			arduboy.drawBitmap(110, 51, abutton, 16, 16, WHITE);
			arduboy.setCursor(0, 0);
			arduboy.print(F("       Controls\n\n     A: Jump off\nUp + B: Delete data"));
			if(arduboy.pressed(B_BUTTON) && arduboy.pressed(UP_BUTTON) && buttonfree) {
				state = 16;
				buttonfree = false;
				highscore = 0;
				EEPROM.put(SAVELOCATION, highscore);
        EEPROM.commit();
			}
			if(arduboy.pressed(A_BUTTON) && buttonfree) {
				state = 2;
				buttonfree = false;
				resetgame();
			}
			break;
		case 16:	//Erased
			arduboy.drawBitmap(110, 51, abutton, 16, 16, WHITE);
			arduboy.setCursor(0, 0);
			arduboy.print(F("       Complete\n\nAll high score data\nwas erased..."));
			if(arduboy.pressed(A_BUTTON) && buttonfree) {
				state = 0;
				buttonfree = false;
				resetgame();
			}
			break;
		case 2: //Game
			isdone = false;
			traindistance -= trainspeed;
			if(arduboy.pressed(A_BUTTON) && buttonfree && ontrack && alive) {
				buttonfree = false;
				ontrack = false;
				if(traindistance > 128) {
					score -= 10;
				}
			}

			for(currentx = 0; currentx < 128; currentx += 1) {
				for(currenty = 0; currenty < 38; currenty += 1) {
					arduboy.drawPixel(currentx, currenty, WHITE);
				}
			}


			if(traindistance < 128 && traindistance > 7 && alive && ontrack) {
				score += trainspeed;
			}

			if(traindistance <= 7 && ontrack) {
				alive = false;
			}

			if(alive && !ontrack) {
				animation += 3;
				if(score >= 100) {
					score += 25;
				}
				if(score != 0) {
					stashedscore += score;
					levelscore = score;
					score = 0;
				}
				if(arduboy.pressed(A_BUTTON) && buttonfree && endtransition <= 0) {
					buttonfree = false;
					level += 1;
					traindistance = 350 + rand() % 300;
					if(level < 20) {
						trainspeed = 14 + (level - 4) + rand() % 14;
					} else {
						trainspeed = 30 + rand() % 20;
					}
					ontrack = true;
					state = 2;
					animation = 0;
					endtransition = 128;
				}
				isdone = true;
			}

			if(!alive) {
				if (arduboy.pressed(A_BUTTON) && buttonfree && endtransition <= 0) {
					buttonfree = false;
					state = 3;
					animation = 0;
					if(highscore < stashedscore && stashedscore > 0) {
						highscore = stashedscore;
						EEPROM.put(SAVELOCATION, highscore);
            EEPROM.commit();
					}
				}
				isdone = true;
			}

			arduboy.drawBitmap(0, 38, grass, SPRITESIZE, SPRITESIZE + 20, WHITE);
			arduboy.drawBitmap(48, 38, grass, SPRITESIZE, SPRITESIZE + 20, WHITE);
			arduboy.drawBitmap(96, 38, grass, SPRITESIZE, SPRITESIZE + 20, WHITE);

			arduboy.drawBitmap(traindistance, 1, train1white, SPRITESIZE, SPRITESIZE, BLACK);
			arduboy.drawBitmap(traindistance, 1, train1black, SPRITESIZE, SPRITESIZE, WHITE);

			arduboy.drawBitmap(48 + traindistance, 1, train2white, SPRITESIZE, SPRITESIZE, BLACK);
			arduboy.drawBitmap(48 + traindistance, 1, train2black, SPRITESIZE, SPRITESIZE, WHITE);
			
			arduboy.drawBitmap(96 + traindistance, 1, train3white, SPRITESIZE, SPRITESIZE, BLACK);
			arduboy.drawBitmap(96 + traindistance, 1, train3black, SPRITESIZE, SPRITESIZE, WHITE);

			arduboy.drawBitmap(143 + traindistance, 1, train4white, SPRITESIZE, SPRITESIZE, BLACK);
			arduboy.drawBitmap(143 + traindistance, 1, train4black, SPRITESIZE, SPRITESIZE, WHITE);

			arduboy.drawBitmap(143 + 48 + traindistance, 1, train5white, SPRITESIZE, SPRITESIZE, BLACK);
			arduboy.drawBitmap(143 + 48 + traindistance, 1, train5black, SPRITESIZE, SPRITESIZE, WHITE);

			arduboy.drawBitmap(143 + 96 + traindistance, 1, train6white, SPRITESIZE, SPRITESIZE, BLACK);
			arduboy.drawBitmap(143 + 96 + traindistance, 1, train6black, SPRITESIZE, SPRITESIZE, WHITE);
			
			arduboy.drawBitmap(143 +143 + traindistance, 1, train4white, SPRITESIZE, SPRITESIZE, BLACK);
			arduboy.drawBitmap(143 +143 + traindistance, 1, train4black, SPRITESIZE, SPRITESIZE, WHITE);

			arduboy.drawBitmap(143 +143 + 48 + traindistance, 1, train5white, SPRITESIZE, SPRITESIZE, BLACK);
			arduboy.drawBitmap(143 +143 + 48 + traindistance, 1, train5black, SPRITESIZE, SPRITESIZE, WHITE);

			arduboy.drawBitmap(143 +143 + 96 + traindistance, 1, train6white, SPRITESIZE, SPRITESIZE, BLACK);
			arduboy.drawBitmap(143 +143 + 96 + traindistance, 1, train6black, SPRITESIZE, SPRITESIZE, WHITE);

			if(alive) {
				if(animation == 0) {
					arduboy.drawBitmap(5, 28, guy1white, 26, 26, BLACK);
					arduboy.drawBitmap(5, 28, guy1black, 26, 26, WHITE);
				} else {
					if(animation < 15) {
						arduboy.drawBitmap(7, 27 + animation, guy2white, 26, 26, BLACK);
						arduboy.drawBitmap(7, 27 + animation, guy2black, 26, 26, WHITE);

					} else {
						arduboy.drawBitmap(9, 43, guy1white, 26, 26, BLACK);
						arduboy.drawBitmap(9, 43, guy1black, 26, 26, WHITE);
					}
				}
			} else {

			}

			if(isdone) {
				if(endtransition > 0 && traindistance < -350) {
					endtransition -= 8;
				}
				for(currenty = 0; currenty < 64; currenty += 1) {
					for (currentx = 0 + endtransition + 0 + currenty; currentx < 64 + endtransition + currenty; currentx += 1) {
						arduboy.drawPixel(currentx, currenty, 0);
					}
				}
				if (alive) {
					arduboy.setCursor(endtransition + 44, 20);
					arduboy.print("SCORE");
					arduboy.setCursor(endtransition + 55, 30);
					if(levelscore > 0) {
						if(levelscore > 100) {
							sprintf(text, "+%d!", levelscore);
							arduboy.print(text);
						} else {
							sprintf(text, "+%d", levelscore);
							arduboy.print(text);
						}
					} else {
						arduboy.print(levelscore);
					}
					arduboy.setCursor(endtransition + 64, 40);
					arduboy.print(stashedscore);
				} else {
					arduboy.setCursor(endtransition + 45, 20);
					arduboy.print("YOU");
					arduboy.setCursor(endtransition + 55, 30);
					arduboy.print("DIED!");
					arduboy.setCursor(endtransition + 64, 40);
					arduboy.print(stashedscore);
				}
				arduboy.drawBitmap(endtransition + 96, 51, abutton, 16, 16, WHITE);
			}

			break;
		case 3:	//Game Over screen
			

			if(animation < 64) {
				animation += 4;
				for(currenty = 0; currenty < 38; currenty += 1) {
					for(currentx = 0; currentx < 128; currentx += 1) {
						arduboy.drawPixel(currentx, currenty, WHITE);
					}
				}
				arduboy.drawBitmap(0, 38, grass, SPRITESIZE, SPRITESIZE + 20, WHITE);
				arduboy.drawBitmap(48, 38, grass, SPRITESIZE, SPRITESIZE + 20, WHITE);
				arduboy.drawBitmap(96, 38, grass, SPRITESIZE, SPRITESIZE + 20, WHITE);
			}

			for(currenty = 0; currenty < 64; currenty += 1) {
				for(currentx = 0 + currenty; currentx < 64 + currenty; currentx += 1) {
					arduboy.drawPixel(currentx, currenty, BLACK);
				}
			}
			
			for(currenty = 64 - animation; currenty < 64; currenty += 1) {
				for(currentx = 0; currentx < 128; currentx += 1) {
					arduboy.drawPixel(currentx, currenty, BLACK);
				}
			}
			

			arduboy.setCursor(41, 64 - animation + 5);
			arduboy.print("GAME OVER");
			arduboy.setCursor(41, 64 - animation + 15);
			sprintf(text, "SCORE: %d", stashedscore);
			arduboy.print(text);
			arduboy.setCursor(25, 64 - animation + 40);
			sprintf(text, "HIGH SCORE: %d", highscore);
			arduboy.print(text);
			
			if(arduboy.pressed(A_BUTTON) && buttonfree) {
				state = 2;
				buttonfree = false;
				resetgame();
			}
			arduboy.drawBitmap(110, 51, abutton, 16, 16, WHITE);
			
			break;
			
	}
	
	
	if(buttonfree == false && !arduboy.pressed(A_BUTTON)) {
		buttonfree = true;
	}
	
	arduboy.display();
}
