//  KPA Quest
//  Version 1.0, April 6, 2023
//  Created for JXM
//  Website: https://tunetojxm.com/
//  Code & Pixel Art By Jonathan Holmes (crait)
//  Website: http://www.crait.net/
//  E-Mail:  crait.is@gmail.com
//  Twitter: @crait
//
//  Navigate through 10 levels that range from easy to incredibly difficult in this fun retro puzzler.
//  Push the letters 'K', 'P', and 'A' to their destinations to advance to the next level, but avoid
//  pushing them into corners or against the walls. If you are getting stuck, you can even push multiple
//  blocks at the smame time!
//
//  KPA Quest is a puzzle game that I designed and programmed for JXM, a full-service digital agency
//  located in Massachusetts, for a marketing push. The goal of the game's design was to feature the
//  letters 'KPA' in an approachable and easy-to-understand puzzle game. I designed this game to be
//  similar to Sokoban, so most players can instantly be familiar with it from the start, but there are
//  some fun twists: You can actually push multiple blocks at the same time. Plus, each 'block' is marked
//  with a specific letter that corresponds to a specific destination. These small changes really worked
//  to make this game quite different than Sokoban, allowing me to design levels that you can only find
//  in this game.
//
// Release History
//  1.0 - April 6, 2023

#include <Arduboy2.h>
Arduboy2 arduboy;
#include <Arduboy2Beep.h>
BeepPin2 beep;

#define SOUND_TITLE_START		100
#define SOUND_TITLE_END 		100
#define SOUND_SLIDE      		100
#define SOUND_GOAL      		515
#define SOUND_WIN           515

#define SOUND_MENU_NEXT			425
#define SOUND_MENU_SCROLL		375
#define SOUND_MENU_BACK			215
#define SOUND_MENU_RESTART  200
#define SOUND_MENU_CONTINUE SOUND_MENU_NEXT

#define SOUND_TINY				3
#define SOUND_SHORT				6
#define SOUND_MED				  12
#define SOUND_LONG				20



signed char pause_transition = 0;
unsigned char floating = 0;
unsigned char floating_direction = 1;
#define CURVE_COUNT        15
unsigned char curve[CURVE_COUNT] = {
  0, 0, 1, 1, 2, 4, 7, 11, 14, 16, 17, 18, 18, 19, 19
};

/*
#define HEAD_WIDTH    54
#define HEAD_HEIGHT   40
unsigned char mascot_head[] PROGMEM = {
  0x00, 0x00, 0x00, 0x00, 0x00, 0x00, 0x80, 0x80, 
  0xc0, 0xc0, 0xe0, 0xe0, 0x70, 0x70, 0x38, 0x38, 
  0x1c, 0x9c, 0x8c, 0xcc, 0xcc, 0xce, 0xce, 0xc6, 
  0xe6, 0xe6, 0xe6, 0xe6, 0xe6, 0xe6, 0xe6, 0xe7, 
  0xe7, 0xf3, 0xf3, 0xf3, 0xf3, 0xf3, 0xf3, 0xf3, 
  0xf3, 0xf3, 0xf3, 0xf3, 0xf3, 0xf3, 0xf3, 0xd7, 
  0x27, 0xc7, 0x0f, 0x1e, 0xfc, 0xf8, 0xe0, 0xf0, 
  0x78, 0x3c, 0x0e, 0x0f, 0x07, 0x03, 0xfd, 0xff, 
  0x0f, 0x00, 0xe0, 0xfe, 0xfe, 0xff, 0xff, 0xff, 
  0xff, 0xff, 0xff, 0xff, 0xff, 0xff, 0xff, 0xff, 
  0xff, 0xff, 0xff, 0xff, 0xff, 0xff, 0xff, 0xff, 
  0xff, 0xff, 0xff, 0xff, 0xff, 0xff, 0xff, 0xff, 
  0xff, 0xff, 0xff, 0x1f, 0xc7, 0x71, 0x1c, 0x83, 
  0xe0, 0xfc, 0x3f, 0x0f, 0x03, 0x1f, 0x7f, 0xf8, 
  0xe0, 0x80, 0x00, 0x00, 0x03, 0x0f, 0x3f, 0xfc, 
  0xf0, 0xc3, 0x0f, 0x3f, 0xff, 0xff, 0xff, 0xff, 
  0xff, 0x7f, 0x7f, 0xff, 0xff, 0xff, 0xff, 0xff, 
  0x3f, 0xff, 0xff, 0x3f, 0xff, 0xff, 0xff, 0xff, 
  0xff, 0x9f, 0x0f, 0x0f, 0x9f, 0xff, 0xff, 0xff, 
  0xff, 0x00, 0xff, 0x00, 0xfe, 0xff, 0x07, 0x01, 
  0x00, 0x00, 0x00, 0x00, 0x00, 0x01, 0x07, 0x1f, 
  0xfe, 0xf8, 0xc0, 0x80, 0x00, 0x00, 0x03, 0x0f, 
  0x3f, 0xfc, 0xf0, 0xc3, 0x0f, 0x3f, 0x7c, 0x78, 
  0x78, 0x7c, 0x7f, 0x7f, 0x3f, 0x3f, 0x3e, 0x3d, 
  0x3d, 0x3e, 0x3f, 0x3f, 0x1f, 0x9f, 0x9f, 0x8f, 
  0xcf, 0xcf, 0xcf, 0xe7, 0xe7, 0x67, 0x62, 0x73, 
  0x71, 0x38, 0x3f, 0x1f, 0x00, 0x00, 0x00, 0x00, 
  0x00, 0x00, 0x00, 0x00, 0x00, 0x00, 0x00, 0x01, 
  0x07, 0x07, 0x06, 0x06, 0x06, 0x06, 0x06, 0x06, 
  0x07, 0x07, 0x07, 0x06, 0x06, 0x06, 0x06, 0x06, 
  0x06, 0x06, 0x07, 0x07, 0x03, 0x03, 0x03, 0x03, 
  0x03, 0x03, 0x03, 0x03, 0x03, 0x01, 0x01, 0x01, 
  0x00, 0x00, 0x00, 0x00, 0x00, 0x00, 0x00, 0x00, 
  0x00, 0x00, 0x00, 0x00, 0x00, 0x00, 
};

#define BODY_WIDTH    49
#define BODY_HEIGHT   32
unsigned char mascot_body[] PROGMEM = {
  0x00, 0x00, 0x00, 0x00, 0x00, 0x00, 0x00, 0x00, 
  0x00, 0x00, 0x00, 0x00, 0x00, 0x00, 0x00, 0x00, 
  0x00, 0xc0, 0xf0, 0xf8, 0x7c, 0x2c, 0xce, 0x8e, 
  0x7a, 0x0a, 0x6a, 0x6b, 0x09, 0xc9, 0xc9, 0x09, 
  0xc9, 0xc9, 0x09, 0x09, 0x09, 0x09, 0xc9, 0xe9, 
  0xa5, 0xe5, 0xa5, 0xe5, 0xee, 0xde, 0x3c, 0xf8, 
  0xe0, 0x00, 0x00, 0x00, 0x00, 0x00, 0x00, 0x00, 
  0x00, 0x00, 0x00, 0x00, 0x00, 0x00, 0x00, 0x00, 
  0xc0, 0x7f, 0x5f, 0xd7, 0x75, 0x7d, 0xe6, 0xe7, 
  0xc1, 0xc0, 0xc0, 0x83, 0x87, 0x86, 0x86, 0x06, 
  0x06, 0x06, 0x00, 0x00, 0x00, 0x00, 0x00, 0x3f, 
  0x7f, 0x6a, 0x7f, 0x6a, 0x7f, 0x6a, 0x3f, 0xc0, 
  0xff, 0xff, 0x18, 0x26, 0x7d, 0x53, 0x62, 0x3c, 
  0x24, 0x3c, 0x24, 0x3c, 0x24, 0x3c, 0x26, 0x3e, 
  0x13, 0x0d, 0x05, 0x03, 0x01, 0x00, 0x00, 0x00, 
  0xf0, 0x8f, 0x15, 0x2d, 0x39, 0xa9, 0xbb, 0x6b, 
  0x1b, 0x0f, 0x07, 0x07, 0x07, 0x06, 0x06, 0x06, 
  0x06, 0x06, 0x06, 0x06, 0x06, 0x06, 0x07, 0x07, 
  0x03, 0x03, 0x01, 0x00, 0x00, 0x00, 0x00, 0x00, 
  0x00, 0x00, 0x00, 0x00, 0x00, 0x00, 0x00, 0x00, 
  0x00, 0x00, 0x00, 0x00, 0x00, 0x00, 0x00, 0x00, 
  0x00, 0x06, 0x07, 0x06, 0x03, 0x02, 0x01, 0x00, 
  0x00, 0x00, 0x00, 0x00, 0x00, 0x00, 0x00, 0x00, 
  0x00, 0x00, 0x00, 0x00, 0x00, 0x00, 0x00, 0x00, 
  0x00, 0x00, 0x00, 0x00, 
};
*/

unsigned char title_back[] PROGMEM = {
  0x00, 0x00, 0x00, 0x00, 0x00, 0x00, 0x00, 0x00,
  0x80, 0xe0, 0xf8, 0xfe, 0xff, 0xff, 0xff, 0xff,
  0xff, 0xff, 0xff, 0xff, 0xfe, 0xf8, 0xfc, 0xfe,
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  0x00, 0x00, 0x00, 0x00, 0x00, 0x00, 0x00, 0x00,
};

unsigned char title_outline[] PROGMEM = {
  0x00, 0x00, 0x00, 0x00, 0x00, 0x00, 0x00, 0x00,
  0x80, 0x60, 0x18, 0x06, 0x01, 0x01, 0x01, 0x01,
  0x01, 0x01, 0xc1, 0x79, 0x26, 0x18, 0x04, 0x02,
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  0x00, 0x00, 0x00, 0x00, 0x00, 0x00, 0x00, 0x00,
};

uint8_t PROGMEM bitmap_player[] = {
  0x86, 0xcf, 0xff, 0xff, 0xff, 0xff, 0xff, 0xcf,
  0x86, 0x00, 0x00, 0x00, 0x00, 0x00, 0x00, 0x00,
  0x01, 0x03, 0x03, 0x03, 0x03, 0x03, 0x03, 0x03,
  0x01, 0x00, 0x00, 0x00, 0x00, 0x00, 0x00, 0x00,
};

/*
uint8_t PROGMEM bitmap_player[] = {
    0x06, 0x0f, 0x9f, 0xff, 0xff, 0xff, 0xff, 0xff,
    0xff, 0x9f, 0x0f, 0x06, 0x00, 0x00, 0x00, 0x00,
    0x06, 0x0f, 0x0f, 0x0f, 0x0f, 0x0f, 0x0f, 0x0f,
    0x0f, 0x0f, 0x0f, 0x06, 0x00, 0x00, 0x00, 0x00,
};
*/

uint8_t PROGMEM bitmap_K[] = {
    0x00, 0xfe, 0x02, 0x8e, 0x88, 0x24, 0x52, 0x8a,
    0x06, 0x00, 0x00, 0x00, 0x00, 0x00, 0x00, 0x00,
    0xf8, 0x04, 0xfe, 0x02, 0x8e, 0x88, 0x24, 0x52,
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    0x02, 0x03, 0x00, 0x00, 0x00, 0x00, 0x00, 0x00,
};

uint8_t PROGMEM bitmap_P[] = {
    0x00, 0xfe, 0x02, 0xba, 0xaa, 0xaa, 0xba, 0x82,
    0x7c, 0x00, 0x00, 0x00, 0x00, 0x00, 0x00, 0x00,
    0xf8, 0x04, 0xfe, 0x02, 0xba, 0xaa, 0xaa, 0x92,
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    0x00, 0x00, 0x00, 0x00, 0x00, 0x00, 0x00, 0x00,
};

uint8_t PROGMEM bitmap_A[] = {
    0x00, 0xf8, 0x04, 0xb2, 0xaa, 0xaa, 0xb2, 0x04,
    0xf8, 0x00, 0x00, 0x00, 0x00, 0x00, 0x00, 0x00,
    0xf8, 0x04, 0xfa, 0x06, 0xb2, 0xaa, 0xaa, 0x12,
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    0x01, 0x00, 0x00, 0x00, 0x00, 0x00, 0x00, 0x00,
};

uint8_t PROGMEM bitmap_small_K[] = {
  0x7f, 0x08, 0x1c, 0x36, 0x63, 0x41, 0x00, 0x00,
};

uint8_t PROGMEM bitmap_small_P[] = {
  0x7f, 0x11, 0x11, 0x11, 0x11, 0x1f, 0x00, 0x00
};

uint8_t PROGMEM bitmap_small_A[] = {
  0x7e, 0x13, 0x11, 0x11, 0x13, 0x7e, 0x00, 0x00,
};

unsigned char me[] PROGMEM = {
	0x45, 0x8a, 0x15, 0xaa, 0x15, 0xaa, 0xd5, 0x6a, 0x34, 0x28, 0x21, 0x32, 0x1d, 0x0a, 0x0c, 0x06, 0x03, 0x02, 0x07, 0x02, 0x23, 0x41, 0xa0, 0x41, 0x80, 0x40, 0x81, 0x40, 0x20, 0x80, 0x40, 0x80,
	0x40, 0x20, 0x08, 0xc7, 0x7d, 0xa2, 0x55, 0xa2, 0x51, 0xa8, 0x15, 0x88, 0x44, 0xa2, 0x51, 0xaa, 0x54, 0xa8, 0x51, 0x82, 0x05, 0xff, 0x00, 0x00, 0x41, 0x80, 0x80, 0x00, 0x80, 0xe0, 0xf0, 0xf0,
	0xf0, 0xf0, 0xe0, 0x60, 0x60, 0x60, 0x68, 0xed, 0xe4, 0xe3, 0xe0, 0xe0, 0x61, 0x72, 0xe1, 0x02, 0xe1, 0x32, 0x1a, 0xaf, 0x11, 0x88, 0x54, 0x8a, 0x45, 0x2a, 0x05, 0x92, 0x45, 0xa2, 0x41, 0xa0,
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	0xdb, 0x57, 0xa7, 0xcf, 0xb7, 0x8b, 0xfa, 0xf6, 0x76, 0xa6, 0xca, 0x76, 0xea, 0x9c, 0x5f, 0xdf, 0xc0, 0xfe, 0xfe, 0xff, 0xff, 0xff, 0xff, 0x0f, 0xb6, 0xb9, 0xfb, 0xf8, 0xf3, 0xf7, 0xff, 0xf8
};

unsigned char jonathan[] PROGMEM = {
	0x20, 0x40, 0x41, 0x3f, 0x01, 0x00, 0x38, 0x44,
	0x44, 0x44, 0x38, 0x00, 0x7c, 0x08, 0x04, 0x04,
	0x78, 0x00, 0x20, 0x54, 0x54, 0x78, 0x40, 0x00,
	0x04, 0x04, 0x3f, 0x44, 0x24, 0x00, 0x7f, 0x08,
	0x04, 0x04, 0x78, 0x00, 0x20, 0x54, 0x54, 0x78,
	0x40, 0x00, 0x7c, 0x08, 0x04, 0x04, 0x78
};

unsigned char holmes[] PROGMEM = {
	0x7f, 0x08, 0x08, 0x08, 0x7f, 0x00, 0x38, 0x44,
	0x44, 0x44, 0x38, 0x00, 0x00, 0x41, 0x7f, 0x40,
	0x00, 0x00, 0x7c, 0x04, 0x78, 0x04, 0x78, 0x00,
	0x38, 0x54, 0x54, 0x54, 0x18, 0x00, 0x48, 0x54,
	0x54, 0x54, 0x24
};

unsigned char at[] PROGMEM = {
	0x3e, 0x41, 0x5d, 0x59, 0x4e
};

unsigned char crait[] PROGMEM = {
	0x38, 0x44, 0x44, 0x44, 0x28, 0x00, 0x7c, 0x08,
	0x04, 0x04, 0x08, 0x00, 0x20, 0x54, 0x54, 0x78,
	0x40, 0x00, 0x00, 0x44, 0x7d, 0x40, 0x00, 0x00,
	0x04, 0x04, 0x3f, 0x44, 0x24
};

unsigned char net[] PROGMEM = {
	0x60, 0x60, 0x00, 0x00, 0x7c, 0x08, 0x04, 0x04,
	0x78, 0x00, 0x38, 0x54, 0x54, 0x54, 0x18, 0x00,
	0x04, 0x04, 0x3f, 0x44, 0x24
};

/*
uint8_t PROGMEM jxm[] = {
  0x00, 0x00, 0x00, 0x00, 0x00, 0x00, 0x00, 0x00,
  0xfe, 0xff, 0xff, 0xff, 0xff, 0xff, 0xff, 0xff,
  0xff, 0xff, 0xff, 0xfe, 0x00, 0x1e, 0x3f, 0x7f,
  0xff, 0xff, 0xff, 0xff, 0xff, 0xff, 0xff, 0xff,
  0xff, 0xff, 0xff, 0xff, 0xff, 0x7f, 0x3f, 0x1e,
  0x00, 0xfe, 0xff, 0xff, 0xff, 0xfe, 0xfc, 0xf8,
  0xf0, 0xe0, 0xc0, 0xe0, 0xf0, 0xf8, 0xfc, 0xfe,
  0xff, 0xff, 0xff, 0xfe, 0x7e, 0xff, 0xff, 0xff,
  0xff, 0xff, 0xff, 0xff, 0xff, 0xff, 0xff, 0xff,
  0xff, 0xff, 0xff, 0xff, 0xff, 0xff, 0xff, 0x3f,
  0x00, 0x80, 0xc0, 0xe0, 0xf0, 0xf9, 0xff, 0xff,
  0xff, 0xff, 0xff, 0xff, 0xff, 0xff, 0xff, 0xf9,
  0xf0, 0xe0, 0xc0, 0x80, 0x00, 0xff, 0xff, 0xff,
  0xff, 0xff, 0xff, 0xff, 0xff, 0xff, 0xff, 0xff,
  0xff, 0xff, 0xff, 0xff, 0xff, 0xff, 0xff, 0xff,
  0x00, 0x00, 0x01, 0x03, 0x07, 0x07, 0x07, 0x07,
  0x07, 0x07, 0x07, 0x07, 0x07, 0x07, 0x07, 0x03,
  0x03, 0x01, 0x00, 0x00, 0x00, 0x03, 0x07, 0x07,
  0x07, 0x07, 0x07, 0x07, 0x07, 0x07, 0x07, 0x07,
  0x07, 0x07, 0x07, 0x07, 0x07, 0x07, 0x07, 0x03,
  0x00, 0x03, 0x07, 0x07, 0x07, 0x07, 0x07, 0x07,
  0x07, 0x07, 0x07, 0x07, 0x07, 0x07, 0x07, 0x07,
  0x07, 0x07, 0x07, 0x03,
};
*/

unsigned char by_jxm[] PROGMEM = {
	0xf8, 0xa8, 0xb8, 0xe0, 0x00, 0x38, 0xe0, 0x38, 
	0x00, 0xe0, 0xf0, 0xf0, 0xf0, 0xfe, 0xff, 0xff, 
	0xff, 0xff, 0xfe, 0x00, 0x86, 0xcf, 0xff, 0xff, 
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	0x03, 0x03, 0x03, 0x03, 0x03, 0x01, 
};

uint8_t PROGMEM menu_play[] = {
  0xff, 0xff, 0x23, 0x3f, 0x1e, 0x00, 0xff, 0xff,
  0x00, 0x00, 0x00, 0xfe, 0xff, 0x33, 0xff, 0xfe,
  0x00, 0x0f, 0x1f, 0xf0, 0xf0, 0x1f, 0x0f, 0x03,
  0x03, 0x00, 0x00, 0x00, 0x00, 0x03, 0x03, 0x03,
  0x03, 0x00, 0x03, 0x03, 0x00, 0x03, 0x03, 0x00,
  0x00, 0x00, 0x03, 0x03, 0x00, 0x00,
};

uint8_t PROGMEM menu_credits[] = {
  0xfe, 0xff, 0x03, 0xcf, 0xce, 0x00, 0xff, 0xff,
  0x73, 0xdf, 0xde, 0x00, 0xff, 0xff, 0x13, 0x03,
  0x00, 0xff, 0xff, 0x03, 0x03, 0xff, 0xfe, 0x00,
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  0x03, 0x03, 0x03, 0x01,
};

uint8_t PROGMEM menu_continue[] = {
  0xfe, 0xff, 0x03, 0xcf, 0xce, 0x00, 0xfe, 0xff,
  0x03, 0xff, 0xfe, 0x00, 0xff, 0xff, 0x1e, 0x78,
  0xe0, 0xff, 0xff, 0x00, 0x03, 0x03, 0xff, 0xff,
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  0x03, 0x03, 0x03, 0x03,
};

uint8_t PROGMEM menu_menu[] = {
  0xff, 0xff, 0x1e, 0x7c, 0x1e, 0xff, 0xff, 0x00,
  0xff, 0xff, 0x33, 0x03, 0x00, 0xff, 0xff, 0x1e,
  0x78, 0xe0, 0xff, 0xff, 0x00, 0xff, 0xff, 0x00,
  0xff, 0xff, 0x03, 0x03, 0x00, 0x00, 0x00, 0x03,
  0x03, 0x00, 0x03, 0x03, 0x03, 0x03, 0x00, 0x03,
  0x03, 0x00, 0x00, 0x01, 0x03, 0x03, 0x00, 0x00,
  0x03, 0x03, 0x03, 0x00,
};

uint8_t PROGMEM menu_restart[] = {
  0xff, 0xff, 0x73, 0xdf, 0xde, 0x00, 0xff, 0xff,
  0x33, 0x03, 0x00, 0x9e, 0xbf, 0x33, 0x33, 0xf7,
  0xe6, 0x00, 0x03, 0x03, 0xff, 0xff, 0x03, 0x03,
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  0x00, 0x00, 0x03, 0x03, 0x00, 0x00,
};

signed char menu_item = 0;
signed char transition = -32;

enum GameState {
  Credits1,
  //Credits2,
  Title,
  Gameplay
};
GameState state = GameState::Credits1;

struct Star {
  signed char life = 0;
  signed short x = 0;
  signed short y = 0;
  signed char x_velocity = 0;
  signed char y_velocity = 0;
};

#define STARS_COUNT   35
Star stars[STARS_COUNT];

struct MenuItem {
  uint8_t* image;
  unsigned char width;
  void (*f)();
};

void sound(int pitch, unsigned char duration) {
  if(arduboy.audio.enabled()) {
		beep.tone(beep.freq(pitch), duration);
	}
}

MenuItem main_menu[] = {
  {
    menu_play, 23, []() {
      transition = 1;
      sound(SOUND_MENU_NEXT, SOUND_LONG);
    }
  },
  {
    menu_credits, 42, []() {
      state = GameState::Credits1;
      sound(SOUND_MENU_NEXT, SOUND_SHORT);
    }
  }
};

void create_level();
void reset_title();
bool pause_menu = false;
MenuItem restart_menu[] = {
  {
    menu_continue, 50, []() {
      pause_menu = false;
      sound(SOUND_MENU_BACK, SOUND_SHORT);
    }
  },
  {
    menu_restart, 43, []() {
      create_level();
      sound(SOUND_MENU_RESTART, SOUND_LONG);
    }
  },
  {
    menu_menu, 26, []() {
      state = GameState::Title;
      reset_title();
      sound(SOUND_MENU_NEXT, SOUND_SHORT);
    }
  }
};

signed char menu_offset = -1;
bool handle_menu(MenuItem menu[], unsigned char item_count) {
  if (arduboy.justReleased(UP_BUTTON)) {
    sound(SOUND_MENU_SCROLL, SOUND_SHORT);
    menu_offset = 0;
    menu_item--;
    if(menu_item < 0) {
      menu_item = item_count - 1;
    }
    return true;
  } else if(arduboy.justReleased(DOWN_BUTTON)) {
    sound(SOUND_MENU_SCROLL, SOUND_SHORT);
    menu_offset = 0;
    menu_item++;
    if(menu_item >= item_count) {
      menu_item = 0;
    }
    return true;
  } else if(arduboy.justReleased(A_BUTTON)) {
    menu[menu_item].f();
    return true;
  }
  
  return false;
}
void draw_menu(signed char x, signed char y, MenuItem menu[], unsigned char item_count) {
  arduboy.fillRect(x, y + 12 * menu_item, (menu_offset >= 1 ? menu_offset - 1 : 0), 11, WHITE);

  for(unsigned char i = 0; i < item_count; i++) {
    arduboy.drawBitmap(x + (menu_item == i ? menu_offset : 0), y + 12 * i, menu[i].image, menu[i].width, 16, WHITE);
  }

  //if(menu_offset < 8) {
  //  menu_offset++;
  //}
}

#define TILE_SIZE         10
#define GROUND_PADDING    1
#define MAP_OFFSET_X      4
#define MAP_OFFSET_Y      2
#define MOVE_SPEED        2

#define TILE_GROUND       0
#define TILE_WALL         1
#define TILE_START        2
#define TILE_1_START      3
#define TILE_2_START      4
#define TILE_3_START      5
#define TILE_1_END        6
#define TILE_2_END        7
#define TILE_3_END        8

#define LEVEL_WIDTH       12
#define LEVEL_HEIGHT      6

unsigned char endings[3] = {
  TILE_1_END, TILE_2_END, TILE_3_END
};

#define LEVEL_COUNT       10
unsigned char levels[LEVEL_COUNT][LEVEL_HEIGHT][LEVEL_WIDTH] = {
  {
    TILE_WALL,    TILE_WALL,    TILE_WALL,      TILE_WALL,      TILE_WALL,      TILE_WALL,      TILE_WALL,      TILE_WALL,      TILE_WALL,      TILE_WALL,      TILE_WALL,    TILE_WALL,
    TILE_WALL,    TILE_WALL,    TILE_GROUND,    TILE_GROUND,    TILE_GROUND,    TILE_WALL,      TILE_GROUND,    TILE_GROUND,    TILE_WALL,      TILE_WALL,      TILE_WALL,    TILE_WALL,
    TILE_WALL,    TILE_WALL,    TILE_GROUND,    TILE_START,     TILE_GROUND,    TILE_GROUND,    TILE_GROUND,    TILE_1_START,   TILE_WALL,      TILE_WALL,      TILE_WALL,    TILE_WALL,
    TILE_WALL,    TILE_WALL,    TILE_GROUND,    TILE_GROUND,    TILE_GROUND,    TILE_WALL,      TILE_WALL,      TILE_GROUND,    TILE_WALL,      TILE_WALL,      TILE_WALL,    TILE_WALL,
    TILE_WALL,    TILE_WALL,    TILE_WALL,      TILE_WALL,      TILE_WALL,      TILE_WALL,      TILE_WALL,      TILE_1_END,     TILE_WALL,      TILE_WALL,      TILE_WALL,    TILE_WALL,
    TILE_WALL,    TILE_WALL,    TILE_WALL,      TILE_WALL,      TILE_WALL,      TILE_WALL,      TILE_WALL,      TILE_WALL,      TILE_WALL,      TILE_WALL,      TILE_WALL,    TILE_WALL,
  },
  {
    TILE_WALL,    TILE_WALL,    TILE_WALL,      TILE_WALL,      TILE_WALL,      TILE_WALL,      TILE_WALL,      TILE_WALL,      TILE_WALL,      TILE_WALL,      TILE_WALL,    TILE_WALL,
    TILE_WALL,    TILE_WALL,    TILE_WALL,      TILE_WALL,      TILE_WALL,      TILE_WALL,      TILE_WALL,      TILE_WALL,      TILE_WALL,      TILE_WALL,      TILE_WALL,    TILE_WALL,
    TILE_GROUND,  TILE_GROUND,  TILE_GROUND,    TILE_WALL,      TILE_GROUND,    TILE_GROUND,    TILE_WALL,      TILE_GROUND,    TILE_GROUND,    TILE_WALL,      TILE_GROUND,  TILE_GROUND,
    TILE_GROUND,  TILE_START,   TILE_GROUND,    TILE_1_START,   TILE_2_START,   TILE_3_START,   TILE_GROUND,    TILE_GROUND,    TILE_GROUND,    TILE_GROUND,    TILE_GROUND,  TILE_GROUND,
    TILE_GROUND,  TILE_GROUND,  TILE_GROUND,    TILE_WALL,      TILE_WALL,      TILE_GROUND,    TILE_WALL,      TILE_WALL,      TILE_GROUND,    TILE_WALL,      TILE_WALL,    TILE_GROUND,
    TILE_WALL,    TILE_WALL,    TILE_WALL,      TILE_WALL,      TILE_WALL,      TILE_1_END,     TILE_WALL,      TILE_WALL,      TILE_2_END,     TILE_WALL,      TILE_WALL,    TILE_3_END,
  },
  {
    TILE_WALL,    TILE_WALL,    TILE_WALL,      TILE_WALL,      TILE_WALL,      TILE_GROUND,    TILE_GROUND,    TILE_GROUND,    TILE_GROUND,    TILE_GROUND,    TILE_GROUND,  TILE_WALL,
    TILE_WALL,    TILE_WALL,    TILE_WALL,      TILE_WALL,      TILE_WALL,      TILE_WALL,      TILE_GROUND,    TILE_WALL,      TILE_WALL,      TILE_GROUND,    TILE_WALL,    TILE_WALL,
    TILE_START,   TILE_1_START, TILE_GROUND,    TILE_GROUND,    TILE_GROUND,    TILE_GROUND,    TILE_GROUND,    TILE_1_END,     TILE_WALL,      TILE_GROUND,    TILE_WALL,    TILE_WALL,
    TILE_WALL,    TILE_WALL,    TILE_WALL,      TILE_WALL,      TILE_GROUND,    TILE_2_START,   TILE_GROUND,    TILE_3_START,   TILE_GROUND,    TILE_GROUND,    TILE_WALL,    TILE_WALL,
    TILE_WALL,    TILE_WALL,    TILE_WALL,      TILE_WALL,      TILE_WALL,      TILE_WALL,      TILE_WALL,      TILE_GROUND,    TILE_GROUND,    TILE_GROUND,    TILE_3_END,   TILE_WALL,
    TILE_WALL,    TILE_WALL,    TILE_WALL,      TILE_WALL,      TILE_WALL,      TILE_WALL,      TILE_WALL,      TILE_2_END,     TILE_WALL,      TILE_GROUND,    TILE_WALL,    TILE_WALL,
  },
  {
    TILE_WALL,    TILE_WALL,    TILE_GROUND,    TILE_GROUND,    TILE_GROUND,    TILE_GROUND,    TILE_GROUND,    TILE_GROUND,    TILE_GROUND,    TILE_2_END,     TILE_WALL,    TILE_WALL,
    TILE_WALL,    TILE_WALL,    TILE_GROUND,    TILE_WALL,      TILE_1_START,   TILE_WALL,      TILE_WALL,      TILE_WALL,      TILE_WALL,      TILE_GROUND,    TILE_WALL,    TILE_WALL,
    TILE_WALL,    TILE_WALL,    TILE_GROUND,    TILE_WALL,      TILE_2_START,   TILE_WALL,      TILE_WALL,      TILE_WALL,      TILE_1_END,     TILE_GROUND,    TILE_WALL,    TILE_WALL,
    TILE_WALL,    TILE_WALL,    TILE_GROUND,    TILE_GROUND,    TILE_GROUND,    TILE_GROUND,    TILE_GROUND,    TILE_3_START,   TILE_GROUND,    TILE_3_END,     TILE_WALL,    TILE_WALL,
    TILE_WALL,    TILE_WALL,    TILE_WALL,      TILE_WALL,      TILE_GROUND,    TILE_GROUND,    TILE_WALL,      TILE_WALL,      TILE_START,     TILE_GROUND,    TILE_WALL,    TILE_WALL,
    TILE_WALL,    TILE_WALL,    TILE_WALL,      TILE_WALL,      TILE_GROUND,    TILE_GROUND,    TILE_WALL,      TILE_WALL,      TILE_WALL,      TILE_WALL,      TILE_WALL,    TILE_WALL,
  },
  {
    TILE_WALL,    TILE_WALL,    TILE_WALL,      TILE_GROUND,    TILE_GROUND,    TILE_2_END,     TILE_GROUND,    TILE_GROUND,    TILE_GROUND,    TILE_GROUND,    TILE_WALL,    TILE_WALL,
    TILE_WALL,    TILE_WALL,    TILE_WALL,      TILE_GROUND,    TILE_GROUND,    TILE_GROUND,    TILE_WALL,      TILE_WALL,      TILE_WALL,      TILE_GROUND,    TILE_GROUND,  TILE_GROUND,
    TILE_GROUND,  TILE_GROUND,  TILE_GROUND,    TILE_WALL,      TILE_GROUND,    TILE_GROUND,    TILE_WALL,      TILE_1_END,     TILE_GROUND,    TILE_GROUND,    TILE_WALL,    TILE_GROUND,
    TILE_GROUND,  TILE_GROUND,  TILE_START,     TILE_GROUND,    TILE_GROUND,    TILE_GROUND,    TILE_2_START,   TILE_3_START,   TILE_GROUND,    TILE_GROUND,    TILE_GROUND,  TILE_GROUND,
    TILE_WALL,    TILE_1_START, TILE_GROUND,    TILE_WALL,      TILE_GROUND,    TILE_WALL,      TILE_WALL,      TILE_WALL,      TILE_GROUND,    TILE_WALL,      TILE_WALL,    TILE_3_END,
    TILE_WALL,    TILE_GROUND,  TILE_GROUND,    TILE_GROUND,    TILE_GROUND,    TILE_WALL,      TILE_WALL,      TILE_WALL,      TILE_GROUND,    TILE_GROUND,    TILE_GROUND,  TILE_GROUND,
  },
  {
    TILE_WALL,    TILE_WALL,    TILE_WALL,      TILE_WALL,      TILE_WALL,      TILE_GROUND,    TILE_GROUND,    TILE_WALL,      TILE_WALL,      TILE_WALL,      TILE_WALL,    TILE_WALL,
    TILE_WALL,    TILE_WALL,    TILE_WALL,      TILE_WALL,      TILE_GROUND,    TILE_GROUND,    TILE_1_START,   TILE_GROUND,    TILE_GROUND,    TILE_WALL,      TILE_WALL,    TILE_WALL,
    TILE_WALL,    TILE_WALL,    TILE_GROUND,    TILE_GROUND,    TILE_GROUND,    TILE_GROUND,    TILE_GROUND,    TILE_GROUND,    TILE_GROUND,    TILE_WALL,      TILE_WALL,    TILE_WALL,
    TILE_WALL,    TILE_START,   TILE_GROUND,    TILE_3_START,   TILE_2_START,   TILE_WALL,      TILE_WALL,      TILE_WALL,      TILE_GROUND,    TILE_WALL,      TILE_WALL,    TILE_WALL,
    TILE_WALL,    TILE_WALL,    TILE_GROUND,    TILE_WALL,      TILE_GROUND,    TILE_WALL,      TILE_WALL,      TILE_WALL,      TILE_GROUND,    TILE_WALL,      TILE_WALL,    TILE_WALL,
    TILE_WALL,    TILE_WALL,    TILE_GROUND,    TILE_GROUND,    TILE_1_END,     TILE_GROUND,    TILE_GROUND,    TILE_2_END,     TILE_3_END,     TILE_WALL,      TILE_WALL,    TILE_WALL,
  },
  {
    TILE_WALL,    TILE_WALL,    TILE_WALL,      TILE_WALL,      TILE_WALL,      TILE_GROUND,    TILE_GROUND,    TILE_GROUND,    TILE_GROUND,    TILE_GROUND,    TILE_GROUND,  TILE_WALL,
    TILE_WALL,    TILE_WALL,    TILE_WALL,      TILE_GROUND,    TILE_GROUND,    TILE_GROUND,    TILE_GROUND,    TILE_1_END,     TILE_WALL,      TILE_GROUND,    TILE_GROUND,  TILE_WALL,
    TILE_WALL,    TILE_WALL,    TILE_WALL,      TILE_GROUND,    TILE_WALL,      TILE_WALL,      TILE_WALL,      TILE_GROUND,    TILE_WALL,      TILE_WALL,      TILE_3_END,   TILE_WALL,
    TILE_GROUND,  TILE_GROUND,  TILE_GROUND,    TILE_GROUND,    TILE_1_START,   TILE_3_START,   TILE_START,     TILE_2_START,   TILE_GROUND,    TILE_GROUND,    TILE_GROUND,  TILE_WALL,
    TILE_GROUND,  TILE_GROUND,  TILE_WALL,      TILE_GROUND,    TILE_WALL,      TILE_WALL,      TILE_WALL,      TILE_2_END,     TILE_WALL,      TILE_WALL,      TILE_GROUND,  TILE_WALL,
    TILE_GROUND,  TILE_GROUND,  TILE_GROUND,    TILE_GROUND,    TILE_GROUND,    TILE_GROUND,    TILE_GROUND,    TILE_GROUND,    TILE_GROUND,    TILE_GROUND,    TILE_GROUND,  TILE_WALL,
  },
  {
    TILE_WALL,    TILE_WALL,    TILE_WALL,    TILE_WALL,      TILE_WALL,        TILE_WALL,      TILE_WALL,      TILE_GROUND,    TILE_GROUND,    TILE_WALL,      TILE_WALL,    TILE_WALL,
    TILE_WALL,    TILE_WALL,    TILE_WALL,    TILE_GROUND,    TILE_1_START,     TILE_GROUND,    TILE_GROUND,    TILE_GROUND,    TILE_GROUND,    TILE_GROUND,    TILE_WALL,    TILE_WALL,
    TILE_WALL,    TILE_WALL,    TILE_GROUND,  TILE_START,     TILE_WALL,        TILE_WALL,      TILE_GROUND,    TILE_3_END,     TILE_GROUND,    TILE_GROUND,    TILE_WALL,    TILE_WALL,
    TILE_WALL,    TILE_WALL,    TILE_GROUND,  TILE_2_START,   TILE_3_START,     TILE_GROUND,    TILE_GROUND,    TILE_GROUND,    TILE_WALL,      TILE_WALL,      TILE_WALL,    TILE_WALL,
    TILE_WALL,    TILE_WALL,    TILE_WALL,    TILE_WALL,      TILE_GROUND,      TILE_WALL,      TILE_GROUND,    TILE_WALL,      TILE_WALL,      TILE_WALL,      TILE_WALL,    TILE_WALL,
    TILE_WALL,    TILE_WALL,    TILE_WALL,    TILE_WALL,      TILE_GROUND,      TILE_GROUND,    TILE_2_END,     TILE_1_END,     TILE_WALL,      TILE_WALL,      TILE_WALL,    TILE_WALL,
  },
  {
    TILE_WALL,    TILE_WALL,    TILE_WALL,      TILE_WALL,    TILE_WALL,        TILE_WALL,      TILE_WALL,      TILE_WALL,      TILE_GROUND,    TILE_GROUND,    TILE_WALL,    TILE_WALL,
    TILE_WALL,    TILE_WALL,    TILE_WALL,      TILE_WALL,    TILE_GROUND,      TILE_GROUND,    TILE_GROUND,    TILE_GROUND,    TILE_GROUND,    TILE_GROUND,    TILE_WALL,    TILE_WALL,
    TILE_WALL,    TILE_WALL,    TILE_WALL,      TILE_WALL,    TILE_1_START,     TILE_WALL,      TILE_WALL,      TILE_2_END,     TILE_WALL,      TILE_1_END,     TILE_GROUND,  TILE_GROUND,
    TILE_WALL,    TILE_WALL,    TILE_START,     TILE_GROUND,  TILE_GROUND,      TILE_2_START,   TILE_3_START,   TILE_GROUND,    TILE_GROUND,    TILE_GROUND,    TILE_WALL,    TILE_GROUND,
    TILE_WALL,    TILE_WALL,    TILE_GROUND,    TILE_WALL,    TILE_WALL,        TILE_GROUND,    TILE_GROUND,    TILE_GROUND,    TILE_WALL,      TILE_3_END,     TILE_GROUND,  TILE_GROUND,
    TILE_WALL,    TILE_WALL,    TILE_GROUND,    TILE_GROUND,  TILE_GROUND,      TILE_GROUND,    TILE_GROUND,    TILE_GROUND,    TILE_WALL,      TILE_WALL,      TILE_WALL,    TILE_WALL,
  },
  {
    TILE_WALL,    TILE_WALL,    TILE_WALL,    TILE_1_END,     TILE_GROUND,      TILE_GROUND,    TILE_GROUND,    TILE_GROUND,    TILE_GROUND,    TILE_WALL,      TILE_WALL,    TILE_WALL,
    TILE_WALL,    TILE_WALL,    TILE_GROUND,  TILE_GROUND,    TILE_WALL,        TILE_WALL,      TILE_GROUND,    TILE_WALL,      TILE_2_START,   TILE_WALL,      TILE_WALL,    TILE_WALL,
    TILE_WALL,    TILE_WALL,    TILE_GROUND,  TILE_GROUND,    TILE_1_START,     TILE_GROUND,    TILE_START,     TILE_3_END,     TILE_GROUND,    TILE_GROUND,    TILE_WALL,    TILE_WALL,
    TILE_WALL,    TILE_WALL,    TILE_WALL,    TILE_GROUND,    TILE_WALL,        TILE_WALL,      TILE_WALL,      TILE_GROUND,    TILE_WALL,      TILE_GROUND,    TILE_WALL,    TILE_WALL,
    TILE_WALL,    TILE_WALL,    TILE_GROUND,  TILE_3_START,   TILE_GROUND,      TILE_GROUND,    TILE_WALL,      TILE_GROUND,    TILE_WALL,      TILE_GROUND,    TILE_WALL,    TILE_WALL,
    TILE_WALL,    TILE_WALL,    TILE_GROUND,  TILE_GROUND,    TILE_GROUND,      TILE_GROUND,    TILE_GROUND,    TILE_2_END,     TILE_GROUND,    TILE_GROUND,    TILE_WALL,    TILE_WALL,
  },
};

unsigned char level[LEVEL_HEIGHT][LEVEL_WIDTH];

unsigned char timer = 0;
signed char finished_timer = 0;
bool celebration = false;

void draw_level() {
  int x_offset = MAP_OFFSET_X;
  int y_offset = MAP_OFFSET_Y;
  if(celebration) {
    y_offset -= finished_timer * finished_timer / 4;
  }
  if(finished_timer < 0) {
    y_offset += finished_timer * finished_timer / 4;
  }
  arduboy.fillRect(0, 0, WIDTH, HEIGHT, WHITE);
  //arduboy.fillRect(0, (y_offset + (LEVEL_HEIGHT + 1) * TILE_SIZE) + MAP_OFFSET_Y * 2, WIDTH, HEIGHT - (y_offset + (LEVEL_HEIGHT + 1) * TILE_SIZE) + MAP_OFFSET_Y, WHITE);
  for (unsigned char y = 0; y < LEVEL_HEIGHT; y++) {
    for (unsigned char x = 0; x < LEVEL_WIDTH; x++) {
      if(level[y][x] != TILE_WALL) {
        arduboy.fillRect(x_offset + x * TILE_SIZE - GROUND_PADDING, y_offset + y * TILE_SIZE - GROUND_PADDING, TILE_SIZE + GROUND_PADDING * 2, TILE_SIZE + GROUND_PADDING * 2, BLACK);
      }
      switch (level[y][x]) {
        case TILE_WALL:
          //arduboy.fillRect(x_offset + x * TILE_SIZE, y_offset + y * TILE_SIZE, TILE_SIZE, TILE_SIZE, WHITE);
          break;
        case TILE_1_END:
          //K
          if(!celebration) {
            arduboy.drawBitmap(x_offset + x * TILE_SIZE + 2, y_offset + y * TILE_SIZE + 1, bitmap_small_K, 8, 8, WHITE);            
          }
          break;
        case TILE_2_END:
          //P
          if(!celebration) {
            arduboy.drawBitmap(x_offset + x * TILE_SIZE + 2, y_offset + y * TILE_SIZE + 1, bitmap_small_P, 8, 8, WHITE);
          }
          break;
        case TILE_3_END:
          //A
          if(!celebration) {
            arduboy.drawBitmap(x_offset + x * TILE_SIZE + 2, y_offset + y * TILE_SIZE + 1, bitmap_small_A, 8, 8, WHITE);
          }
          break;
      }
    }
  }
}

#define OBJECT_PLAYER 0
#define OBJECT_1 1
#define OBJECT_2 2
#define OBJECT_3 3

struct Object {
  int x = -50;
  int y = -50;
  bool complete = false;
  signed char x_count = 0;
  signed char y_count = 0;
  unsigned char timer = 0;
  double x_velocity = 0;
  double y_velocity = 0;
};

Object objects[4];

void draw_celebration() {
  for (unsigned char i = 0; i < 4; i++) {
    uint8_t* bitmap = nullptr;
    switch (i) {
      case OBJECT_PLAYER:
        //arduboy.drawBitmap(objects[i].x, objects[i].y, bitmap_player, 16, 16, WHITE);
        arduboy.drawBitmap(objects[i].x + 3, objects[i].y + 2, bitmap_player, 16, 16, WHITE);
        continue;
        break;
      case OBJECT_1:
        //K
        bitmap = bitmap_K;
        break;
      case OBJECT_2:
        //P
        bitmap = bitmap_P;
        break;
      case OBJECT_3:
        //A
        bitmap = bitmap_A;
        break;
    }

    objects[i].timer++;
    if(objects[i].timer >= 16 * 2) {
      objects[i].timer = 0;
    }
    
    objects[i].y_velocity -= 0.5;
    //objects[i].x_velocity *= 0.9;

    objects[i].x += objects[i].x_velocity;
    if(objects[i].y < HEIGHT + 30) {
      objects[i].y -= objects[i].y_velocity;
    }
    
    arduboy.drawBitmap(objects[i].x + 1, objects[i].y, bitmap + 16 * (objects[i].timer / 2), 16, 8, BLACK);
    arduboy.drawBitmap(objects[i].x + 1, objects[i].y + 8, bitmap + 16 * 16 + 16 * (objects[i].timer / 2), 16, 8, BLACK);

    arduboy.drawBitmap(objects[i].x - 1, objects[i].y, bitmap + 16 * (objects[i].timer / 2), 16, 8, BLACK);
    arduboy.drawBitmap(objects[i].x - 1, objects[i].y + 8, bitmap + 16 * 16 + 16 * (objects[i].timer / 2), 16, 8, BLACK);

    arduboy.drawBitmap(objects[i].x, objects[i].y + 1, bitmap + 16 * (objects[i].timer / 2), 16, 8, BLACK);
    arduboy.drawBitmap(objects[i].x, objects[i].y + 1 + 8, bitmap + 16 * 16 + 16 * (objects[i].timer / 2), 16, 8, BLACK);

    arduboy.drawBitmap(objects[i].x, objects[i].y - 1, bitmap + 16 * (objects[i].timer / 2), 16, 8, BLACK);
    arduboy.drawBitmap(objects[i].x, objects[i].y - 1 + 8, bitmap + 16 * 16 + 16 * (objects[i].timer / 2), 16, 8, BLACK);

    
    arduboy.drawBitmap(objects[i].x, objects[i].y, bitmap + 16 * (objects[i].timer / 2), 16, 8, WHITE);
    arduboy.drawBitmap(objects[i].x, objects[i].y + 8, bitmap + 16 * 16 + 16 * (objects[i].timer / 2), 16, 8, WHITE);
  }
}

void draw_objects() {
  int y_offfset = 0;
  if(finished_timer < 0) {
    y_offfset = finished_timer * finished_timer / 2;
  }
  for (unsigned char i = 3; i < 255; i--) {
    if (objects[i].complete) {
      //continue;
    }

    uint8_t* bitmap = nullptr;
    switch (i) {
      case OBJECT_PLAYER:
        //arduboy.drawBitmap(MAP_OFFSET_X + objects[i].x * TILE_SIZE - objects[i].x_count - 1 - 1, y_offfset + MAP_OFFSET_Y + objects[i].y * TILE_SIZE - objects[i].y_count - 1, bitmap_player, 16, 16, BLACK);
        //arduboy.drawBitmap(MAP_OFFSET_X + objects[i].x * TILE_SIZE - objects[i].x_count - 1 + 1, y_offfset + MAP_OFFSET_Y + objects[i].y * TILE_SIZE - objects[i].y_count - 1, bitmap_player, 16, 16, BLACK);
        //arduboy.drawBitmap(MAP_OFFSET_X + objects[i].x * TILE_SIZE - objects[i].x_count - 1, y_offfset + MAP_OFFSET_Y + objects[i].y * TILE_SIZE - objects[i].y_count - 1 - 1, bitmap_player, 16, 16, BLACK);
        //arduboy.drawBitmap(MAP_OFFSET_X + objects[i].x * TILE_SIZE - objects[i].x_count - 1, y_offfset + MAP_OFFSET_Y + objects[i].y * TILE_SIZE - objects[i].y_count - 1 + 1, bitmap_player, 16, 16, BLACK);
        
        arduboy.drawBitmap(MAP_OFFSET_X + objects[i].x * TILE_SIZE - objects[i].x_count - 1 + 2, y_offfset + MAP_OFFSET_Y + objects[i].y * TILE_SIZE - objects[i].y_count - 1 + 1, bitmap_player, 16, 16, WHITE);
        break;
      case OBJECT_1:
        //K
        bitmap = bitmap_K;
        break;
      case OBJECT_2:
        //P
        bitmap = bitmap_P;
        break;
      case OBJECT_3:
        //A
        bitmap = bitmap_A;
        break;
    }
    if(bitmap != nullptr) {
      if(objects[i].complete && objects[i].x_count == 0 && objects[i].y_count == 0) {
          objects[i].timer++;
          if(objects[i].timer >= 16 * 2) {
            objects[i].timer = 0;
          }
          arduboy.fillRect(MAP_OFFSET_X + objects[i].x * TILE_SIZE - objects[i].x_count, MAP_OFFSET_Y + objects[i].y * TILE_SIZE - objects[i].y_count, TILE_SIZE, TILE_SIZE, BLACK);
          arduboy.drawBitmap(MAP_OFFSET_X + objects[i].x * TILE_SIZE - objects[i].x_count, MAP_OFFSET_Y + objects[i].y * TILE_SIZE - objects[i].y_count - 1, bitmap + 16 * (objects[i].timer / 2), 16, 8, WHITE);
          arduboy.drawBitmap(MAP_OFFSET_X + objects[i].x * TILE_SIZE - objects[i].x_count, MAP_OFFSET_Y + objects[i].y * TILE_SIZE - objects[i].y_count - 1 + 8, bitmap + 16 * 16 + 16 * (objects[i].timer / 2), 16, 8, WHITE);
        } else {
          objects[i].timer = 0;


          arduboy.drawBitmap(MAP_OFFSET_X + objects[i].x * TILE_SIZE - objects[i].x_count - 1, y_offfset + MAP_OFFSET_Y + objects[i].y * TILE_SIZE - objects[i].y_count - 1 + 1, bitmap, 16, 8, BLACK);
          arduboy.drawBitmap(MAP_OFFSET_X + objects[i].x * TILE_SIZE - objects[i].x_count - 1, y_offfset + MAP_OFFSET_Y + objects[i].y * TILE_SIZE - objects[i].y_count - 1 + 8 + 1, bitmap + 16 * 16, 16, 8, BLACK);

          arduboy.drawBitmap(MAP_OFFSET_X + objects[i].x * TILE_SIZE - objects[i].x_count - 1, y_offfset + MAP_OFFSET_Y + objects[i].y * TILE_SIZE - objects[i].y_count - 1 - 1, bitmap, 16, 8, BLACK);
          arduboy.drawBitmap(MAP_OFFSET_X + objects[i].x * TILE_SIZE - objects[i].x_count - 1, y_offfset + MAP_OFFSET_Y + objects[i].y * TILE_SIZE - objects[i].y_count - 1 + 8 - 1, bitmap + 16 * 16, 16, 8, BLACK);

          arduboy.drawBitmap(MAP_OFFSET_X + objects[i].x * TILE_SIZE - objects[i].x_count + 1, y_offfset + MAP_OFFSET_Y + objects[i].y * TILE_SIZE - objects[i].y_count - 1 + 1, bitmap, 16, 8, BLACK);
          arduboy.drawBitmap(MAP_OFFSET_X + objects[i].x * TILE_SIZE - objects[i].x_count + 1, y_offfset + MAP_OFFSET_Y + objects[i].y * TILE_SIZE - objects[i].y_count - 1 + 8 + 1, bitmap + 16 * 16, 16, 8, BLACK);

          arduboy.drawBitmap(MAP_OFFSET_X + objects[i].x * TILE_SIZE - objects[i].x_count + 1, y_offfset + MAP_OFFSET_Y + objects[i].y * TILE_SIZE - objects[i].y_count - 1 - 1, bitmap, 16, 8, BLACK);
          arduboy.drawBitmap(MAP_OFFSET_X + objects[i].x * TILE_SIZE - objects[i].x_count + 1, y_offfset + MAP_OFFSET_Y + objects[i].y * TILE_SIZE - objects[i].y_count - 1 + 8 - 1, bitmap + 16 * 16, 16, 8, BLACK);

          arduboy.drawBitmap(MAP_OFFSET_X + objects[i].x * TILE_SIZE - objects[i].x_count, y_offfset + MAP_OFFSET_Y + objects[i].y * TILE_SIZE - objects[i].y_count - 1, bitmap, 16, 8, WHITE);
          arduboy.drawBitmap(MAP_OFFSET_X + objects[i].x * TILE_SIZE - objects[i].x_count, y_offfset + MAP_OFFSET_Y + objects[i].y * TILE_SIZE - objects[i].y_count - 1 + 8, bitmap + 16 * 16, 16, 8, WHITE);
        }
    }
  }
}

bool check_level() {
  bool finished = true;
  for (unsigned char i = 1; i < 4; i++) {
    //if(objects[i].complete == false) {
    //finished = false;
    //}

    if (objects[i].complete == false && level[objects[i].y][objects[i].x] != endings[i - 1]) {
      finished = false;
      break;
    }
  }

  return finished;
}

unsigned char current_level = 0;
void create_level() {
  arduboy.generateRandomSeed();

  pause_menu = false;

  finished_timer = -40;
  celebration = false;
  for (unsigned char i = 0; i < 4; i++) {
    objects[i].x = -50;
    objects[i].y = -50;
    objects[i].x_count = 0;
    objects[i].y_count = 0;
    objects[i].complete = true;
  }

  for (unsigned char y = 0; y < LEVEL_HEIGHT; y++) {
    for (unsigned char x = 0; x < LEVEL_WIDTH; x++) {
      level[y][x] = levels[current_level][y][x];
      switch (level[y][x]) {
        case TILE_START:
          objects[0].x = x;
          objects[0].y = y;
          objects[0].complete = false;
          break;
        case TILE_1_START:
          objects[1].x = x;
          objects[1].y = y;
          objects[1].complete = false;
          break;
        case TILE_2_START:
          objects[2].x = x;
          objects[2].y = y;
          objects[2].complete = false;
          break;
        case TILE_3_START:
          objects[3].x = x;
          objects[3].y = y;
          objects[3].complete = false;
          break;
      }
    }
  }
}


void move(struct Object* object, unsigned char index, signed char x_dir, signed char y_dir) {
  object->x += x_dir;
  object->y += y_dir;
  object->x_count = x_dir * TILE_SIZE;
  object->y_count = y_dir * TILE_SIZE;

  if (index > 0) {
    sound(SOUND_SLIDE, SOUND_TINY);
    object->complete = (level[object->y][object->x] == endings[index - 1]);
  }
}

bool try_move(struct Object* object, unsigned char index, signed char x_dir, signed char y_dir) {
  bool moved = true;

  for (unsigned char i = 1; i < 4; i++) {
    if (/* objects[i].complete == false &&*/ object->y + y_dir == objects[i].y && object->x + x_dir == objects[i].x) {
      if (!try_move(&objects[i], i, x_dir, y_dir)) {
        moved = false;
      }
    }
  }


  if (moved && object->y + y_dir >= 0 && object->x + x_dir >= 0 && object->x + x_dir <= LEVEL_WIDTH - 1 && object->y + y_dir <= LEVEL_HEIGHT - 1) {
    if (level[object->y + y_dir][object->x + x_dir] == TILE_WALL) {
      moved = false;
    } else {
      moved = true;
    }
  } else {
    moved = false;
  }

  if (moved) {
    move(object, index, x_dir, y_dir);
  }

  return moved;
}

void credits1() {
	arduboy.drawBitmap(8, 8, me, 48, 48, WHITE);

	arduboy.drawBitmap(73, 8, jonathan, 47, 8, WHITE);
	arduboy.drawBitmap(85, 18, holmes, 35, 8, WHITE);
	arduboy.drawBitmap(85, 38, at, 5, 8, WHITE);
	arduboy.drawBitmap(91, 38, crait, 29, 8, WHITE);
	arduboy.drawBitmap(67, 49, crait, 29, 8, WHITE);
	arduboy.drawBitmap(99, 49, net, 21, 8, WHITE);
}

//void credits2() {
  //arduboy.drawBitmap((WIDTH - 60) / 2, (HEIGHT - 24) / 2, jxm, 60, 24, WHITE);
//}

void gameplay() {
  if(!(pause_menu && pause_transition == CURVE_COUNT - 1)) {
    draw_level();
  }

  if(pause_menu) {
    if(pause_transition < CURVE_COUNT - 1) {
      pause_transition++;
      menu_offset = 0;
    }
  } else {
    if(pause_transition > 0) {
      pause_transition--;
    }
  }

  if(!celebration) {
    draw_objects();
  }

  if(pause_transition > 0) {
    arduboy.fillRect(0, 0, curve[pause_transition] * 10, HEIGHT, WHITE);
    arduboy.fillRect(20, curve[pause_transition] * 3 - 50, WIDTH - 40, 50, BLACK);
    //arduboy.drawRect(20, curve[pause_transition] * 3 - 50, WIDTH - 40, 50, WHITE);
    draw_menu(32, curve[pause_transition] * 3 - 50 + 8, restart_menu, 3);
    if(menu_offset < 8) {
      menu_offset += 2;
    }
  }

  if(celebration) {
    pause_menu = false;
    draw_celebration();
  }

  bool finished = check_level() && objects[0].x_count == 0 && objects[0].y_count == 0;
  if(finished_timer < 0) {
    finished_timer++;
  }
  if(finished) {
    if(celebration == false) {
      celebration = true;
      for(unsigned char i = 0; i < 4; i++) {
        if(objects[i].complete == true || i == 0) {
          objects[i].x = MAP_OFFSET_X + objects[i].x * TILE_SIZE - GROUND_PADDING;
          objects[i].y = MAP_OFFSET_Y + objects[i].y * TILE_SIZE - GROUND_PADDING;
          objects[i].x_velocity = random(-25, 25) / 8;
          objects[i].y_velocity = random(15, 35) / 4.5;
        }
      }
    }
    if(beep.duration == 0) {
      sound(SOUND_WIN + 2 * finished_timer, SOUND_TINY);
    }
    finished_timer++;
    if(finished_timer >= 40) {
      if(current_level + 1 < LEVEL_COUNT) {
        current_level++;
        create_level();
      } else {
        state = GameState::Credits1;
      }      
    }
  } else {
    if(finished_timer == 0 && objects[0].x_count == 0 && objects[0].y_count == 0) {
      if(pause_menu) {
        if(pause_transition == CURVE_COUNT - 1) {
          handle_menu(restart_menu, 3);
        }
      } else {
        if (arduboy.pressed(UP_BUTTON)) {
          try_move(&objects[0], 0, 0, -1);
        } else if (arduboy.pressed(DOWN_BUTTON)) {
          try_move(&objects[0], 0, 0, 1);
        } else if (arduboy.pressed(LEFT_BUTTON)) {
          try_move(&objects[0], 0, -1, 0);
        } else if (arduboy.pressed(RIGHT_BUTTON)) {
          try_move(&objects[0], 0, 1, 0);
        } else if (arduboy.pressed(A_BUTTON)) {
          sound(SOUND_MENU_NEXT, SOUND_SHORT);
          pause_menu = true;
          menu_item = 0;
        }
      }
    } else {
      pause_menu = false;
    }
    for(unsigned char i = 0; i < 4; i++) {
      bool moving = false;
      if(objects[i].x_count < 0) {
        moving = true;
        objects[i].x_count += MOVE_SPEED;
      } else if(objects[i].x_count > 0) {
        moving = true;
        objects[i].x_count -= MOVE_SPEED;
      }
      if(objects[i].y_count < 0) {
        moving = true;
        objects[i].y_count += MOVE_SPEED;
      } else if(objects[i].y_count > 0) {
        moving = true;
        objects[i].y_count -= MOVE_SPEED;
      }
      if(moving && objects[i].complete && objects[i].x_count == 0 && objects[i].y_count == 0) {
        sound(SOUND_GOAL, SOUND_SHORT);
      }
    }
  }
}

void reset_title() {
  transition = -32;
  menu_offset = -1;
  menu_item = 0;
  for(unsigned char i = 0; i < STARS_COUNT - 1; i++) {
    stars[i].life = random(20, 35);
    stars[i].x = -1;
    stars[i].y = -1;
    stars[i].x_velocity = 0;
    stars[i].y_velocity = 0;
  }
}

void title() {
  floating += floating_direction;
  if(floating == 255) {
    floating = 0;
    floating_direction = 1;
  } else if(floating == (CURVE_COUNT - 1) * 2) {
    floating = (CURVE_COUNT - 1) * 2 - 1;
    floating_direction = -1;
  }

  unsigned char f = curve[floating / 2];
  //f = 0;
  short x = 10;
  for(unsigned char i = 0; i < abs(transition); i++) {
    x += curve[i / 2] * .75 * (transition < 0 ? -1 : 1);
  }
  unsigned char y = 5;

  
  if(menu_item == 0) {
    if(current_level > 0) {
      arduboy.setCursor(95 + menu_offset, HEIGHT - 24 + 4 / 5 + x / 5 + 1);
      arduboy.print(F("\x11"));
    }
    
    arduboy.setCursor(95 + menu_offset + 8, HEIGHT - 24 + 4 / 5 + x / 5 + 1);
    arduboy.print(current_level + 1);
    
    if(current_level < LEVEL_COUNT - 1) {
      arduboy.setCursor(95 + menu_offset + 16, HEIGHT - 24 + 4 / 5 + x / 5 + 1);
      arduboy.print(F("\x10"));
    }
  }

  //arduboy.drawBitmap(WIDTH - 60 - 2, 4 - x / 5, jxm, 60, 24, WHITE);
  arduboy.drawBitmap(24, 53 - x / 5, by_jxm, 39, 10);

  draw_menu(70, HEIGHT - 24 + x / 5, main_menu, 2);
  if(menu_offset < 8) {
    menu_offset++;
  }

  if(transition < 0) {
    menu_offset = 0;
  }

  
  for(unsigned char i = 0; i < STARS_COUNT - 1; i++) {
    stars[i].x += stars[i].x_velocity;
    stars[i].y += stars[i].y_velocity;
    stars[i].life--;
    if(stars[i].life == -1) {
      stars[i].life = random(0, 25);
      stars[i].x = random(33, 77);
      stars[i].y = 40 - x;
      stars[i].x_velocity = random(-5, 5);
      stars[i].y_velocity = random(-5, 5);
    }
    arduboy.drawPixel(stars[i].x, stars[i].y, WHITE);
  }

  arduboy.drawBitmap(7, 11 - x, title_back, 88, 50, BLACK);
  arduboy.drawBitmap(7, 11 - x, title_outline, 88, 50, WHITE);
  
  /*
  arduboy.drawBitmap(x - 8, y + 33 - f / 2, mascot_body, BODY_WIDTH, BODY_HEIGHT, WHITE);

  arduboy.drawBitmap(x, -3 + y - (f * 2) / 5, mascot_head, HEAD_WIDTH, HEAD_HEIGHT, BLACK);
  arduboy.drawBitmap(x, -2 + y - (f * 2) / 5, mascot_head, HEAD_WIDTH, HEAD_HEIGHT, BLACK);
  arduboy.drawBitmap(x, -1 + y - (f * 2) / 5, mascot_head, HEAD_WIDTH, HEAD_HEIGHT, BLACK);
  arduboy.drawBitmap(x, 0 + y - (f * 2) / 5, mascot_head, HEAD_WIDTH, HEAD_HEIGHT, WHITE);
  */

  if(transition > 0) {
    arduboy.fillCircle(-200 + x, HEIGHT / 2, 120, WHITE);
  }
}

void setup() {
  arduboy.begin();
  arduboy.setFrameRate(45);
	beep.begin();
}

void loop() {
  if(!(arduboy.nextFrame())) {
    return;
  }

	beep.timer();
  arduboy.clear();
  arduboy.pollButtons();

  timer++;
  if(timer > 15) {
    timer = 0;
  }

  switch(state) {
    case GameState::Credits1:
      credits1();
      if (arduboy.justReleased(A_BUTTON)) {
        sound(SOUND_MENU_NEXT, SOUND_SHORT);
        //state = GameState::Credits2;
        state = GameState::Title;
        reset_title();
      }
      break;
    //case GameState::Credits2:
      //credits2();
      //if (arduboy.justReleased(A_BUTTON)) {
        //state = GameState::Title;
        //reset_title();
      //}
      //break;
    case GameState::Title:
      title();
      if(transition < 0) {
        transition++;
      } else if(transition > 0) {
        transition++;
        if(transition == 32) {
          state = GameState::Gameplay;
          create_level();
          menu_item = 0;
          pause_transition = 0;
          pause_menu = false;
        }
      } else {
        if(!handle_menu(main_menu, 2)) {
          if(menu_item == 0) {
            if(arduboy.justReleased(LEFT_BUTTON) && current_level > 0) {
              sound(SOUND_MENU_SCROLL, SOUND_SHORT);
              current_level--;
            } else if(arduboy.justReleased(RIGHT_BUTTON) && current_level < LEVEL_COUNT - 1) {
              sound(SOUND_MENU_SCROLL, SOUND_SHORT);
              current_level++;
            }
          }
        }
      }
      break;
    case GameState::Gameplay:
      gameplay();
      break;
  }

  arduboy.display();
}
