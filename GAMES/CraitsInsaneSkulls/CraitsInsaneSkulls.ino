//	Insane Skulls
//	Version 1.0, Aug 31, 2020
//	By Jonathan Holmes (crait)
//
//	Website: http://www.crait.net/
//	Twitter: @crait (http://www.twitter.com/crait)
//
//	Long ago, the Greeks and Romans would play a game called, "Astragalus," which evolved into
//	what Americans call, "Jacks." There have been several variations of this game over time,
//	but it started out being played with small, dried animal bones. In the 90's, there was
//	a major Crazy Bones crazy, a game based off of astragalus with plastic figurines with weird
//	and odd shapes, sizes, and faces.
//
//	Insane Skulls is based off of games like astragalus and Crazy Bones, where a player picks
//	a team of 4 characters (or skulls), all with different stats and properties. Players take
//	turns flicking their skulls at the opposing skulls, carefully aiming, giving a nice amount
//	of upward or forward force, in hopes of knocking the other player's skulls over.
//
//	Insane Skulls has 16 different characters, including guest characters like Circuit Dude
//	and Dusty Argile, and supports either a single player mode against the CPU or head-to-head
//	mode against another human.
//
//	See how many times you can beat the CPU in a row with the team you make to beat the high
//	score!
//
//	Release History:
//	1.0 - Aug 31, 2020
//
//	License:
//	Code is supplied for 2 purposes: 1) Ease of loading onto an Arduboy device for personal
//	play, and 2) Educational value in the case of studying the code and modifying for personal,
//	educational use. Even though the source code is available to the public, this software is
//	not 'open-source'. Re-releasing my code/game, re-distributing my code/game, or publicly
//	sharing a modified variation or derivative of my code/game is not allowed. The code has no
//	guarantee of support in the future. The code is also free of charge in order to play. This
//	code must never be sold. This game must never be sold. Distribution of my game/code for
//	commercial or financial gain is explicitly NOT allowed. Finally, someone creating a new
//	version of the game for a different platform with imagery, gameplay elements, or game
//	design element derived from this game must have explicit permission from me if it is
//	intended to be released or distributed to others.

#include <Arduboy2.h>
Arduboy2 arduboy;
#include <Arduboy2Beep.h>
BeepPin2 beep;
#include "Tinyfont.h"
Tinyfont tinyfont = Tinyfont(arduboy.sBuffer, Arduboy2::width(), Arduboy2::height());

#define SAVELOCATION	(EEPROM_STORAGE_SPACE_START + 92)

#define FRAMERATE		45
signed char frame = 0;
signed char bob = 0;
signed char screenshake = 0;

#define STATE_INTRO		0
#define STATE_MENU		1
#define STATE_SCORE		2
#define STATE_CHARS		3
#define STATE_PICKAIM	10
#define STATE_AIM		4
#define STATE_FLICK		5
#define STATE_RESULT	6
#define STATE_VS		7
#define STATE_FLYING	8
#define STATE_RESULTSCORE	11

signed char gamestate = STATE_INTRO;
signed char flickstate = 0;
signed char flickcursor = 0;
signed char flickmovement = 0;

#define MENU_1P			0
#define MENU_2P			1
#define MENU_SOUND		2
#define MENU_SOUND_ON	3

signed char cursor = 0;
signed char delayedcursor = 0;

#define NOISE_NEXT		130
#define NOISE_POINT		70
#define NOISE_MISS		300
#define NOISE_HIT		500
#define NOISE_RETREAT	130
#define NOISE_CLICK		400

#define SOUND_SHORT		5
#define SOUND_MED		20
#define SOUND_LONG		60

#define SOUND_MENU_EXIT			215
#define SOUND_MENU_BACK			215
#define SOUND_MENU_TOGGLE		325
#define SOUND_MENU_PICK			325
#define SOUND_MENU_NEXT			425
#define SOUND_MENU_SCROLL		400

#define SOUND_BOUNCE	350
#define SOUND_HIT		500

#define OFFSET_X_MENU	16
#define OFFSET_Y_MENU	37
#define OFFSET_X_STATS	22
#define OFFSET_Y_STATS	0
#define OFFSET_Y_TEAM	10

unsigned char me[] PROGMEM = {
	0x45, 0x8a, 0x15, 0xaa, 0x15, 0xaa, 0xd5, 0x6a, 0x34, 0x28, 0x21, 0x32, 0x1d, 0x0a, 0x0c, 0x06, 0x03, 0x02, 0x07, 0x02, 0x23, 0x41, 0xa0, 0x41, 0x80, 0x40, 0x81, 0x40, 0x20, 0x80, 0x40, 0x80,
	0x40, 0x20, 0x08, 0xc7, 0x7d, 0xa2, 0x55, 0xa2, 0x51, 0xa8, 0x15, 0x88, 0x44, 0xa2, 0x51, 0xaa, 0x54, 0xa8, 0x51, 0x82, 0x05, 0xff, 0x00, 0x00, 0x41, 0x80, 0x80, 0x00, 0x80, 0xe0, 0xf0, 0xf0,
	0xf0, 0xf0, 0xe0, 0x60, 0x60, 0x60, 0x68, 0xed, 0xe4, 0xe3, 0xe0, 0xe0, 0x61, 0x72, 0xe1, 0x02, 0xe1, 0x32, 0x1a, 0xaf, 0x11, 0x88, 0x54, 0x8a, 0x45, 0x2a, 0x05, 0x92, 0x45, 0xa2, 0x41, 0xa0,
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	0xdb, 0x57, 0xa7, 0xcf, 0xb7, 0x8b, 0xfa, 0xf6, 0x76, 0xa6, 0xca, 0x76, 0xea, 0x9c, 0x5f, 0xdf, 0xc0, 0xfe, 0xfe, 0xff, 0xff, 0xff, 0xff, 0x0f, 0xb6, 0xb9, 0xfb, 0xf8, 0xf3, 0xf7, 0xff, 0xf8
};

unsigned char logo[] PROGMEM = {
	0x00, 0x00, 0x00, 0x20, 0x20, 0x20, 0x20, 0x00, 
	0x40, 0xc0, 0x80, 0x80, 0x80, 0x00, 0x00, 0x00, 
	0x00, 0x00, 0x0e, 0xfe, 0xf8, 0xc0, 0xc0, 0xe0, 
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	0x00, 0x00, 0x00, 0x00, 0x00, 0x00, 0x00, 0x00
};

unsigned char splat1[] PROGMEM = {
	0x06, 0x0f, 0x1f, 0x3e, 0x7c, 0x7c, 0x7c, 0x3e, 0x3f, 0x3f, 0x3e, 0x1c, 0x18, 0x00, 0x00, 0x00, 0x80, 0x00, 0x04, 0x0c, 0x0e, 0x0c, 0x04
};

unsigned char splat2[] PROGMEM = {
	0x3c, 0xe6, 0x1e, 0xfe, 0xfe, 0xfe, 0xf8, 0xf8,
	0xf0, 0xf0, 0xf0, 0xf0, 0xdc, 0xf6, 0xfb, 0xfd,
	0xfd, 0xfd, 0xfd, 0xfd, 0xff, 0xfa, 0xfa, 0xfc,
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	0x03, 0x01
};

unsigned char menucap[] PROGMEM = {
	0x7e, 0x81, 0x7e
};

unsigned char menulabels[][11] PROGMEM = {
	{
		0x48, 0x4c, 0x7e, 0x7e, 0x40, 0x00, 0x7e, 0x7e, 0x12, 0x1e, 0x0c
	},
	{
		0x44, 0x62, 0x72, 0x5e, 0x4c, 0x00, 0x7e, 0x7e, 0x12, 0x1e, 0x0c
	},
	{
		0x18, 0x3c, 0x3c, 0x7e, 0x00, 0x00, 0x28, 0x10, 0x28, 0x00, 0x00
	},
	{
		0x18, 0x3c, 0x3c, 0x7e, 0x00, 0x24, 0x18, 0x42, 0x24, 0x18, 0x00
	}
};

unsigned char newlabel[] PROGMEM = {
	0x00, 0x00, 0xfe, 0x0e, 0x0c, 0x9e, 0x7e, 0xfc,
	0x08, 0x08, 0xfc, 0x02, 0x02, 0xda, 0xda, 0xda,
	0xfe, 0x03, 0x03, 0x7e, 0x1e, 0x84, 0x06, 0x06,
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	0x01, 0x00
};

unsigned char misslabel[] PROGMEM = {
	0xfe, 0x06, 0x06, 0x86, 0x1c, 0x70, 0xf8,
	0x0e, 0xc2, 0x02, 0x02, 0xfe, 0xf6, 0x04, 0x04,
	0xf5, 0xfc, 0x84, 0x84, 0x34, 0x34, 0x74, 0xfc,
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	0x3c, 0x27, 0x24, 0x24, 0x3f, 0x01, 0x00
};

unsigned char hitlabel[] PROGMEM = {
	0x18, 0x38, 0x7c, 0xfe, 0x0e, 0x07, 0x7c, 0x78,
	0x78, 0x7c, 0x07, 0x03, 0xfe, 0xfc, 0xf4, 0x07,
	0x06, 0xf6, 0xfe, 0xec, 0xe8, 0xe8, 0x08, 0x0c,
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	0x7f, 0x1c, 0x38, 0x38, 0x10, 0x00
};

unsigned char winslabel[] PROGMEM = {
	0xfc, 0x8c, 0x0c, 0x78, 0xfc, 0x0c, 0x04, 0x84,
	0x1c, 0x7e, 0x07, 0x03, 0xff, 0xfa, 0x02, 0x02,
	0xfa, 0xfe, 0x02, 0x02, 0xe3, 0x8e, 0x18, 0x7c,
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	0x6f, 0x44, 0x44, 0x7e, 0x0f, 0x06
};

unsigned char highscorelabel[] PROGMEM = {
	0x00, 0xfc, 0x3e, 0x02, 0x02, 0x3e, 0x3e, 0x3e,
	0x0e, 0x06, 0xe4, 0xb8, 0x3c, 0x3e, 0xbf, 0xff,
	0x3c, 0x1f, 0x8f, 0xcf, 0xce, 0xcc, 0xcc, 0xfc,
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	0x1e, 0x18
};

unsigned char aimlabel[] PROGMEM = {
	0x60, 0x78, 0x7e, 0x7e, 0x78, 0x60, 0x00, 0x00,
	0xc0, 0x78, 0x0c, 0xce, 0x0e, 0x3c, 0xf0, 0xc0,
	0x00, 0xb8, 0xec, 0x0c, 0x88, 0xe8, 0xf8, 0x38,
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	0x40, 0x78, 0x0f, 0x01
};

unsigned char flicklabel[] PROGMEM = {
	0x06, 0xff, 0x03, 0x03, 0xb3, 0xbb, 0xaa, 0xfe,
	0x0c, 0x04, 0xfc, 0x00, 0x00, 0x1c, 0xf4, 0x04,
	0x04, 0xf4, 0xfc, 0x0c, 0x04, 0xe6, 0xf6, 0xf6,
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	0x04, 0x08, 0x09, 0x17, 0x1e, 0x38
};

unsigned char vlaunch[] PROGMEM = {
	0x00, 0x80, 0xc0, 0xe0, 0xf0, 0xf8, 0xfc, 0xfe,
	0xff, 0xfe, 0xfc, 0xf8, 0xf0, 0xe0, 0xc0, 0x80,
	0x00, 0x00, 0x70, 0xff, 0xff, 0x29, 0x02, 0x49,
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	0x3d, 0x3f, 0x3f, 0x3f, 0x1f, 0x0f, 0x21, 0x00,
};

unsigned char hlaunch[] PROGMEM = {
	0x84, 0xe0, 0xe0, 0xbc, 0xfe, 0xfe, 0x76, 0xb6,
	0x56, 0xbe, 0x5c, 0x1c, 0xb8, 0x18, 0x5a, 0x1a,
	0x98, 0x18, 0x18, 0x18, 0x18, 0x58, 0x18, 0x1a,
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	0x0f, 0x07, 0x03, 0x01
};

unsigned char vslabel[] PROGMEM = {
	0x70, 0xf9, 0xca, 0x0a, 0xf8, 0xf8, 0x30, 0x90,
	0xfa, 0x8c, 0x04, 0x34, 0x64, 0xe4, 0x3d, 0x80,
	0x00, 0x21, 0x0f, 0x18, 0x11, 0x18, 0x0e, 0x07,
	0x4d, 0x09, 0x1b, 0x18, 0x18, 0x3f, 0x1f, 0x40
};

unsigned char teamlabel[] PROGMEM = {
	0xdc, 0x16, 0x16, 0xf6, 0x06, 0x06, 0xf4, 0x74,
	0x1c, 0x90, 0x90, 0x92, 0x90, 0xf0, 0xf0, 0x18,
	0x8c, 0xce, 0x0a, 0x78, 0xc1, 0xfe, 0x06, 0x06,
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	0x30, 0x1f
};

unsigned char cpulabel[] PROGMEM = {
	0xe2, 0x30, 0x10, 0x98, 0x98, 0xfe, 0x1c, 0x18,
	0xd0, 0x10, 0x30, 0xfc, 0x19, 0x10, 0xf0, 0x18,
	0x08, 0xf8, 0x0b, 0x06, 0x04, 0x0c, 0x1c, 0x7f,
	0x38, 0x30, 0x1e, 0x02, 0x03, 0x03, 0x67, 0x04,
	0x0c, 0x0c, 0x1e, 0x43
};

unsigned char playerlabel[] PROGMEM = {
	0xe0, 0xfc, 0xf8, 0xfa, 0xf8, 0xfc, 0xfe, 0xf8,
	0xfe, 0xfe, 0xfc, 0xf8, 0xf8, 0xf0, 0x01, 0x07,
	0x0f, 0x1f, 0x0f, 0x0f, 0x0f, 0x07, 0x07, 0x0f,
	0x1f, 0x1f, 0x23, 0x03
};

unsigned char skullbitmaps[16][4][32] PROGMEM = {
	{
		{ 0x00, 0x00, 0xc0, 0x30, 0x0c, 0xc2, 0x21, 0xa1, 0xc1, 0x21, 0xa2, 0xcc, 0x30, 0xc0, 0x00, 0x00, 0x00, 0x60, 0x97, 0x98, 0x90, 0x60, 0x21, 0x29, 0x28, 0x29, 0x61, 0x90, 0x98, 0x97, 0x60, 0x00 },
		{ 0x00, 0x80, 0xe0, 0x10, 0x08, 0x04, 0x64, 0xb2, 0x92, 0xe2, 0x42, 0x82, 0x02, 0x04, 0xf8, 0x00, 0x07, 0x08, 0x09, 0x06, 0x68, 0x91, 0x92, 0xa4, 0x61, 0x22, 0x22, 0x11, 0x08, 0x06, 0x01, 0x00 },
		{ 0x1c, 0x22, 0xe2, 0x1c, 0x88, 0x04, 0x04, 0xc4, 0xa4, 0x24, 0xc8, 0x08, 0x10, 0x10, 0x20, 0xc0, 0x38, 0x44, 0x47, 0x38, 0x13, 0x20, 0x20, 0x26, 0x2d, 0x29, 0x16, 0x10, 0x08, 0x08, 0x04, 0x03 },
		{ 0xe0, 0x10, 0x90, 0x60, 0x16, 0x89, 0x49, 0x25, 0x86, 0x44, 0xc4, 0x88, 0x10, 0x60, 0x80, 0x00, 0x00, 0x01, 0x07, 0x08, 0x10, 0x20, 0x26, 0x49, 0x4b, 0x46, 0x42, 0x41, 0x40, 0x20, 0x1f, 0x00 }
	},
	{
		{ 0x1e, 0xe1, 0x01, 0x31, 0x09, 0x09, 0x09, 0x29, 0x01, 0xa9, 0x89, 0x31, 0x01, 0xc6, 0x38, 0x00, 0xe0, 0x9f, 0x80, 0x9c, 0xaa, 0xbe, 0xaa, 0xbe, 0xaa, 0xbe, 0xaa, 0xbe, 0xaa, 0x9d, 0x82, 0x7c },
		{ 0x00, 0x80, 0x80, 0x40, 0xa0, 0x90, 0x8c, 0x12, 0x51, 0x31, 0x82, 0x44, 0xc8, 0x30, 0xc0, 0x00, 0x01, 0x02, 0x04, 0x0b, 0x15, 0x2a, 0x55, 0xab, 0xb4, 0x5a, 0x32, 0x08, 0x05, 0x04, 0x03, 0x00 },
		{ 0xff, 0x01, 0xf1, 0xaa, 0xfa, 0xaa, 0xf2, 0x02, 0x02, 0x02, 0x8a, 0x09, 0xf1, 0x01, 0x01, 0xfe, 0x7f, 0x80, 0x9f, 0xaa, 0xbf, 0xaa, 0x5f, 0x20, 0x26, 0x20, 0x4a, 0x48, 0x46, 0x20, 0x20, 0x1f },
		{ 0x80, 0x40, 0xa0, 0x50, 0xa8, 0x54, 0xaa, 0xd9, 0x76, 0x08, 0x10, 0xa0, 0x40, 0x40, 0x80, 0x00, 0x01, 0x02, 0x05, 0x07, 0x0a, 0x31, 0x46, 0x50, 0x54, 0x59, 0x22, 0x23, 0x10, 0x08, 0x04, 0x03 }
	},
	{
		{ 0x00, 0x00, 0x00, 0xc0, 0x30, 0x4c, 0x42, 0x01, 0x01, 0x42, 0x4c, 0x30, 0xc0, 0x00, 0x00, 0x00, 0x1c, 0x0a, 0x8e, 0xd1, 0xa0, 0x90, 0xa5, 0x94, 0x94, 0xa5, 0x90, 0xa0, 0xd1, 0x8e, 0x0a, 0x1c },
		{ 0x90, 0x98, 0xb4, 0x64, 0x94, 0x0c, 0x84, 0x04, 0x24, 0x0a, 0x92, 0x22, 0x41, 0x81, 0x71, 0x0f, 0x01, 0x02, 0x04, 0x09, 0x12, 0x22, 0x4c, 0x91, 0xea, 0x10, 0x30, 0xe8, 0x44, 0x3f, 0x00, 0x00 },
		{ 0xfc, 0x08, 0x50, 0xa9, 0x07, 0xc5, 0x06, 0x48, 0x08, 0x68, 0x10, 0x10, 0x20, 0x20, 0x40, 0x80, 0x3f, 0x10, 0x0a, 0x95, 0xe0, 0xa3, 0x60, 0x12, 0x10, 0x16, 0x08, 0x08, 0x04, 0x04, 0x02, 0x01 },
		{ 0x80, 0x40, 0x20, 0x90, 0x48, 0x44, 0x32, 0x89, 0x57, 0x08, 0x0c, 0x17, 0x22, 0xfc, 0x00, 0x00, 0x09, 0x19, 0x2d, 0x26, 0x29, 0x30, 0x21, 0x20, 0x24, 0x50, 0x49, 0x44, 0x82, 0x81, 0x8e, 0xf0 }
	},
	{
		{ 0x00, 0x00, 0x80, 0x9c, 0xa2, 0x41, 0x81, 0x81, 0x81, 0x81, 0x41, 0xa2, 0x9c, 0x80, 0x00, 0x00, 0x30, 0x0b, 0x64, 0x92, 0x0a, 0x67, 0x98, 0x12, 0x12, 0x98, 0x67, 0x0a, 0x92, 0x64, 0x0b, 0x30 },
		{ 0x24, 0x92, 0x4a, 0x92, 0xa2, 0x5c, 0x20, 0x38, 0xc4, 0x82, 0x01, 0x01, 0x01, 0x82, 0x44, 0x38, 0x00, 0x07, 0x00, 0x06, 0x03, 0x54, 0x59, 0x4a, 0x58, 0x24, 0x8b, 0x55, 0x25, 0x84, 0x78, 0x00 },
		{ 0x48, 0x24, 0x25, 0xc9, 0x52, 0x24, 0xba, 0x22, 0xdc, 0x20, 0x10, 0x08, 0x08, 0x08, 0x10, 0xe0, 0x12, 0x24, 0xa4, 0x93, 0x4a, 0x24, 0x5d, 0x44, 0x3b, 0x04, 0x08, 0x10, 0x10, 0x10, 0x08, 0x07 },
		{ 0x00, 0xe0, 0x00, 0x60, 0xc0, 0x2a, 0x9a, 0x52, 0x1a, 0x24, 0xd1, 0xaa, 0xa4, 0x21, 0x1e, 0x00, 0x24, 0x49, 0x52, 0x49, 0x45, 0x3a, 0x04, 0x1c, 0x23, 0x41, 0x80, 0x80, 0x80, 0x41, 0x22, 0x1c }
	},
	{
		{ 0x00, 0x00, 0x00, 0x80, 0x60, 0x18, 0x84, 0x02, 0x01, 0x07, 0x18, 0x60, 0x80, 0x00, 0x00, 0x00, 0xc0, 0xb0, 0x8e, 0x81, 0x80, 0x80, 0x91, 0x90, 0x90, 0x93, 0x90, 0x98, 0x81, 0x8e, 0xb0, 0xc0 },
		{ 0x40, 0xa0, 0x30, 0x10, 0x10, 0x08, 0x08, 0x24, 0x14, 0x84, 0x42, 0x02, 0x02, 0xe1, 0x19, 0x06, 0x00, 0x00, 0x01, 0x02, 0x04, 0x08, 0x11, 0x22, 0x44, 0x88, 0x84, 0x60, 0x1e, 0x01, 0x00, 0x00 },
		{ 0xff, 0x01, 0x02, 0xc2, 0x04, 0x04, 0x04, 0x48, 0x48, 0x10, 0x10, 0x20, 0x20, 0x40, 0x80, 0x00, 0xff, 0x80, 0x40, 0x4f, 0x28, 0x20, 0x22, 0x12, 0x10, 0x08, 0x08, 0x04, 0x04, 0x02, 0x02, 0x03 },
		{ 0x00, 0x00, 0x80, 0x40, 0x20, 0x10, 0x88, 0x44, 0x02, 0x01, 0x86, 0x1c, 0x60, 0x80, 0x00, 0x00, 0x06, 0x09, 0x08, 0x10, 0x12, 0x15, 0x10, 0x20, 0x22, 0x24, 0x20, 0x41, 0x40, 0x83, 0x9c, 0x60 }
	},
	{
		{ 0x0f, 0x31, 0xc7, 0x04, 0xa7, 0xa1, 0xa7, 0x04, 0x07, 0xa1, 0xa1, 0xa7, 0x04, 0xc7, 0x31, 0x0f, 0xe0, 0x90, 0x8f, 0x80, 0x99, 0x91, 0x91, 0x90, 0x90, 0x91, 0x91, 0x99, 0x80, 0x8f, 0x90, 0xe0 },
		{ 0x00, 0x80, 0x40, 0x40, 0xa0, 0x10, 0x6c, 0x6b, 0x11, 0x05, 0x03, 0x96, 0x0c, 0x58, 0x30, 0xe0, 0x03, 0x06, 0x0c, 0x19, 0x32, 0x64, 0xc8, 0x90, 0x48, 0x33, 0x0b, 0x04, 0x03, 0x02, 0x01, 0x01 },
		{ 0xff, 0x01, 0x01, 0xf2, 0x14, 0x04, 0x04, 0x74, 0x74, 0x04, 0x72, 0x02, 0x01, 0xdd, 0x55, 0x77, 0xff, 0x80, 0x80, 0x4f, 0x28, 0x20, 0x20, 0x2e, 0x2e, 0x20, 0x4e, 0x40, 0x80, 0xb9, 0xa9, 0xef },
		{ 0xc0, 0x60, 0x30, 0x98, 0x4c, 0x26, 0x13, 0x09, 0x12, 0xcc, 0xd0, 0x20, 0xc0, 0x40, 0x80, 0x80, 0x00, 0x01, 0x02, 0x02, 0x05, 0x08, 0x36, 0xd6, 0x88, 0xa0, 0xc0, 0x69, 0x30, 0x1a, 0x0c, 0x07 }
	},
	{
		{ 0x80, 0xc0, 0x20, 0x20, 0xc0, 0x00, 0x00, 0x80, 0xf0, 0x0a, 0x2e, 0x8e, 0xbc, 0xb8, 0xc0, 0x00, 0x0f, 0x0a, 0x15, 0x2f, 0x17, 0xa1, 0xc9, 0xa8, 0x28, 0xe4, 0x90, 0x09, 0x0f, 0x00, 0x00, 0x00 },
		{ 0x08, 0xd4, 0x2a, 0x2a, 0x92, 0x22, 0x3c, 0x40, 0xc0, 0x20, 0x20, 0xa0, 0x28, 0xf8, 0xf0, 0x60, 0x04, 0x19, 0x07, 0x14, 0x7a, 0x0d, 0x12, 0x12, 0x10, 0x0e, 0x0e, 0x04, 0x18, 0x0f, 0x01, 0x00 },
		{ 0xe0, 0x40, 0xa8, 0x14, 0xcb, 0x1d, 0x1b, 0x7d, 0x93, 0x12, 0x0c, 0x00, 0x00, 0x00, 0x00, 0x00, 0x06, 0x02, 0x03, 0x04, 0x19, 0x12, 0x10, 0x18, 0x79, 0x41, 0x35, 0x31, 0x3e, 0x1c, 0x0e, 0x00 },
		{ 0x00, 0x10, 0x10, 0xda, 0x32, 0x2d, 0xd4, 0x26, 0x12, 0x82, 0x6c, 0x52, 0x4d, 0x42, 0x3c, 0x00, 0x00, 0x00, 0x00, 0x11, 0x36, 0x2e, 0x26, 0x60, 0x69, 0xe1, 0xfe, 0x60, 0x30, 0x00, 0x00, 0x00 }
	},
	{
		{ 0xbc, 0x42, 0x2c, 0x10, 0x08, 0xc8, 0x28, 0xa8, 0x28, 0x28, 0xc8, 0x08, 0x10, 0x2c, 0x42, 0xbc, 0x7f, 0x90, 0x8e, 0x8a, 0x8c, 0x88, 0x51, 0x51, 0x51, 0x51, 0x88, 0x8c, 0x8a, 0x8e, 0x90, 0x7f },
		{ 0xc0, 0x20, 0x90, 0x48, 0xc6, 0x05, 0xc5, 0x25, 0x4b, 0x91, 0x20, 0x40, 0x80, 0x00, 0x80, 0xc0, 0x07, 0x09, 0x09, 0x13, 0x67, 0x88, 0x99, 0xfb, 0xaa, 0x9a, 0x41, 0x20, 0x10, 0x0f, 0x08, 0x07 },
		{ 0x3e, 0xc1, 0x01, 0xc3, 0x3d, 0x15, 0x0d, 0xc1, 0xa1, 0x22, 0xc5, 0x09, 0xf5, 0x05, 0x02, 0x00, 0x7c, 0x83, 0x80, 0xc3, 0xbc, 0xa8, 0xb0, 0x83, 0x84, 0x44, 0xa3, 0x90, 0xaf, 0xa0, 0x40, 0x00 },
		{ 0xe0, 0x90, 0x90, 0xc8, 0xe6, 0x11, 0x99, 0xdf, 0x55, 0x59, 0x82, 0x04, 0x08, 0xf0, 0x10, 0xe0, 0x03, 0x04, 0x09, 0x12, 0x63, 0xa0, 0xa3, 0xa4, 0xd2, 0x89, 0x04, 0x02, 0x01, 0x00, 0x01, 0x03 }
	},
	{
		{ 0x00, 0xf8, 0x08, 0xea, 0xe9, 0x6a, 0xec, 0xec, 0xec, 0xeb, 0x29, 0xe8, 0xe8, 0x08, 0xf8, 0x00, 0x00, 0x3f, 0x20, 0x2f, 0xef, 0x6f, 0x2f, 0x2b, 0x2b, 0x2f, 0x6f, 0xef, 0x2f, 0x20, 0x3f, 0x00 },
		{ 0xe0, 0x30, 0xd8, 0xec, 0xf6, 0xfb, 0xfd, 0xdd, 0xfd, 0xfb, 0xf6, 0xec, 0xdd, 0xbe, 0x68, 0xc6, 0x19, 0x0e, 0x0d, 0x8b, 0xf7, 0x6d, 0x5b, 0xbf, 0xbf, 0xbf, 0xdd, 0x6e, 0x37, 0x1b, 0x0c, 0x07 },
		{ 0x10, 0x30, 0xfe, 0x02, 0xfa, 0x7a, 0xfa, 0xfa, 0xda, 0xfa, 0xfa, 0x02, 0xfe, 0xc0, 0x28, 0x10, 0x08, 0x0c, 0x7f, 0x40, 0x5f, 0x5e, 0x5f, 0x5f, 0x5b, 0x5b, 0x5f, 0x40, 0x7f, 0x01, 0x02, 0x06 },
		{ 0x98, 0x70, 0xb0, 0xd1, 0xef, 0xb6, 0xda, 0xfd, 0xfd, 0xfd, 0x7b, 0xf6, 0xec, 0xd8, 0x30, 0xe0, 0x07, 0x0c, 0x1b, 0x37, 0x6f, 0xdf, 0xbb, 0xb7, 0xbf, 0xdf, 0x6f, 0x37, 0x7b, 0xbd, 0xa6, 0x13 }
	},
	{
		{ 0x00, 0x20, 0x40, 0x40, 0x50, 0x58, 0x58, 0x5c, 0x4c, 0x5c, 0x4c, 0x58, 0x40, 0x40, 0x20, 0x00, 0x00, 0x00, 0x30, 0xb8, 0xc9, 0xb3, 0xa7, 0x24, 0x47, 0x47, 0xa4, 0xb3, 0xc0, 0x00, 0x00, 0x00 },
		{ 0x00, 0xc0, 0xe0, 0x60, 0x80, 0x00, 0xe7, 0xe8, 0x50, 0xa4, 0x4c, 0x9c, 0x3c, 0x58, 0xb0, 0x00, 0x1b, 0x1e, 0x2c, 0xf2, 0xa7, 0xf8, 0xe1, 0x63, 0x37, 0x0f, 0x05, 0x06, 0x01, 0x02, 0x04, 0x06 },
		{ 0x78, 0x10, 0xec, 0x2c, 0x18, 0xc0, 0x60, 0x70, 0x00, 0xfc, 0x02, 0xf0, 0xe0, 0x80, 0x00, 0x00, 0x1c, 0x13, 0x0c, 0x08, 0x00, 0x07, 0x0b, 0x0b, 0x00, 0x3f, 0x40, 0x0a, 0x0f, 0x07, 0x00, 0x00 },
		{ 0x78, 0xe8, 0xfc, 0x2b, 0x27, 0x16, 0x9b, 0xd1, 0xd6, 0xce, 0xcc, 0x00, 0x80, 0x40, 0x40, 0x40, 0x00, 0x00, 0x01, 0x01, 0x02, 0xcf, 0xab, 0x17, 0x4a, 0x25, 0x52, 0x79, 0x3c, 0x1e, 0x00, 0x00 }
	},
	{
		{ 0x70, 0x8c, 0x02, 0x31, 0x52, 0x64, 0x04, 0x08, 0xe4, 0xa2, 0xe2, 0x02, 0x1c, 0xe0, 0x00, 0x00, 0x38, 0x44, 0x83, 0x80, 0x88, 0x94, 0x48, 0x40, 0x40, 0x40, 0x40, 0x82, 0x85, 0x88, 0x70, 0x00 },
		{ 0xc0, 0x20, 0x20, 0xa0, 0x18, 0x04, 0x32, 0x2a, 0x19, 0xc1, 0x4d, 0xd2, 0x10, 0x10, 0xe0, 0x00, 0x03, 0x04, 0x09, 0x12, 0x11, 0x60, 0x80, 0x80, 0x40, 0x39, 0x05, 0x05, 0x04, 0x02, 0x01, 0x00 },
		{ 0x3c, 0xc2, 0x01, 0x21, 0x51, 0x22, 0x04, 0x04, 0x02, 0x31, 0x29, 0x19, 0x82, 0x62, 0x14, 0x08, 0x38, 0x47, 0x40, 0x40, 0x20, 0x10, 0x08, 0x10, 0x27, 0x25, 0x27, 0x10, 0x10, 0x11, 0x0e, 0x00 },
		{ 0xc0, 0x20, 0x20, 0x18, 0x04, 0x02, 0x09, 0x15, 0x09, 0x01, 0xce, 0x50, 0x90, 0x20, 0xc0, 0x00, 0x00, 0x01, 0x02, 0x02, 0x02, 0x1c, 0x20, 0x4e, 0x4a, 0x4e, 0x40, 0x39, 0x05, 0x04, 0x08, 0x07 }
	},
	{
		{ 0x00, 0x00, 0x80, 0x82, 0x74, 0x08, 0xa4, 0x84, 0x84, 0xa4, 0x08, 0x74, 0x82, 0x80, 0x00, 0x00, 0x16, 0x05, 0x0a, 0x28, 0x09, 0x12, 0x52, 0x12, 0x12, 0x52, 0x12, 0x09, 0x28, 0x0a, 0x05, 0x16 },
		{ 0x00, 0xe0, 0x50, 0x30, 0x10, 0x60, 0x90, 0x48, 0x84, 0x17, 0x04, 0x48, 0x10, 0xe0, 0x40, 0x40, 0x05, 0x10, 0x03, 0x44, 0x08, 0x90, 0x21, 0xa2, 0x42, 0x65, 0x54, 0x3a, 0x01, 0x00, 0x00, 0x00 },
		{ 0x00, 0x40, 0x08, 0xe1, 0x1c, 0x03, 0xe5, 0x12, 0xcc, 0x10, 0x50, 0x10, 0x20, 0xd0, 0x08, 0x00, 0x00, 0x02, 0x10, 0x87, 0x38, 0xc0, 0xa7, 0x48, 0x33, 0x08, 0x0a, 0x08, 0x04, 0x0b, 0x10, 0x00 },
		{ 0xa0, 0x08, 0xc0, 0x22, 0x10, 0x09, 0x84, 0x45, 0x42, 0xa6, 0x2a, 0x5c, 0x80, 0x00, 0x00, 0x00, 0x00, 0x07, 0x0a, 0x0c, 0x08, 0x06, 0x09, 0x12, 0x21, 0xe8, 0x20, 0x12, 0x08, 0x07, 0x02, 0x02 }
	},
	{
		{ 0x00, 0x80, 0x40, 0x30, 0x88, 0x04, 0x12, 0x82, 0x82, 0x12, 0x04, 0x88, 0x30, 0x40, 0x80, 0x00, 0x03, 0xc4, 0xa6, 0xb9, 0x90, 0xa0, 0xa1, 0x42, 0x42, 0xa1, 0xa0, 0x90, 0xb9, 0xa6, 0xc4, 0x03 },
		{ 0x00, 0x00, 0x30, 0xc8, 0x24, 0x24, 0x14, 0xc4, 0x22, 0x42, 0x8a, 0x02, 0x14, 0x08, 0xf0, 0x00, 0x07, 0x09, 0x11, 0x36, 0x48, 0x90, 0x90, 0xe0, 0x11, 0x11, 0x2c, 0x22, 0x10, 0x0f, 0x00, 0x00 },
		{ 0x7e, 0x82, 0x6c, 0x18, 0x08, 0x06, 0x85, 0x49, 0x92, 0x04, 0x08, 0x48, 0x10, 0x20, 0xc0, 0x00, 0x7e, 0x41, 0x36, 0x18, 0x10, 0x60, 0xa1, 0x92, 0x49, 0x20, 0x10, 0x12, 0x08, 0x04, 0x03, 0x00 },
		{ 0xe0, 0x90, 0x88, 0x6c, 0x12, 0x09, 0x09, 0x07, 0x88, 0x88, 0x34, 0x44, 0x08, 0xf0, 0x00, 0x00, 0x00, 0x00, 0x0c, 0x13, 0x24, 0x24, 0x28, 0x23, 0x44, 0x42, 0x41, 0x50, 0x24, 0x10, 0x0f, 0x00 }
	},
	{
		{ 0x3c, 0xe4, 0x44, 0x44, 0x7c, 0x24, 0x20, 0x20, 0x6e, 0x3a, 0x02, 0xf2, 0xce, 0x00, 0x00, 0x00, 0x70, 0x8f, 0xa8, 0xa8, 0x78, 0x28, 0x78, 0xa9, 0x8a, 0x9a, 0x6a, 0x4f, 0x89, 0x90, 0xa0, 0xc0 },
		{ 0xc0, 0x60, 0x70, 0x98, 0x0c, 0x07, 0x9f, 0x13, 0x61, 0x52, 0x8c, 0x48, 0x30, 0x98, 0xc8, 0x70, 0x03, 0x02, 0x0f, 0x0b, 0x09, 0x26, 0x5c, 0x85, 0xfa, 0x04, 0x04, 0x06, 0x03, 0x01, 0x00, 0x00 },
		{ 0x8e, 0x51, 0xfd, 0x51, 0xfe, 0x02, 0x02, 0x82, 0x02, 0x1e, 0xf3, 0x11, 0x11, 0x3f, 0x00, 0x00, 0xf3, 0x8c, 0x44, 0x22, 0x1f, 0x08, 0x0f, 0x18, 0x18, 0x19, 0x0b, 0x0a, 0x13, 0x11, 0x1f, 0x00 },
		{ 0x80, 0x40, 0x20, 0x40, 0x5c, 0xe4, 0x2f, 0x9d, 0x49, 0x07, 0x06, 0xcc, 0x58, 0x70, 0xe0, 0xe0, 0x01, 0x01, 0x01, 0x01, 0x01, 0x0e, 0x19, 0x30, 0x64, 0xcb, 0x91, 0xb2, 0x6c, 0x04, 0x02, 0x01 }
	},
	{
		{ 0x40, 0xa0, 0x20, 0xc0, 0x00, 0x00, 0x00, 0x78, 0x84, 0x04, 0x04, 0x54, 0x84, 0x88, 0x88, 0xf4, 0x06, 0x09, 0x10, 0xa1, 0xc2, 0x81, 0x81, 0xa1, 0xd0, 0x90, 0x18, 0x0e, 0x29, 0x10, 0x00, 0x00 },
		{ 0x00, 0x08, 0xec, 0x2a, 0x12, 0x44, 0xb8, 0x80, 0x80, 0x60, 0x10, 0x10, 0x90, 0xe0, 0x00, 0x80, 0x10, 0x1e, 0x21, 0x78, 0x88, 0x08, 0x04, 0x04, 0x2c, 0x38, 0x04, 0x08, 0x10, 0x20, 0x13, 0x0c },
		{ 0xf8, 0x10, 0x88, 0x04, 0x02, 0x01, 0x11, 0xea, 0x0a, 0x89, 0x86, 0x80, 0x80, 0x00, 0x00, 0x00, 0x03, 0x01, 0x10, 0x27, 0x1c, 0x08, 0x08, 0x10, 0xf1, 0x88, 0x80, 0x88, 0x60, 0x9f, 0x00, 0x00 },
		{ 0x10, 0x08, 0x0c, 0x0b, 0x3a, 0xc2, 0x02, 0x04, 0xc4, 0x24, 0x4c, 0x50, 0x4e, 0x24, 0x18, 0x00, 0x00, 0x00, 0x23, 0x52, 0x8b, 0x85, 0x40, 0x40, 0xb1, 0x22, 0x22, 0x1c, 0x00, 0x00, 0x00, 0x00 }
	},
	{
		{ 0x00, 0x00, 0x70, 0xfe, 0x02, 0x7a, 0xca, 0xfa, 0xfa, 0xca, 0x7a, 0x02, 0xfe, 0x70, 0x00, 0x00, 0x00, 0x0e, 0x0d, 0xc2, 0xa1, 0xd6, 0xa8, 0x11, 0x11, 0xa8, 0xd6, 0xa1, 0xc2, 0x0d, 0x0e, 0x00 },
		{ 0x00, 0x70, 0x68, 0x38, 0xa8, 0x78, 0x0c, 0xf6, 0xdb, 0xed, 0x7d, 0xba, 0xf4, 0x68, 0x90, 0xe0, 0x3c, 0x36, 0xca, 0xc7, 0xa8, 0xd0, 0x70, 0x11, 0x09, 0x65, 0x7d, 0x55, 0x3e, 0x03, 0x01, 0x00 },
		{ 0x78, 0x28, 0x50, 0xa0, 0x46, 0x26, 0x2a, 0x94, 0xc8, 0xec, 0xac, 0xac, 0xe8, 0x08, 0xf8, 0x00, 0x1e, 0x14, 0x0a, 0x05, 0x62, 0x64, 0x54, 0x29, 0x13, 0x37, 0x35, 0x35, 0x17, 0x10, 0x1f, 0x00 },
		{ 0x3c, 0x6c, 0x53, 0xe3, 0x15, 0x0b, 0x0e, 0x88, 0x90, 0xa6, 0xbe, 0xaa, 0x7c, 0xc0, 0x80, 0x00, 0x00, 0x0e, 0x16, 0x1c, 0x15, 0x1e, 0x30, 0x6f, 0xdb, 0xb7, 0xbe, 0x5d, 0x2f, 0x16, 0x09, 0x07 }
	}
};

unsigned char skullicons[17][8] PROGMEM = {
	{ 0x7c, 0xc2, 0xd5, 0x51, 0xd5, 0xc2, 0x7c, 0x00 },
	{ 0xfe, 0x81, 0xa5, 0xa1, 0xa5, 0x99, 0xe6, 0x00 },
	{ 0x70, 0xb8, 0xc6, 0x95, 0x95, 0xc6, 0xb8, 0x70 },
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	{ 0x55, 0xaa, 0x55, 0xaa, 0x55, 0xaa, 0x55, 0xaa }
};
#define SKULL_BLANK		16

unsigned char uparrow[] PROGMEM = {
	0x08, 0x0c, 0x0e, 0x0f, 0x0f, 0x0e, 0x0c, 0x08
};

unsigned char smallarrow[] PROGMEM = {
	0x08, 0x1c, 0x3e, 0x7f
};

signed char bobbing[16] = {
	0, 0, -1, -1, -1, -1, -1, -1,
	0, 0, 1, 1, 1, 1, 1, 1
};

#define STAT_FLOATABILITY	0
#define STAT_STABILITY		1
#define STAT_BOUNCE			2

char statlabels[3][7] {
	"FLOATY",
	"STABLE",
	"BOUNCE"
};

struct skull {
	char name[8];
	signed char stats[3];
};

skull skulls[16] = {
	{ "EGGSTER", { 6,  3,  0  } },
	{ "GRIMMUS", { 3,  8,  2  } },
	{ "BOOSTER", { 9,  7,  1  } },
	{ "CRAWLEE", { 6,  10, 0  } },

	{ "TRIANGY", { 4,  9,  5  } },
	{ "ROOK   ", { 2,  10, 4  } },
	{ "CHICKY ", { 8,  3,  7  } },
	{ "KOGRE  ", { 3,  7,  4  } },

	{ "TEVE-O ", { 5,  3,  4  } },
	{ "DUSTY  ", { 6,  4,  4  } },
	{ "BLEBBBB", { 4,  6,  5  } },
	{ "YUEFFOE", { 10, 0,  10 } },
	
	{ "BLUBBS ", { 2,  8,  9  } },
	{ "TOMAS  ", { 1,  8,  3  } },
	{ "CLEVER ", { 5,  4,  9  } },
	{ "C. DUDE", { 5,  5,  5  } }
};

#define PLAYER_1		0
#define PLAYER_2		1
#define PLAYER_BUFFER	2

char teams[3][4] = {
	{ SKULL_BLANK, SKULL_BLANK, SKULL_BLANK, SKULL_BLANK },
	{ SKULL_BLANK, SKULL_BLANK, SKULL_BLANK, SKULL_BLANK },
	{ SKULL_BLANK, SKULL_BLANK, SKULL_BLANK, SKULL_BLANK }
};

signed char currentskull = 0;
signed char opposingskull = -1;
signed char playerturn = 0;
signed char picking = 0;
signed char cpu = false;
signed char roundstate = 0;
signed char bounces = 0;
signed char upwardflick = 0;
signed char forwardflick = 0;
signed char rotationfactor = 0;
float fall = 0;
float speed = 0;
signed char direction = 1;
signed char rotation = 0;
signed char splat = 0;
boolean newhighscore = false;
unsigned char highscore = 0;
unsigned char score = 0;
int height = 0;
int distance = 0;
int opposingheight = 0;
int opposingdistance = 0;
float opposingspeed = 0;
float opposingfall = 0;
signed char opposingrotation = 0;
boolean hit = false;
Rect rect1;
Rect rect2;

#define SKULL_Y_OFFSET		40
#define SKULL_X_OFFSET		44
#define MAX_DISTANCE		1000
#define MAX_MOVE_DISTANCE	(MAX_DISTANCE - 128 + SKULL_X_OFFSET)
#define FRICTION_AIR		0.05f
#define FRICTION_GROUND		1.5
#define FRICTION_BOUNCE		1.1
#define FRICTION_GRAVITY	0.7f
#define MIN_SPEED			14
#define MAX_SPEED_RANGE		6
#define MIN_FALL			7
#define MAX_FALL_RANGE		6
#define MAX_ROTATION		160

#define ANGLE_COUNT			13

signed char angles[ANGLE_COUNT][4] = {
	{ -2, -6, 8, -12 },
	{ -1, -5, 9, -10 },
	{ -1, -4, 9, -8 },
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	{ -2, 6, 8, 12 }
};

signed char validhits[ANGLE_COUNT] = {
	-100,
	-100,
	-3,
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	-100,
	-100
};

#define PARTICLE_X			0
#define PARTICLE_Y			1
#define PARTICLE_LIFE		2
#define PARTICLE_COUNT		20
#define PARTICLE_MAX_LIFE	11

struct particle {
	int x;
	signed char y;
	signed char life;
	signed char offset;
};

particle particles[PARTICLE_COUNT] = { };

unsigned char particlebitmaps[PARTICLE_MAX_LIFE][8] PROGMEM = {
	{ 0x00, 0x00, 0x00, 0x08, 0x10, 0x00, 0x00, 0x00 },
	{ 0x00, 0x00, 0x00, 0x18, 0x18, 0x00, 0x00, 0x00 },
	{ 0x00, 0x00, 0x14, 0x00, 0x00, 0x28, 0x00, 0x00 },
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	{ 0x00, 0x04, 0x04, 0x40, 0x40, 0x10, 0x08, 0x00 }
};

void makeparticle(signed char x, signed char y) {
	for(signed char i = 0; i < PARTICLE_COUNT; i++) {
		if(particles[i].life == 0) {
			particles[i].offset = random(0, PARTICLE_MAX_LIFE);
			particles[i].life = random(0, PARTICLE_MAX_LIFE);
			particles[i].x = x;
			particles[i].y = y;
			return;
		}
	}
}

void resetparticles() {
	for(signed char i = 0; i < PARTICLE_COUNT; i++) {
		particles[i].life = 0;
	}
}

void resetteam(signed char team) {
	for(signed char i = 0; i < 4; i++) {
		teams[team][i] = SKULL_BLANK;
	}
}

signed char teamhas(signed char team, signed char skull) {
	signed char count = 0;

	for(signed char i = 0; i < 4; i++) {
		if(teams[team][i] == skull) {
			count++;
		}
	}
	return count;
}

void randomizeteam(signed char team1, signed char team2) {
	for(signed char i = 0; i < 4; i++) {
		signed char picked = picked = random(0, 16);
		while(teamhas(team1, picked) > 0 || teamhas(team2, picked) > 0) {
			picked = random(0, 16);
		}
		teams[team1][i] = picked;
	}
}

signed char randomskull(signed char team) {
	signed char picked = random(0, 4);
	while(teams[team][picked] == SKULL_BLANK) {
		picked = random(0, 4);
	}

	return picked;
}

signed char cpupickopponent() {
	if(random(0, 6 + teamhas(PLAYER_1, SKULL_BLANK)) < random(5, 7)) {
		return randomskull(PLAYER_1);
	} else {
		return -1;
	}
}

void resetpicker() {
	cursor = 0;
	delayedcursor = 0;
}

void newgame() {
	currentskull = 0;
	
	newhighscore = false;
	score = 0;
	nextmatch();
	playerturn = PLAYER_1;

	resetteam(PLAYER_1);
	resetteam(PLAYER_2);
	resetteam(PLAYER_BUFFER);
	
	randomizeteam(PLAYER_BUFFER, PLAYER_1);

	resetpicker();
}

void startgame() {
	currentskull = 0;
	playerturn = PLAYER_1;
}

void nextmatch() {
	currentskull = 0;

	resetteam(PLAYER_2);
	//resetteam(PLAYER_BUFFER);

	for(signed char i = 0; i < 4; i++) {
		teams[PLAYER_1][i] = teams[PLAYER_BUFFER][i];
	}

	resetround();
	playerturn = PLAYER_2;
}

void resetround() {
	cursor = 0;
	roundstate = 0;
	bounces = 0;
	upwardflick = 0;
	forwardflick = 0;
	rotationfactor = 0;
	rotation = 0;
	speed = 0;
	distance = 0;
	height = 0;
	direction = 1;
	fall = 0;
	opposingskull = -1;
	opposingheight = 0;
	opposingdistance = 0;
	opposingspeed = 0;
	opposingrotation = 0;
	hit = false;
}

void nextround() {
	resetround();
	resetparticles();
	playerturn = !playerturn;
	cursor = 0;
	delayedcursor = 0;
	teamscroll(playerturn, 3, true);
}

void sound(int pitch, unsigned char duration) {
	if(arduboy.audio.enabled()) {
		beep.tone(beep.freq(pitch), duration);
	}
}

void tostate(signed char state, void (*after)()) {
	if(arduboy.justPressed(A_BUTTON)) {
		sound(SOUND_MENU_NEXT, SOUND_SHORT);
		gamestate = state;

		if(after != nullptr) {
			after();
		}
	}
}

void scroll(signed char max) {
	if(arduboy.justPressed(UP_BUTTON)) {
		cursor--;
	}
	if(arduboy.justPressed(DOWN_BUTTON)) {
		cursor++;
	}
	if(cursor < 0) {
		cursor = 0;
	}
	if(cursor > max) {
		cursor = max;
	}
}

void teamscroll(signed char team, signed char max, bool override) {
	if(override || arduboy.justPressed(UP_BUTTON)) {
		cursor--;
		if(cursor < 0) {
			cursor = 0;
		}
		while(cursor > 0 && teams[team][cursor] == SKULL_BLANK) {
			cursor--;
		}
		while(cursor < max && teams[team][cursor] == SKULL_BLANK) {
			cursor++;
		}
	}
	if(arduboy.justPressed(DOWN_BUTTON)) {
		cursor++;
		if(cursor > max) {
			cursor = max;
		}
		while(cursor < max && teams[team][cursor] == SKULL_BLANK) {
			cursor++;
		}
		while(cursor > 0 && teams[team][cursor] == SKULL_BLANK) {
			cursor--;
		}
	}
}

void drawhallway() {
	if(screenshake > 0) {
		screenshake--;
	}

	signed char xoffset = random(0 - screenshake, screenshake);
	signed char yoffset = random(0 - screenshake, screenshake);


	int drawdistance = (distance < MAX_MOVE_DISTANCE ? distance : MAX_MOVE_DISTANCE);

	arduboy.drawFastHLine(xoffset + 0, yoffset + 50, 128, WHITE);

	for(signed char i = 0; i < 5; i++) {
		arduboy.drawFastVLine(xoffset + 16 + 32 * i - drawdistance % 32, yoffset - 10, 60, WHITE);
		
		arduboy.drawLine(xoffset + 16 + 32 * i - drawdistance % 32, yoffset + 50, (16 + 32 * i - drawdistance % 32) * 2 - 64, 64, WHITE );
	}

	for(signed char i = 0; i < PARTICLE_COUNT; i++) {
		if(particles[i].life > 0) {
			if(distance < MAX_MOVE_DISTANCE) {
				particles[i].x -= direction * speed;
			}

			if(particles[i].x < -64) {
				particles[i].life = 0;
			} else {				
				arduboy.drawBitmap(xoffset + particles[i].x, yoffset + particles[i].y, particlebitmaps[(particles[i].life + particles[i].offset) % PARTICLE_MAX_LIFE], 8, 8, WHITE);

				particles[i].life--;
			}
		}
	}

	rect1 = { -1, -1, 1, 1 };
	rect2 = { 120, 120, 1, 1 };

	if(distance < MAX_DISTANCE) {
		signed char x = SKULL_X_OFFSET + (MAX_MOVE_DISTANCE > distance ? 0 : distance - MAX_MOVE_DISTANCE);
		signed char y = SKULL_Y_OFFSET - height;

		if(speed > 0) {
			if(random(0, 8 - (speed / 2)) == 0) {
				makeparticle(x, y + 4);
			}
		}
		
		arduboy.fillRect(xoffset + x - 1, yoffset + y - 1, 18, 18, BLACK);
		flipbitmap((rotation / 10) >= 8, (direction == 1 ? ((rotation / 10) >= 8) : ((rotation / 10) < 8)), xoffset + x, yoffset + y, skullbitmaps[teams[playerturn][currentskull]][((rotation / 10) / 2) % 4], 16, 16, WHITE);

		rect1 = { xoffset + x - 1, yoffset + y - 1, 18, 18 };
	}

	if(opposingskull > -1) {
		if(distance > MAX_MOVE_DISTANCE - WIDTH && opposingdistance < (WIDTH - SKULL_X_OFFSET - 16)) {
			signed char x = WIDTH - SKULL_X_OFFSET - 16 - (MAX_MOVE_DISTANCE > distance ? distance - MAX_MOVE_DISTANCE : 0);
			signed char y = SKULL_Y_OFFSET;

			arduboy.fillRect(xoffset + x + opposingdistance - 1, yoffset + y + opposingheight - 1, 18, 18, BLACK);
			flipbitmap(!((opposingrotation / 10) >= 8), !((opposingrotation / 10) < 8), xoffset + x + opposingdistance, yoffset + y + opposingheight, skullbitmaps[teams[!playerturn][opposingskull]][((opposingrotation / 10) / 2) % 4], 16, 16, WHITE);

			rect2 = { xoffset + x - 1, yoffset + y - 1, 18, 18 };
		}
		
		if(rect1.width > 1 && rect2.width > 1) {
			if(!hit && speed > 0) {
				if(arduboy.collide(rect1, rect2) && (random(0, bounces) == 0 || random(0, 11) > skulls[teams[!playerturn][opposingskull]].stats[STAT_STABILITY])) {
					
					hit = true;
					screenshake = 15;
					if(random(0, 3) == 0) {
						direction = -1;
					}
					rotationfactor = random(1, 10);
					opposingspeed = speed;
					opposingfall = random(0, fall);
					opposingheight = 0;
					opposingdistance = 0;
					opposingrotation = random(0, MAX_ROTATION);
					
					sound(SOUND_HIT, SOUND_MED);
				}
			}
		}

		if(hit) {
			opposingheight += abs(opposingfall);
			opposingdistance += speed;
		}
	}
}

void launching() {
	if(speed > 0) {
		rotation += rotationfactor;
		if(rotation > MAX_ROTATION) {
			rotation = rotation - MAX_ROTATION;
		}
		if(rotation < 0) {
			rotation = rotation + MAX_ROTATION;
		}

		distance += direction * speed;
		speed -= FRICTION_AIR;

		if(fall >= 0) {
			fall += FRICTION_GRAVITY - 0.6f * (skulls[teams[playerturn][currentskull]].stats[STAT_FLOATABILITY] / 10.0f);
		} else {
			fall += FRICTION_GRAVITY;
		}
		height -= fall;

		if(height <= 0) {
			screenshake = 5;
			bounces++;
			rotationfactor -= random(-1, 2);
			if(rotationfactor < 0) {
				rotationfactor = 0;
			}
			height = 0;
			speed -= FRICTION_GROUND;
			fall = 0 - fall;
			if(0 - fall > FRICTION_BOUNCE) {
				fall += FRICTION_BOUNCE;
				fall -= 0.7f * (skulls[teams[playerturn][currentskull]].stats[STAT_BOUNCE] / 10.0f);
				sound(SOUND_BOUNCE, SOUND_SHORT);
			} else {
				fall = 0;
			}
		}
	} else {
		rotationfactor = 0;
		speed = 0;
		fall = 0;
		height = 0;
		screenshake = 0;
	}
}

void win() {
	if(cpu && playerturn == PLAYER_1 && score != 255) {
		score++;
	}
	gamestate = STATE_RESULT;
}

void flying() {
	launching();
	drawhallway();
	
	// arduboy.fillRect(0, 0, 20, 6, WHITE);
	// tinyfont.setCursor(1, 1);
	// tinyfont.print(int(distance));

	if(speed == 0) {
		if(!hit) {
			arduboy.fillRect(51, 4 + bobbing[bob], 35, 15, BLACK);
			arduboy.drawBitmap(51, 4 + bobbing[bob], misslabel, 35, 16, WHITE);
		} else {
			arduboy.fillRect(51, 4 + bobbing[bob] - 1, 35, 17, BLACK);
			arduboy.drawBitmap(51, 4 + bobbing[bob], hitlabel, 35, 16, WHITE);
		}

		tostate(STATE_PICKAIM, []() {
			if(hit) {
				teams[!playerturn][opposingskull] = SKULL_BLANK;
			}
			if(teamhas(!playerturn, SKULL_BLANK) == 4) {
				win();
			} else {
				nextround();
			}
		});
	}
}

void pickaim() {
	teamscroll(playerturn, 3, false);

	drawstats(playerturn);
	drawlineup(playerturn, cursor, 1);
	drawlineup(!playerturn, -1, WIDTH - 16 - 1);

	tostate(STATE_AIM, []() {
		currentskull = cursor;
		cursor = random(3, 9);
	});
}

void aiming() {
	scroll(ANGLE_COUNT - 1);

	arduboy.drawLine(
		angles[cursor][0] + (16 + 1),
		angles[cursor][1] + (8 + 16 * currentskull),
		
		angles[cursor][2] + (16 + 1),
		angles[cursor][3] + (8 + 16 * currentskull),
		
		WHITE);

	drawlineup(playerturn, -1, 1);
	drawlineup(!playerturn, -1, WIDTH - 16 - 1);

	arduboy.drawBitmap(47, 24 + bobbing[bob], aimlabel, 34, 16, WHITE);

	tostate(STATE_FLICK, []() {
		opposingskull = currentskull + validhits[cursor];
		if(opposingskull > 3 || opposingskull < 0) {
			opposingskull = -1;
		}
		if(teams[!playerturn][opposingskull] == SKULL_BLANK) {
			opposingskull = -1;
		}

		flickstate = 0;
		flickcursor = random(0, 40);
		flickmovement = -1;
		if(random(0, 1)) {
			flickmovement = 1;
		}
	});
}

void flicking() {
	drawhallway();
	
	arduboy.fillRect(51, 4 + bobbing[bob], 35, 12, BLACK);
	arduboy.drawBitmap(51, 4 + bobbing[bob], flicklabel, 35, 16, WHITE);


	flickcursor += flickmovement;

	if(flickcursor >= 40) {
		flickcursor = 40;
		flickmovement = -1;
	} else if(flickcursor <= 0) {
		flickcursor = 0;
		flickmovement = 1;
	}

	if(flickstate == 0) {
		arduboy.fillRect(8 - 1, 3 - 1, 16 + 1, 54 + 1, BLACK);
		arduboy.drawBitmap(8, 3, vlaunch, 16, 54, WHITE);
		arduboy.fillRect(13, 11 + (40 - flickcursor), 7, flickcursor, WHITE);
		
		
		if(cpu && playerturn == PLAYER_2) {
			if(flickcursor > 30 && random(0, 20) == 0) {
				sound(SOUND_MENU_NEXT, SOUND_SHORT);
				upwardflick = flickcursor / 2;

				flickstate = 1;
				flickcursor = random(0, 40);
				gamestate = STATE_FLICK;
			}
		} else {
			tostate(STATE_FLICK, []() {
				upwardflick = flickcursor / 2;

				flickstate = 1;
				flickcursor = random(0, 40);
			});
		}
	} else {
		arduboy.fillRect(37 - 1, 19 - 1, 54 + 1, 16 + 1, BLACK);
		arduboy.drawBitmap(37, 19, hlaunch, 54, 16, WHITE);
		arduboy.fillRect(43, 24, flickcursor, 7, WHITE);

		if(cpu && playerturn == PLAYER_2) {
			if(flickcursor > 20 && random(0, 20) == 0) {
				sound(SOUND_MENU_NEXT, SOUND_SHORT);

				forwardflick = flickcursor / 2;
				calcflick();

				flickstate = 0;
				flickcursor = random(0, 40);
				gamestate = STATE_FLYING;
			}
		} else {
			tostate(STATE_FLYING, []() {
				forwardflick = flickcursor / 2;
				calcflick();

				flickstate = 0;
				flickcursor = random(0, 40);
			});
		}
	}
}

void calcflick() {
	fall = 0 - (MIN_FALL + (upwardflick / 20.0f) * MAX_FALL_RANGE);
	speed = MIN_SPEED + (forwardflick / 20.0f) * MAX_SPEED_RANGE;

	rotationfactor = random(1, 10);
	rotation = random(1, MAX_ROTATION);
}

void showvs() {
	currentskull = 4;
	drawteam(3, PLAYER_1);
	drawteam(79, PLAYER_2);

	arduboy.drawBitmap(56, 24, vslabel, 16, 16, WHITE);

	tostate(STATE_PICKAIM, startgame);
}

void showscore() {
	if(newhighscore) {
		arduboy.drawBitmap(46, 4 + bobbing[bob], newlabel, 29, 16, WHITE);
	}

	arduboy.drawBitmap(28, 14 + bobbing[bob], highscorelabel, 73, 16, WHITE);

	if(!newhighscore || (frame >= 5)) {
		arduboy.setCursor(58, 38);
		arduboy.print(int(highscore));
	}
}

uint8_t reverse_byte(uint8_t c) {
	c = ((c >> 1) & 0x55) | ((c << 1) & 0xAA);
	c = ((c >> 2) & 0x33) | ((c << 2) & 0xCC);
	c = (c >> 4) | (c << 4);

	return c;
}

void flipbitmap(bool mirror, bool flip, int16_t x, int16_t y, uint8_t *bitmap, uint8_t w, uint8_t h, uint8_t color) {
	if (x + w <= 0 || x > WIDTH - 1 || y + h <= 0 || y > HEIGHT - 1)
		return;

	int yOffset = abs(y) % 8;
	int sRow = y / 8;
	if(y < 0) {
		sRow--;
		yOffset = 8 - yOffset;
	}

	int rows = h / 8;
	if (h % 8 != 0) rows++;
	for (int row = 0; row < rows; row++) {
		int a = row;
		if(flip) {
			a = rows - row - 1;
		}
		int bRow = sRow + a;
		if (bRow > (HEIGHT/8)-1) break;
		if (bRow > -2) {
			for (int iCol = 0; iCol<w; iCol++) {
				int c = iCol;
				if(mirror) {
					c = w - iCol;
				}
				if (c + x > (WIDTH - 1)) break;
				if (c + x >= 0) {
					uint8_t val;
					if (bRow >= 0) {
						val = pgm_read_byte(bitmap + (row * w) + iCol);
						if(flip) {
							val = reverse_byte(val);
						} else {
							reverse_byte(val);
						}
						val = val << yOffset;
						if (color == WHITE)
							arduboy.sBuffer[(bRow * WIDTH) + x + c] |= val;
						else if (color == BLACK)
							arduboy.sBuffer[(bRow * WIDTH) + x + c] &= ~(val);
						else
							arduboy.sBuffer[(bRow * WIDTH) + x + c] ^= val;
					}
					if (yOffset && bRow < (HEIGHT / 8) - 1 && bRow > -2) {
						val = pgm_read_byte(bitmap + (row * w) + iCol);
						if(flip) {
							val = reverse_byte(val);
						} else {
							reverse_byte(val);
						}
						val = val >> (8 - yOffset);
						if (color == WHITE)
							arduboy.sBuffer[((bRow + 1) * WIDTH) + x + c] |= val;
						else if (color == BLACK)
							arduboy.sBuffer[((bRow + 1) * WIDTH) + x + c] &= ~(val);
						else
							arduboy.sBuffer[((bRow + 1) * WIDTH) + x + c] ^= val;
					}
				}
			}
		}
	}
}

void credits() {
	arduboy.drawBitmap(8, 8, me, 48, 48, WHITE);
	arduboy.setCursor(75, 8);
	arduboy.print(F("Jonathan"));
	arduboy.setCursor(87, 18);
	arduboy.print(F("Holmes"));
	arduboy.setCursor(86, 38);
	arduboy.print(F("@crait"));
	arduboy.setCursor(68, 49);
	arduboy.print(F("crait.net"));

	tostate(STATE_MENU, nullptr);
}

void drawteam(signed char xoffset, signed char team) {
	arduboy.drawBitmap(xoffset + 15, OFFSET_Y_TEAM + bobbing[bob] + 5, teamlabel, 33, 16, WHITE);
	if(team == PLAYER_2 && cpu) {
		arduboy.drawBitmap(xoffset - 2, OFFSET_Y_TEAM + bobbing[bob] + 5, cpulabel, 18, 16, WHITE);
	} else {
		arduboy.drawBitmap(xoffset + 1, OFFSET_Y_TEAM + bobbing[bob] + 5, playerlabel, 14, 16, WHITE);
		arduboy.drawBitmap(xoffset + 3, OFFSET_Y_TEAM + bobbing[bob] + 8, menulabels[team], 11, 8, BLACK);
	}

	arduboy.fillRect(xoffset, OFFSET_Y_TEAM + 24, 46, 10, WHITE);
	for(signed char i = 0; i < 4; i++) {
		arduboy.drawBitmap(xoffset + 1 + i * 12, OFFSET_Y_TEAM + 25, skullicons[teams[team][i]], 8, 8, INVERT);
	}
	if(currentskull < 4) {
		arduboy.drawBitmap(xoffset + 1 + currentskull * 12, OFFSET_Y_TEAM + 36, uparrow, 8, 8, WHITE);
	}
}

void slidecursor() {
	if(delayedcursor == cursor * 14) {
		return;
	}

	if(delayedcursor < cursor * 14) {
		delayedcursor += 2;
	} else {
		delayedcursor -= 2;
	}
}

void drawstats(signed char team) {
	slidecursor();

	tinyfont.setTextColor(WHITE);
	tinyfont.setCursor(OFFSET_X_STATS, delayedcursor + OFFSET_Y_STATS);
	tinyfont.print(skulls[teams[team][cursor]].name);
	
	arduboy.fillRect(OFFSET_X_STATS, delayedcursor + OFFSET_Y_STATS + 5, 43, 16, WHITE);
	arduboy.drawBitmap(OFFSET_X_STATS - 4, cursor * 3 + delayedcursor + OFFSET_Y_STATS + 5, smallarrow, 4, 8, WHITE);

	for(signed char i = 0; i < 3; i++) {
		tinyfont.setTextColor(BLACK);

		tinyfont.setCursor(OFFSET_X_STATS + 1, delayedcursor + OFFSET_Y_STATS + 6 + 5 * i);
		tinyfont.print(statlabels[i]);
		arduboy.fillRect(OFFSET_X_STATS + 31, delayedcursor + OFFSET_Y_STATS + 6 + 5 * i, skulls[teams[team][cursor]].stats[i] + 1, 4, BLACK);
	}
}

void drawlineup(signed char team, signed char hightlight, signed char xoffset) {
	for(signed char i = 0; i < 4; i++) {
		if(teams[team][i] == SKULL_BLANK) {
			continue;
		}

		if(hightlight == i) {
			arduboy.drawBitmap(xoffset, 16 * i + bobbing[bob], skullbitmaps[teams[team][i]][0], 16, 16, WHITE);
		} else {
			arduboy.drawBitmap(xoffset + 4, 4 + 16 * i, skullicons[teams[team][i]], 8, 8, WHITE);
		}
	}
}

void teampicker() {
	scroll(3);

	drawteam(77, playerturn);

	drawstats(PLAYER_BUFFER);
	drawlineup(PLAYER_BUFFER, cursor, 1);

	tostate(STATE_CHARS, []() {
		teams[playerturn][currentskull] = teams[PLAYER_BUFFER][cursor];
		currentskull++;

		if(currentskull > 3) {
			if(playerturn == PLAYER_2) {
				gamestate = STATE_VS;
			}
			playerturn = !playerturn;
			currentskull = 0;	
		}
		
		resetpicker();

		randomizeteam(PLAYER_BUFFER, playerturn);
	});
}

void mainmenu() {
	scroll(2);

	switch(cursor) {
		case MENU_1P:
			tostate(STATE_SCORE, []() {
				cpu = true;
				newgame();
			});
			break;
		case MENU_2P:
			tostate(STATE_CHARS, []() {
				cpu = false;
				newgame();
			});
			break;
		case MENU_SOUND:
			if(arduboy.justPressed(A_BUTTON)) {
				arduboy.audio.toggle();
				arduboy.audio.saveOnOff();
				sound(SOUND_MENU_NEXT, SOUND_SHORT);
			}
			break;
	}

	if(splat > 20) {
		arduboy.drawBitmap(31, bobbing[bob], logo, 97, 64, WHITE);
	} else if(splat > 10) {
		arduboy.drawBitmap(67, 21, splat2, 37, 16, WHITE);
	} else {
		arduboy.drawBitmap(72, 26, splat1, 23, 8, WHITE);
	}


	for(signed char i = 0; i < 3; i++) {
		if(i == cursor) {
			arduboy.drawBitmap(OFFSET_X_MENU - 9, OFFSET_Y_MENU + 9 * i, menucap, 3, 8, WHITE);
			arduboy.drawBitmap(OFFSET_X_MENU + 17, OFFSET_Y_MENU + 9 * i, menucap, 3, 8, WHITE);
			arduboy.fillRect(OFFSET_X_MENU - 6, OFFSET_Y_MENU + 9 * i, 23, 8, WHITE);
		}
	}
	
	arduboy.drawBitmap(OFFSET_X_MENU, OFFSET_Y_MENU + 9 * 0, menulabels[MENU_1P], 11, 8, cursor != MENU_1P);
	arduboy.drawBitmap(OFFSET_X_MENU, OFFSET_Y_MENU + 9 * 1, menulabels[MENU_2P], 11, 8, cursor != MENU_2P);
	arduboy.drawBitmap(OFFSET_X_MENU, OFFSET_Y_MENU + 9 * 2, menulabels[MENU_SOUND + arduboy.audio.enabled()], 11, 8, cursor != MENU_SOUND);

	splat++;
	if(splat > 24) {
		splat = 24;
	}
}

void result() {
	cursor = 0;

	arduboy.drawBitmap(40 + 15, 20 + bobbing[bob] + 5, winslabel, 39, 16, WHITE);

	if(cpu) {
		if(playerturn == PLAYER_1) {
			tostate(STATE_CHARS, nextmatch);
			arduboy.drawBitmap(40 + 1, 20 + bobbing[bob] + 5, playerlabel, 14, 16, WHITE);
			arduboy.drawBitmap(40 + 3, 20 + bobbing[bob] + 8, menulabels[playerturn], 11, 8, BLACK);
		} else {
			arduboy.drawBitmap(40 - 2, 20 + bobbing[bob] + 5, cpulabel, 18, 16, WHITE);
			tostate(STATE_RESULTSCORE, []() {
				if(score > highscore) {
					newhighscore = true;
					highscore = score;
					EEPROM.put(SAVELOCATION, highscore);
				}
			});
		}
	} else {
		arduboy.drawBitmap(40 + 1, 20 + bobbing[bob] + 5, playerlabel, 14, 16, WHITE);
		arduboy.drawBitmap(40 + 3, 20 + bobbing[bob] + 8, menulabels[playerturn], 11, 8, BLACK);
		tostate(STATE_INTRO, nullptr);
	}
}

void gameplay() {
	arduboy.setFrameRate(FRAMERATE);
	if(screenshake > 0) {
		screenshake--;
	}
	switch(gamestate) {
		case STATE_INTRO:
			credits();
			break;
		case STATE_MENU:
			mainmenu();
			break;
		case STATE_SCORE:
			showscore();
			tostate(STATE_CHARS, nullptr);
			break;
		case STATE_CHARS:
			if(playerturn == PLAYER_2 && cpu) {
				//resetteam(PLAYER_BUFFER);
				for(signed char i = 0; i < 4; i++) {
					teams[PLAYER_BUFFER][i] = teams[PLAYER_1][i];
				}
				
				randomizeteam(PLAYER_2, PLAYER_2);
				gamestate = STATE_VS;
			} else {
				teampicker();
			}
			break;
		case STATE_VS:
			showvs();
			break;
		case STATE_AIM:
			if(cpu && playerturn == PLAYER_2) {
				opposingskull = cpupickopponent();

				flickstate = 0;
				flickcursor = random(0, 40);
				flickmovement = -1;
				if(random(0, 1)) {
					flickmovement = 1;
				}
				gamestate = STATE_FLICK;
			} else {
				aiming();
			}
			break;
		case STATE_PICKAIM:
			if(cpu && playerturn == PLAYER_2) {
				currentskull = randomskull(PLAYER_2);
				gamestate = STATE_AIM;
			} else {
				pickaim();
			}
			break;
		case STATE_FLICK:
			arduboy.setFrameRate(FRAMERATE + 10);
			flicking();
			break;
		case STATE_FLYING:
			arduboy.setFrameRate(12);
			flying();
			break;
		case STATE_RESULT:
			result();
			break;
		case STATE_RESULTSCORE:
			showscore();
			tostate(STATE_INTRO, nullptr);
			break;
	}
}

void setup() {
	arduboy.begin();
	arduboy.setFrameRate(FRAMERATE);
	arduboy.initRandomSeed();
	beep.begin();
	arduboy.setRGBled(0, 0, 0);

	EEPROM.get(SAVELOCATION, highscore);
}

void loop() {
	if(!arduboy.nextFrame()) {
		return;
	}

	frame++;
	if(frame >= 12) {
		frame = 0;
		bob++;
	}
	if(bob >= 16) {
		bob = 0;
	}

	beep.timer();
	arduboy.pollButtons();
	arduboy.clear();

	gameplay();
	
	arduboy.display();
}
