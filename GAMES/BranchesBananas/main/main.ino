#include "player.h"
#include "branch.h"
#include "banana.h"
#include <Arduboy2.h>
#include <ArduboyTones.h>

#define MAX_BRANCHES 10

Arduboy2 ab;
ArduboyTones sound(ab.audio.enabled);
Player player(&ab, &sound);
Banana banana;
Branch branches[MAX_BRANCHES];
bool animate = true;
int state;
int bananaCount;
int branchCount;
int highScore;
uint64_t playTime;

// LOGO SPRITES
 uint8_t PROGMEM logo_branches[] = {
11, 62,
0x7f, 0xff, 0xff, 0xe6, 0xe6, 0xfe, 0xfe, 0xce, 0xcc, 0xfc, 0xfc, 
0x1c, 0x38, 0x39, 0x39, 0x39, 0xf8, 0xf8, 0xd9, 0x01, 0x01, 0x01, 
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0x1f, 0x3f, 0x39, 0x3c, 0x3e, 0x0e, 0x3e, 0x3c, 0x00, 0x00, 0x00, 
};

 uint8_t PROGMEM logo_and[] = {
11, 62,
0x00, 0x00, 0x00, 0x00, 0x00, 0x00, 0x00, 0x00, 0x00, 0x00, 0x00, 
0x00, 0x00, 0x00, 0x00, 0x00, 0x00, 0x00, 0x00, 0x00, 0x00, 0x00, 
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0x00, 0x00, 0x00, 0x00, 0x00, 0x00, 0x00, 0x00, 0x00, 0x00, 0x00, 
};

 uint8_t PROGMEM logo_bananas[] = {
11, 62,
0xfc, 0xfc, 0xfc, 0x98, 0x98, 0xf8, 0xf8, 0x38, 0x30, 0xf0, 0xf0, 
0xf1, 0xf3, 0x77, 0x77, 0xe7, 0x03, 0xc3, 0xc7, 0x07, 0x07, 0x07, 
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0x07, 0x0f, 0x0e, 0x0f, 0x0f, 0x03, 0x0f, 0x0f, 0x00, 0x00, 0x00, 
};

 uint8_t PROGMEM logo_message[] = {
27, 50,
0x00, 0xc0, 0x20, 0x20, 0x20, 0xe0, 0x20, 0x20, 0x00, 0x00, 0x00, 0x00, 0x00, 0x00, 0x00, 0x00, 0x00, 0x00, 0x00, 0x00, 0x00, 0x41, 0x41, 0x47, 0x49, 0xc9, 0x07, 
0x00, 0x18, 0x24, 0x24, 0x24, 0x18, 0x00, 0x00, 0x00, 0x00, 0x00, 0x0e, 0x92, 0x92, 0x92, 0x8e, 0x02, 0x02, 0x00, 0x00, 0x00, 0x70, 0x08, 0x78, 0x48, 0x31, 0x00, 
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0x00, 0x00, 0x00, 0x00, 0x00, 0x00, 0x00, 0x00, 0x00, 0x00, 0x00, 0x00, 0x00, 0x00, 0x00, 0x00, 0x00, 0x00, 0x00, 0x00, 0x01, 0x02, 0x03, 0x02, 0x02, 0x02, 0x00, 
};

 uint8_t PROGMEM logo_credit[] = {
29, 39,
0x00, 0x1c, 0x82, 0x82, 0x82, 0x02, 0x1c, 0x00, 0x00, 0x00, 0x00, 0x00, 0x47, 0x48, 0x48, 0x46, 0xc1, 0x4e, 0x40, 0x00, 0x00, 0x00, 0x00, 0x00, 0x00, 0x00, 0x00, 0x00, 0x00, 
0x00, 0xc3, 0x24, 0x24, 0x24, 0xc3, 0x00, 0x00, 0x00, 0x00, 0x00, 0x00, 0xe2, 0x12, 0xf2, 0x92, 0x61, 0x00, 0x00, 0x00, 0x00, 0x00, 0x00, 0xc0, 0x40, 0x40, 0xc0, 0x40, 0xc0, 
0x00, 0x31, 0x09, 0x09, 0x09, 0x09, 0x09, 0x09, 0x00, 0x00, 0x00, 0x00, 0x18, 0x84, 0x84, 0x84, 0x04, 0x04, 0x04, 0x00, 0x00, 0x00, 0x60, 0x81, 0xe2, 0x92, 0x91, 0x92, 0x01, 
0x00, 0x49, 0x49, 0x49, 0x49, 0x39, 0x00, 0x01, 0x00, 0x00, 0x00, 0x00, 0xc7, 0x24, 0x24, 0x24, 0xc7, 0x04, 0x04, 0x00, 0x00, 0x00, 0x00, 0x00, 0x00, 0x00, 0x00, 0x00, 0x00, 
0x0c, 0x10, 0x1c, 0x12, 0x12, 0x1c, 0x00, 0x00, 0x00, 0x00, 0x00, 0x00, 0x48, 0x49, 0x49, 0x49, 0x38, 0x00, 0x00, 0x00, 0x00, 0x00, 0x00, 0x00, 0x00, 0x00, 0x00, 0x00, 0x00, 
};

// TREE SPRITES
 uint8_t PROGMEM tree[] = {
8, 3,
0x06, 0x07, 0x07, 0x07, 0x05, 0x07, 0x07, 0x06, 
};

 uint8_t PROGMEM treeR[] = {
8, 3,
0x03, 0x07, 0x07, 0x07, 0x05, 0x05, 0x07, 0x07, 
};

// Scoreboard stuff
 uint8_t PROGMEM board[] = {
128, 64,
0xff, 0x01, 0x01, 0x01, 0x01, 0x01, 0x01, 0x01, 0x01, 0x01, 0x01, 0x01,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 0xff, 
0xff, 0x00, 0x00, 0x00, 0x00, 0x00, 0x00, 0x00, 0x00, 0x00, 0x00, 0x00,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 0xff, 
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0xff, 0x80, 0x80, 0x80, 0x80, 0x80, 0x80, 0x80, 0x80, 0x80, 0x80, 0x80,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 0xff, 
};

 uint8_t PROGMEM zero[] = {
7, 6,
0x06, 0x09, 0x09, 0x09, 0x09, 0x09, 0x06, 
};

 uint8_t PROGMEM one[] = {
7, 5,
0x07, 0x02, 0x02, 0x02, 0x02, 0x03, 0x02, 
};

 uint8_t PROGMEM two[] = {
7, 6,
0x0f, 0x01, 0x02, 0x04, 0x08, 0x09, 0x06, 
};

 uint8_t PROGMEM three[] = {
7, 6,
0x07, 0x08, 0x08, 0x06, 0x08, 0x08, 0x07, 
};

 uint8_t PROGMEM four[] = {
7, 6,
0x08, 0x08, 0x1f, 0x09, 0x0a, 0x0c, 0x08, 
};

 uint8_t PROGMEM five[] = {
7, 6,
0x07, 0x08, 0x08, 0x07, 0x01, 0x01, 0x0f, 
};

 uint8_t PROGMEM six[] = {
7, 6,
0x06, 0x09, 0x09, 0x07, 0x01, 0x01, 0x06, 
};

 uint8_t PROGMEM seven[] = {
7, 6,
0x02, 0x02, 0x04, 0x04, 0x08, 0x08, 0x0f, 
};

 uint8_t PROGMEM eight[] = {
7, 6,
0x06, 0x09, 0x09, 0x06, 0x09, 0x09, 0x06, 
};

 uint8_t PROGMEM nine[] = {
7, 6,
0x06, 0x08, 0x08, 0x0e, 0x09, 0x09, 0x06, 
};

void setup() {
  // put your setup code here, to run once:
  ab.begin();
  Serial.begin(9600);
  ab.clear();
  state = 0;
  playTime = 0;
  branchCount = 0;
  bananaCount = 0;
  ab.initRandomSeed();
  ab.setFrameRate(60);
  ab.audio.on();
}

void loop() {
  static int animFrame = 0;
  static bool gameOvered = false;

  // Check for next frame
  if (!ab.nextFrame()) {
    return;
  }

  ab.pollButtons();
  ab.clear();

  // Game State switch
  switch (state) {
    case 0:
      // TITLE SCREEN
      titlescreen();
      break;
    case 1:
      // GAME PLAY
      ab.invert(true);
      // Branch Spawn logic
      branchSpawnController(playTime, false);
      playTime++;
      //spawnCheck(spawnTimer);
      // Make the player jump when a button is pressed
      if (anyButtonPressed()) {
        player.jump();
      }

      player.update();
      banana.update();
      
      // Check if hit banana
      if (bananaCollisionCheck()) {
        bananaCount++;
        banana.spawn();
      }
      // Check if hit branch
      if (branchCollisionCheck()) {
        player.fall();
        animate = false;
      }
      if (player.getX() < -50) {
        state = 2;
      }

      // Add point for passing a branch
      if (branchScore()) {
        branchCount++;
      }

      // Draw functions
      drawTrees(animFrame);
      for (int i = 0; i < MAX_BRANCHES; i++) {
        if (branches[i].getActive()) {
          if (animate) branches[i].update();
          branches[i].draw();
        }
      }
      banana.draw();
      player.draw();


      break;
    case 2:
      // GAME OVER
      gameOver();

      if (anyButtonPressed()) 
      {
        resetGame();
      }
  }

  ab.display();
}

/**
 * @brief check if any button was just pressed
 *
 * This function checks if any of the Arduboy buttons were just pressed
 * during the current frame (i.e., transitioned from unpressed to pressed).
 *
 * @return True if any button is just pressed. False otherwise
 */
bool anyButtonPressed() 
{
  return ab.justPressed(LEFT_BUTTON)  ||
         ab.justPressed(RIGHT_BUTTON) || 
         ab.justPressed(UP_BUTTON)    || 
         ab.justPressed(DOWN_BUTTON)  ||
         ab.justPressed(A_BUTTON)     ||
         ab.justPressed(B_BUTTON);
}

/**
 * @brief draws and animates the title the title screen.
 *
 * This function handles the animation of the title screen logos, displays
 * additional text once the animation is complete, and transitions to the 
 * next game state when a button is pressed.
 *
 * @return void
 */
void titlescreen() 
{
  static int offset = 80;
  static int inPosition = false;

  Sprites::drawOverwrite(116, 1 + offset, logo_branches, 0);
  Sprites::drawOverwrite(101, 1 - offset, logo_and, 0);
  Sprites::drawOverwrite(89, 1 + offset, logo_bananas, 0);
  
  
  if (anyButtonPressed()) 
  {
    if (!inPosition) 
    {
      offset = 0;
    }
    else 
    {
      // ab.initRandomSeed();
      state = 1;
    }
  }

  if (offset <= 0) 
  {
    inPosition = true;
    Sprites::drawOverwrite(44, 8, logo_message, 0);
    Sprites::drawOverwrite(0, 13, logo_credit, 0);
  }
  else 
  {
    offset -= 2;
  } 
}

void gameOver() 
{ 
  uint8_t branchesTenthousands;
  uint8_t branchesThousands;
  uint8_t branchesHundreds;
  uint8_t branchesTens;
  uint8_t branchesOnes;
  uint8_t bananasTenthousands;
  uint8_t bananasThousands;
  uint8_t bananasHundreds;
  uint8_t bananasTens;
  uint8_t bananasOnes;
  uint8_t scoreTenthousands;
  uint8_t scoreThousands;
  uint8_t scoreHundreds;
  uint8_t scoreTens;
  uint8_t scoreOnes;
  uint8_t highScoreTenthousands;
  uint8_t highScoreThousands;
  uint8_t highScoreHundreds;
  uint8_t highScoreTens;
  uint8_t highScoreOnes;
  uint8_t *branchesTenthousandsSprite;
  uint8_t *branchesThousandsSprite;
  uint8_t *branchesHundredsSprite;
  uint8_t *branchesTensSprite;
  uint8_t *branchesOnesSprite;
  uint8_t *bananasTenthousandsSprite;
  uint8_t *bananasThousandsSprite;
  uint8_t *bananasHundredsSprite;
  uint8_t *bananasTensSprite;
  uint8_t *bananasOnesSprite;
  uint8_t *scoreTenthousandsSprite;
  uint8_t *scoreThousandsSprite;
  uint8_t *scoreHundredsSprite;
  uint8_t *scoreTensSprite;
  uint8_t *scoreOnesSprite;
  uint8_t *highScoreTenthousandsSprite;
  uint8_t *highScoreThousandsSprite;
  uint8_t *highScoreHundredsSprite;
  uint8_t *highScoreTensSprite;
  uint8_t *highScoreOnesSprite;
  uint16_t score = branchCount + (bananaCount * 3);
  
  if (score > highScore)
  {
    highScore = score;
  }

  // set digits
  branchesTenthousands = (branchCount / 10000);
  branchesThousands = (branchCount / 1000) % 10;
  branchesHundreds = (branchCount / 100) % 10;
  branchesTens = (branchCount / 10) % 10;
  branchesOnes = (branchCount) % 10;

  bananasTenthousands = (bananaCount / 10000);
  bananasThousands = (bananaCount / 1000) % 10;
  bananasHundreds = (bananaCount / 100) % 10;
  bananasTens = (bananaCount / 10) % 10;
  bananasOnes = (bananaCount) % 10;

  scoreTenthousands = (score / 10000);
  scoreThousands = (score / 1000) % 10;
  scoreHundreds = (score / 100) % 10;
  scoreTens = (score / 10) % 10;
  scoreOnes = (score) % 10;

  highScoreTenthousands = (highScore / 10000);
  highScoreThousands = (highScore / 1000) % 10;
  highScoreHundreds = (highScore / 100) % 10;
  highScoreTens = (highScore / 10) % 10;
  highScoreOnes = (highScore) % 10;
  
  // Assign sprite to pointer
  branchesTenthousandsSprite = getDigitSprite(branchesTenthousands);
  branchesThousandsSprite = getDigitSprite(branchesThousands);
  branchesHundredsSprite = getDigitSprite(branchesHundreds);
  branchesTensSprite = getDigitSprite(branchesTens);
  branchesOnesSprite = getDigitSprite(branchesOnes);
  bananasTenthousandsSprite = getDigitSprite(bananasTenthousands);
  bananasThousandsSprite = getDigitSprite(bananasThousands);
  bananasHundredsSprite = getDigitSprite(bananasHundreds);
  bananasTensSprite = getDigitSprite(bananasTens);
  bananasOnesSprite = getDigitSprite(bananasOnes);
  scoreTenthousandsSprite = getDigitSprite(scoreTenthousands);
  scoreThousandsSprite = getDigitSprite(scoreThousands);
  scoreHundredsSprite = getDigitSprite(scoreHundreds);
  scoreTensSprite = getDigitSprite(scoreTens);
  scoreOnesSprite = getDigitSprite(scoreOnes);
  highScoreTenthousandsSprite = getDigitSprite(highScoreTenthousands);
  highScoreThousandsSprite = getDigitSprite(highScoreThousands);
  highScoreHundredsSprite = getDigitSprite(highScoreHundreds);
  highScoreTensSprite = getDigitSprite(highScoreTens);
  highScoreOnesSprite = getDigitSprite(highScoreOnes);

  // Invert
  ab.invert(false);
  // Draw background
  Sprites::drawOverwrite(0, 0, board, 0);

  // Draw branches score
  Sprites::drawOverwrite(88, 17, branchesTenthousandsSprite, 0);
  Sprites::drawOverwrite(88, 23, branchesThousandsSprite, 0);
  Sprites::drawOverwrite(88, 29, branchesHundredsSprite, 0);
  Sprites::drawOverwrite(88, 35, branchesTensSprite, 0);
  Sprites::drawOverwrite(88, 41, branchesOnesSprite, 0);

  // Draw bananas score
  Sprites::drawOverwrite(62, 17, bananasTenthousandsSprite, 0);
  Sprites::drawOverwrite(62, 23, bananasThousandsSprite, 0);
  Sprites::drawOverwrite(62, 29, bananasHundredsSprite, 0);
  Sprites::drawOverwrite(62, 35, bananasTensSprite, 0);
  Sprites::drawOverwrite(62, 41, bananasOnesSprite, 0);

  // Draw final score
  Sprites::drawOverwrite(34, 17, scoreTenthousandsSprite, 0);
  Sprites::drawOverwrite(34, 23, scoreThousandsSprite, 0);
  Sprites::drawOverwrite(34, 29, scoreHundredsSprite, 0);
  Sprites::drawOverwrite(34, 35, scoreTensSprite, 0);
  Sprites::drawOverwrite(34, 41, scoreOnesSprite, 0);

  // Draw high score
  Sprites::drawOverwrite(8, 17, highScoreTenthousandsSprite, 0);
  Sprites::drawOverwrite(8, 23, highScoreThousandsSprite, 0);
  Sprites::drawOverwrite(8, 29, highScoreHundredsSprite, 0);
  Sprites::drawOverwrite(8, 35, highScoreTensSprite, 0);
  Sprites::drawOverwrite(8, 41, highScoreOnesSprite, 0);
}

 uint8_t* getDigitSprite(int digit)
{
  switch (digit) 
  {
    case 0:
      return zero;
      break;
    case 1:
      return one;
      break;
    case 2:
      return two;
      break;
    case 3:
      return three;
      break;
    case 4:
      return four;
      break;
    case 5:
      return five;
      break;
    case 6:
      return six;
      break;
    case 7:
      return seven;
      break;
    case 8:
      return eight;
      break;
    case 9:
      return nine;
      break;
    default:
      return zero;
  } 
}


void drawTrees(int &animFrame) 
{
  if (animate) 
  {
    if (animFrame < 7) 
    {
      animFrame++;
    } else {
      animFrame = 0;
    }
  }
  
  for (int i = 0; i <= 128; i += 8) 
  {
    Sprites::drawOverwrite(i - animFrame, 0, tree, 0);
    Sprites::drawOverwrite(i - animFrame, 61, treeR, 0);
  }
}

bool branchScore() {
  for (int i = 0; i < MAX_BRANCHES; i++) 
  {
    if (branches[i].getX() <= -5) 
    {
      return true;
    }
  }

  return false;
}

bool branchCollisionCheck() 
{
  for (int i = 0; i < MAX_BRANCHES; i++) 
  {
    if (branches[i].getActive()) 
    {
      if (player.getX() < branches[i].getX() + branches[i].getHeight() - 1 &&       // Is the bottom of the player below the top of the branch (subtract 1)
          player.getX() + 16 > branches[i].getX() + 2 &&                            // Is the top of the player above the bottom of the branch (plus 2)
          player.getY() < branches[i].getY() + branches[i].getLength() - 2 &&           // Is the left of the player to the left of the right of the branch
          player.getY() + 16 > branches[i].getY() + 2)                                  // Is the right of the player to the right of the left of the branch
      {
        return true;
      }
    }
  }

  return false;
}

bool bananaCollisionCheck() 
{
      if (player.getX() < banana.getX() + 16 &&
          player.getX() + 16 > banana.getX() &&
          player.getY() < banana.getY() + 12 &&
          player.getY() + 16 > banana.getY())                                  
      {
        player.getBanana();
        return true;
      }
      return false;
}

void resetGame() 
{
  player.reset();
  for (int i = 0; i < MAX_BRANCHES; i++) {
    branches[i].reset();
  }
  animate = true;
  bananaCount = 0;
  branchCount = 0;
  playTime = 0;
  branchSpawnController(0, true);
  state = 1;
}

void spawnBranch() {
  for (int i = 0; i < MAX_BRANCHES; i++) {
    if (!branches[i].getActive()) {
      branches[i].spawn();
      return;
    }
  }
}

void branchSpawnController(int timePassed, bool delayReset)
{
  static uint8_t delay = 96;
  static uint8_t rndRange = random(16);
  static uint8_t space = 32;

  if (delayReset)
  {
    delay = 96;
    rndRange = random(16);
    space = 32;
    return;
  }

  delay--;

  if (delay == 0)
  {
    spawnBranch();
    delay = space + rndRange;

    Serial.print(String(delay) + " | " + String(timePassed));
    
    // Determine variables for difficulty
    if (timePassed < 900)
    {
      rndRange = random(16);
      space = 32;
      Serial.println(" | " + String(timePassed) + " easy");
    }
    else if (timePassed < 1800)
    {
      rndRange = random(8);
      space = 26;
      Serial.println(" | " + String(timePassed) + " medium");
    }
    else
    {
      rndRange = random(8);
      space = 22;
      Serial.println(" | " + String(timePassed) + " hard");
    }
  }
  
  
}
